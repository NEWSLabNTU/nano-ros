// nros-cpp: Publisher class
// Freestanding C++ — no exceptions, no STL required

/**
 * @file publisher.hpp
 * @ingroup grp_pubsub
 * @brief `nros::Publisher<M>` — typed topic publisher.
 */

#ifndef NROS_CPP_PUBLISHER_HPP
#define NROS_CPP_PUBLISHER_HPP

#include <cstdint>
#include <cstddef>
#include <string.h> // memcpy — `<cstring>` isn't in Zephyr's minimal libcpp

#include "nros/config.hpp"
#include "nros/result.hpp"

// FFI declarations
extern "C" {
typedef int nros_cpp_ret_t;
nros_cpp_ret_t nros_cpp_publish_raw(void* storage, const uint8_t* data, size_t len);
nros_cpp_ret_t nros_cpp_publisher_destroy(void* storage);
nros_cpp_ret_t nros_cpp_publisher_relocate(void* old_storage, void* new_storage);

// Phase 108 — publisher-side status-event setters. Returns
// NROS_CPP_RET_UNSUPPORTED until backend wiring lands per-phase.
struct nros_cpp_pub_count_status_t {
    uint32_t total_count;
    uint32_t total_count_change;
};
typedef void (*nros_cpp_publisher_count_cb_t)(
    void* storage,
    nros_cpp_pub_count_status_t status,
    void* user_context);
nros_cpp_ret_t nros_cpp_publisher_set_liveliness_lost(
    void* storage, nros_cpp_publisher_count_cb_t cb, void* user_context);
nros_cpp_ret_t nros_cpp_publisher_set_offered_deadline_missed(
    void* storage, uint32_t deadline_ms,
    nros_cpp_publisher_count_cb_t cb, void* user_context);
} // extern "C"

namespace nros {

/// Maximum topic name length stored inside `nros::Publisher<M>` (256).
/// The topic name is owned C++-side, not inside the runtime handle.
static constexpr size_t PUBLISHER_TOPIC_NAME_MAX = 256;

/// Typed publisher for a ROS 2 topic.
///
/// Mirrors `rclcpp::Publisher<M>`. The message type `M` must provide
/// `TYPE_NAME`, `TYPE_HASH`, and `ffi_publish()` (generated by codegen).
///
/// Raw CDR publishing is always available via `publish_raw()`.
///
/// Inline storage holds the runtime publisher handle directly
/// (`NROS_PUBLISHER_SIZE` bytes; size auto-derived from the runtime).
/// Topic name metadata lives C++-side in `topic_name_`, avoiding a
/// runtime hop for `get_topic_name()`.
///
/// Usage:
/// ```cpp
/// nros::Publisher<std_msgs::msg::String> pub;
/// NROS_TRY(node.create_publisher(pub, "/chatter"));
/// pub.publish_raw(cdr_data, cdr_len);
/// ```
template <typename M> class Publisher {
  public:
    /// Publish a typed message.
    ///
    /// Calls the codegen-generated `M::ffi_publish()` which serializes the
    /// message to CDR and publishes it.
    Result publish(const M& msg) { return Result(M::ffi_publish(storage_, &msg)); }

    /// Publish raw CDR bytes.
    Result publish_raw(const uint8_t* data, size_t len) {
        if (!initialized_) return Result(ErrorCode::NotInitialized);
        return Result(nros_cpp_publish_raw(storage_, data, len));
    }

    /// Get the topic name.
    const char* get_topic_name() const { return initialized_ ? topic_name_ : ""; }

    /// Check if the publisher is initialized and valid.
    bool is_valid() const { return initialized_; }

    /// Destructor — releases publisher resources.
    ~Publisher() {
        if (initialized_) {
            nros_cpp_publisher_destroy(storage_);
            initialized_ = false;
        }
    }

    // Move semantics (non-copyable). Relocation goes through the
    // `nros_cpp_publisher_relocate` runtime call.
    Publisher(Publisher&& other) : initialized_(other.initialized_) {
        if (other.initialized_) {
            nros_cpp_publisher_relocate(other.storage_, storage_);
            ::memcpy(topic_name_, other.topic_name_, sizeof(topic_name_));
            other.initialized_ = false;
        }
    }

    Publisher& operator=(Publisher&& other) {
        if (this != &other) {
            if (initialized_) {
                nros_cpp_publisher_destroy(storage_);
                initialized_ = false;
            }
            if (other.initialized_) {
                nros_cpp_publisher_relocate(other.storage_, storage_);
                ::memcpy(topic_name_, other.topic_name_, sizeof(topic_name_));
                initialized_ = true;
                other.initialized_ = false;
            }
        }
        return *this;
    }

    /// Default constructor — creates an uninitialized publisher.
    /// Use `Node::create_publisher()` to initialize.
    Publisher() : storage_(), topic_name_{}, initialized_(false) {}

    // ====================================================================
    // Phase 108 — status events
    // ====================================================================

    /// Register a callback for liveliness-lost events on this publisher.
    Result on_liveliness_lost(
        nros_cpp_publisher_count_cb_t cb, void* user_context = nullptr) {
        if (!initialized_) return Result(ErrorCode::NotInitialized);
        return Result(nros_cpp_publisher_set_liveliness_lost(
            storage_, cb, user_context));
    }

    /// Register a callback for offered-deadline-missed events on this
    /// publisher.
    Result on_offered_deadline_missed(
        uint32_t deadline_ms,
        nros_cpp_publisher_count_cb_t cb, void* user_context = nullptr) {
        if (!initialized_) return Result(ErrorCode::NotInitialized);
        return Result(nros_cpp_publisher_set_offered_deadline_missed(
            storage_, deadline_ms, cb, user_context));
    }

  private:
    Publisher(const Publisher&) = delete;
    Publisher& operator=(const Publisher&) = delete;

    friend class Node;

    alignas(8) uint8_t storage_[NROS_PUBLISHER_SIZE];
    char topic_name_[PUBLISHER_TOPIC_NAME_MAX];
    bool initialized_;
};

} // namespace nros

// Phase 84.G8: out-of-line definition of Node::create_publisher<M>().
// Placed here so consumers only pay for this template when they actually
// use publishers — including `nros/node.hpp` alone no longer drags in
// every entity's code path.
#include "nros/node.hpp"

namespace nros {

template <typename M>
Result Node::create_publisher(Publisher<M>& out, const char* topic, const QoS& qos) {
    if (!initialized_) return Result(ErrorCode::NotInitialized);
    nros_cpp_qos_t ffi_qos;
    ffi_qos.reliability = static_cast<nros_cpp_qos_reliability_t>(qos.reliability_raw());
    ffi_qos.durability = static_cast<nros_cpp_qos_durability_t>(qos.durability_raw());
    ffi_qos.history = static_cast<nros_cpp_qos_history_t>(qos.history_raw());
    ffi_qos.depth = qos.depth();
    nros_cpp_ret_t ret = nros_cpp_publisher_create(&handle_, topic, M::TYPE_NAME, M::TYPE_HASH,
                                                   ffi_qos, out.storage_);
    if (ret == 0) {
        // Topic name lives C++-side; copy + null-terminate into the
        // fixed-size buffer. Truncation is silent.
        size_t topic_len = 0;
        while (topic[topic_len] != '\0' && topic_len + 1 < sizeof(out.topic_name_)) {
            out.topic_name_[topic_len] = topic[topic_len];
            ++topic_len;
        }
        out.topic_name_[topic_len] = '\0';
        out.initialized_ = true;
    }
    return Result(ret);
}

} // namespace nros

#endif // NROS_CPP_PUBLISHER_HPP
