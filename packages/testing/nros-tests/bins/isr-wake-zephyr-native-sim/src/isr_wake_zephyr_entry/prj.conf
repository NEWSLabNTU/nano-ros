## CMakeLists.txt
```
# Issue 2706 -- a Zephyr interrupt (a k_timer expiry, which runs in the system
# clock's interrupt handler) wakes a parked executor through
# `GuardCondition::trigger_from_isr`. Rust `rust_main` plus a small C helper
# that owns the timer and stamps its expiry.
cmake_minimum_required(VERSION 3.20.0)
find_package(Zephyr REQUIRED HINTS $ENV{ZEPHYR_BASE})
project(isr_wake_zephyr_entry)

if(NOT CONFIG_NROS_RMW_ZENOH)
    message(FATAL_ERROR
        "isr-wake-zephyr-native-sim is a zenoh image: build it with "
        "-DNROS_IMAGE=zephyr_zenoh (system.toml)")
endif()
set(EXTRA_CARGO_ARGS --no-default-features --features rmw-zenoh)

target_sources(app PRIVATE src/isr_timer.c)
rust_cargo_application()
```

## prj.conf
```kconfig
# Issue 2706 -- the interrupt-wake image on native_sim. The board/NSOS tail
# (offloaded sockets) is added by the fixture script, not stated here.
CONFIG_RUST=y
CONFIG_NROS=y

CONFIG_LOG=y
CONFIG_LOG_DEFAULT_LEVEL=3
CONFIG_PRINTK=y
CONFIG_EARLY_CONSOLE=y

CONFIG_NETWORKING=y
CONFIG_NET_IPV4=y
CONFIG_NET_UDP=y
CONFIG_NET_TCP=y
CONFIG_NET_SOCKETS=y
CONFIG_NET_MAX_CONTEXTS=16
CONFIG_DNS_RESOLVER=n
CONFIG_NET_CONNECTION_MANAGER=y

CONFIG_POSIX_API=y
CONFIG_MAX_PTHREAD_MUTEX_COUNT=64
CONFIG_MAX_PTHREAD_COND_COUNT=16
CONFIG_POSIX_THREAD_THREADS_MAX=16

CONFIG_SYS_CLOCK_TICKS_PER_SEC=1000
CONFIG_HEAP_MEM_POOL_SIZE=131072
CONFIG_SYSTEM_WORKQUEUE_STACK_SIZE=4096
CONFIG_NET_PKT_RX_COUNT=32
CONFIG_NET_PKT_TX_COUNT=32
CONFIG_NET_BUF_RX_COUNT=64
CONFIG_NET_BUF_TX_COUNT=64
```

## src/isr_timer.c
```c
/* Issue 2706 -- the interrupt this image's test takes.
 *
 * A k_timer's expiry function runs in the system clock's interrupt handler,
 * so `on_expiry` is interrupt context: it checks that (`k_is_in_isr`), stamps
 * the cycle counter and calls the Rust handler, which calls
 * `GuardCondition::trigger_from_isr`. The guard's callback then asks how many
 * microseconds have passed since the stamp. */
#include <zephyr/kernel.h>
#include <stdint.h>

extern void nros_isr_test_on_interrupt(void);

static struct k_timer timer;
static volatile uint32_t stamp_cycles;
static volatile uint32_t not_in_isr;

static void on_expiry(struct k_timer *t) {
    (void)t;
    if (!k_is_in_isr()) {
        not_in_isr++;
    }
    stamp_cycles = k_cycle_get_32();
    nros_isr_test_on_interrupt();
}

void nros_isr_test_start(uint32_t period_us) {
    k_timer_init(&timer, on_expiry, NULL);
    k_timer_start(&timer, K_USEC(period_us), K_USEC(period_us));
}

void nros_isr_test_stop(void) {
    k_timer_stop(&timer);
}

/* Microseconds since the last expiry's stamp. */
uint32_t nros_isr_test_elapsed_us(void) {
    uint32_t cycles = k_cycle_get_32() - stamp_cycles;
    return (uint32_t)k_cyc_to_us_floor32(cycles);
}

/* Expiries that did NOT run in interrupt context (must stay 0). */
uint32_t nros_isr_test_not_in_isr(void) {
    return not_in_isr;
}
```
