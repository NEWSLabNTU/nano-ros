## CMakeLists.txt
```
# SPDX-License-Identifier: Apache-2.0
# Issue 2738 -- a thread dies holding nros_log's dispatcher on a Zephyr SMP
# image. The fatal error handler says so once and hands the dispatcher back,
# so a later record is delivered; a second death, with the check skipped, is
# the negative control: its later record never arrives.

cmake_minimum_required(VERSION 3.20.0)

find_package(Zephyr REQUIRED HINTS $ENV{ZEPHYR_BASE})
project(log_dead_holder_zephyr_smp)

target_sources(app PRIVATE src/main.c)
```

## prj.conf
```kconfig
# Issue 2738 -- a thread that faults inside a log sink holds nros_log's
# dispatcher when it dies. Deferred mode, as the small-stack cell: the
# platform sink's records reach the console through Zephyr's log thread.
CONFIG_MAIN_STACK_SIZE=8192
CONFIG_HEAP_MEM_POOL_SIZE=32768

CONFIG_LOG=y
CONFIG_LOG_DEFAULT_LEVEL=3
CONFIG_LOG_MODE_DEFERRED=y
CONFIG_LOG_PROCESS_THREAD=y
CONFIG_LOG_BUFFER_SIZE=16384
CONFIG_PRINTK=y

# The check attributes the dispatcher's holder to a thread by its stack
# bounds; the report names the thread.
CONFIG_THREAD_STACK_INFO=y
CONFIG_THREAD_NAME=y

# nros module -- C API only; zenoh satisfies `choice NROS_RMW_BACKEND`, and
# no RMW API is called.
CONFIG_NROS=y
CONFIG_NROS_C_API=y
CONFIG_NROS_RMW_ZENOH=y

CONFIG_POSIX_THREADS=y
CONFIG_POSIX_API=y
CONFIG_POSIX_THREAD_THREADS_MAX=8
CONFIG_MAX_PTHREAD_MUTEX_COUNT=64
CONFIG_MAX_PTHREAD_COND_COUNT=16

# zpico_zephyr.c references `iface->config.ip`, gated on CONFIG_NET_IP.
CONFIG_NETWORKING=y
CONFIG_NET_IPV4=y
CONFIG_NET_SOCKETS=y
# qemu_cortex_a53 has no entropy device (as nros-board-qemu-cortex-a53 does).
CONFIG_TEST_RANDOM_GENERATOR=y
# The harness attaches `-nic user,model=e1000` (see the small-stack cell).
CONFIG_NET_RX_STACK_SIZE=4096
```

## src/main.c
```c
/*
 * Issue 2738 -- a thread dies holding nros_log's dispatcher.
 *
 * A C log sink faults (`k_oops`) on a record whose message starts with "DIE",
 * so the thread that raised it dies INSIDE nros_log's dispatch, holding its
 * guard: deterministic, with no stack overflow to aim. This image's fatal
 * error handler returns, so Zephyr aborts that thread and runs on, which is
 * the configuration where every later record used to be held for a holder
 * that never delivers it.
 *
 * Phase 1: the handler calls `nros_zephyr_log_dead_holder_check`, which must
 * print one line naming `victim1` and hand the dispatcher back; main's next
 * record must reach the console.
 *
 * Phase 2, the NEGATIVE CONTROL: the handler skips the check. Main's next
 * record must NOT reach the console: without the check the death is silent
 * and the record is stranded, which is what makes phase 1's delivery mean
 * something. It runs second because it leaves the dispatcher held for good.
 *
 * The verdict is read from the faulting sink, which echoes every other record
 * with a prefix: it is serialised behind the dispatcher, so it is what a dead
 * holder strands. The Zephyr console sink is re-entrant since issue 2762 and
 * gets every record without the dispatcher, so the stranded record DOES reach
 * the console in phase 2, which the test also asserts.
 *
 * The strings below are `nros_tests::output::LOG_DEAD_HOLDER_*`.
 */

#include <string.h>

#include <zephyr/fatal.h>
#include <zephyr/kernel.h>

#include <rclc/log.h>

/* packages/platform/nros-platform-zephyr/src/platform.c */
bool nros_zephyr_log_dead_holder_check(struct k_thread* thread);

#define VICTIM_STACK 8192

K_THREAD_STACK_DEFINE(victim_stack, VICTIM_STACK);
static struct k_thread victim_thread;

/* Phase 1 runs the check, phase 2 (the control) does not. */
static volatile bool run_check = true;

void k_sys_fatal_error_handler(unsigned int reason, const struct arch_esf* esf) {
    (void)esf;
    if (run_check) {
        (void)nros_zephyr_log_dead_holder_check(k_current_get());
    }
    printk("log-dead-holder: handler returns, reason %u\n", reason);
    /* Returning makes Zephyr abort the faulting thread, not halt. */
}

static void fatal_sink(void* user_data, rcl_log_severity_t severity, const char* logger_name,
                       size_t logger_name_len, const char* message, size_t message_len,
                       const char* file, size_t file_len, uint32_t line, uint64_t timestamp_ns) {
    (void)user_data;
    (void)severity;
    (void)file;
    (void)file_len;
    (void)line;
    (void)timestamp_ns;
    if (message_len >= 3 && memcmp(message, "DIE", 3) == 0) {
        k_oops();
    }
    printk("log-dead-holder: serialised sink got [%.*s]: %.*s\n", (int)logger_name_len, logger_name,
           (int)message_len, message);
}

static void victim_entry(void* a, void* b, void* c) {
    (void)b;
    (void)c;
    rclc_logger_t logger = rclc_log_get_logger("victim");
    RCLC_LOG_INFO(logger, "DIE in victim%d", (int)(intptr_t)a);
    printk("log-dead-holder: victim survived its sink (the sink did not fault)\n");
}

static void kill_victim(int n, const char* name) {
    k_thread_create(&victim_thread, victim_stack, K_THREAD_STACK_SIZEOF(victim_stack), victim_entry,
                    (void*)(intptr_t)n, NULL, NULL, K_PRIO_PREEMPT(5), 0, K_FOREVER);
    k_thread_name_set(&victim_thread, name);
    k_thread_start(&victim_thread);
    (void)k_thread_join(&victim_thread, K_SECONDS(10));
}

int main(void) {
    printk("log-dead-holder: boot\n");
    rclc_log_init();
    if (!rclc_log_add_sink(fatal_sink, NULL)) {
        printk("log-dead-holder: FAILED to install the faulting sink\n");
        return 0;
    }
    rclc_logger_t logger = rclc_log_get_logger("main");

    kill_victim(1, "victim1");
    RCLC_LOG_INFO(logger, "record after the released death");
    /* Deferred mode: let the log thread drain. */
    k_sleep(K_MSEC(500));
    printk("log-dead-holder: phase 1 done\n");

    run_check = false;
    kill_victim(2, "victim2");
    RCLC_LOG_INFO(logger, "record after the unreported death");
    k_sleep(K_MSEC(500));
    printk("log-dead-holder: done\n");
    return 0;
}
```
