## CMakeLists.txt
```
# Issue 2084 -- a link-layout witness: one level spawned on the shim's tier
# pool and one on a declared stack (the generated C/C++ entry's spelling),
# with CONFIG_NROS_ZEPHYR_STACKS_IN_DTCM on a devicetree that has a "DTCM"
# region (app.overlay carves one out of mps2_an385's SRAM). The test
# (tests/zephyr_link_layout.rs) reads the ELF: `nros_tier_stacks`,
# `__nros_tier_stack_1` and `nros_thread_stacks` must all sit in the DTCM
# output section.
cmake_minimum_required(VERSION 3.20.0)
find_package(Zephyr REQUIRED HINTS $ENV{ZEPHYR_BASE})
project(tier_stacks_dtcm_zephyr_mps2)
target_sources(app PRIVATE src/main.c)
```

## prj.conf
```kconfig
# Issue 2084 -- the tier pool must follow CONFIG_NROS_ZEPHYR_STACKS_IN_DTCM
# into the devicetree's DTCM region. CONFIG_NROS_ZEPHYR_TIER_STACKS_IN_DTCM is
# left to its default (it follows the task-stack knob), which is the rule
# under test. One 64 KiB tier slot, the size the MR-CANHUBK344 level needs.
CONFIG_PRINTK=y
CONFIG_EARLY_CONSOLE=y
CONFIG_LOG=y
CONFIG_LOG_BACKEND_RTT=n
CONFIG_NROS=y
CONFIG_NROS_C_API=y
CONFIG_NROS_RMW_ZENOH=y
CONFIG_POSIX_API=y
CONFIG_MAX_PTHREAD_MUTEX_COUNT=64
CONFIG_MAX_PTHREAD_COND_COUNT=16
CONFIG_NETWORKING=y
CONFIG_NET_IPV4=y
CONFIG_NET_SOCKETS=y
CONFIG_NET_UDP=y
CONFIG_NET_L2_ETHERNET=y
CONFIG_NROS_ZEPHYR_STACKS_IN_DTCM=y
CONFIG_NROS_ZEPHYR_MAX_TIERS=1
CONFIG_NROS_ZEPHYR_TIER_STACK_SIZE=65536
CONFIG_NROS_ZEPHYR_TASK_STACK_SIZE=8192
```

## app.overlay
```dts
/* Issue 2084 -- give mps2_an385 a "DTCM" linker region. The board has none;
 * its 4 MiB SRAM is split so the top 512 KiB becomes a zephyr,memory-region
 * named "DTCM", the same shape the S32K344's dtcm node has. QEMU backs the
 * whole 4 MiB, so the image also boots. */
&sram0 {
	reg = <0x20000000 0x380000>;
};

/ {
	dtcm: memory@20380000 {
		compatible = "zephyr,memory-region";
		reg = <0x20380000 0x80000>;
		zephyr,memory-region = "DTCM";
	};
};
```

## src/main.c
```c
/*
 * Issue 2084 -- tier stacks in DTCM, link-layout witness.
 *
 * Spawns one level on the nano-ros shim's tier pool
 * (`nros_zephyr_tier_task_create`), which is what keeps `nros_tier_stacks` in
 * the link: --gc-sections drops the pool from an image that spawns no tier.
 * A second level runs on a DECLARED stack, spelled the way a generated C/C++
 * entry spells it (`NROS_TIER_TASK_MEMORY_DEFINE`,
 * <rclc/detail/tier_task_memory_zephyr.h>), which must follow the same rule.
 * Each level reports whether its stack lies in the devicetree's DTCM region,
 * so a QEMU boot of the image shows the placement at run time as well; the
 * test reads it from the ELF.
 */

#include <stdint.h>
#include <stddef.h>

#include <zephyr/devicetree.h>
#include <zephyr/kernel.h>
#include <zephyr/sys/printk.h>

#include <rclc/detail/tier_task_memory_zephyr.h>

extern int nros_zephyr_tier_task_create_static(void* (*entry)(void*), void* arg, int32_t priority,
                                               const char* name, void* stack, size_t stack_size,
                                               void* thread, uint32_t core_plus1, int* pin_rc);
extern int nros_zephyr_tier_task_create(void* (*entry)(void*), void* arg, int32_t priority,
                                        const char* name, size_t stack_bytes,
                                        uint32_t core_plus1, int* pin_rc);

#define DTCM_NODE DT_NODELABEL(dtcm)
#define DTCM_LO ((uintptr_t)DT_REG_ADDR(DTCM_NODE))
#define DTCM_HI (DTCM_LO + (uintptr_t)DT_REG_SIZE(DTCM_NODE))

/* The declared level's stack: `__nros_tier_stack_1`, 4 KiB. */
NROS_TIER_TASK_MEMORY_DEFINE(1, 4096u);

static void* level(void* arg) {
    uintptr_t sp = (uintptr_t)&arg;
    printk("tier-stacks-dtcm: level `%s` stack %s DTCM (sp=0x%08lx)\n", (const char*)arg,
           (sp >= DTCM_LO && sp < DTCM_HI) ? "in" : "NOT in", (unsigned long)sp);
    for (;;) {
        k_sleep(K_FOREVER);
    }
    return NULL;
}

int main(void) {
    int pin_rc = 0;
    int rc = nros_zephyr_tier_task_create(level, (void*)"pool", 5, "pool", 0u, 0u, &pin_rc);
    printk("tier-stacks-dtcm: pool spawn rc=%d\n", rc);
    const nros_tier_task_memory_t mem = NROS_TIER_TASK_MEMORY(1);
    rc = nros_zephyr_tier_task_create_static(level, (void*)"declared", 6, "declared", mem.stack,
                                             mem.stack_bytes, mem.tcb, 0u, &pin_rc);
    printk("tier-stacks-dtcm: declared spawn rc=%d\n", rc);
    return 0;
}
```
