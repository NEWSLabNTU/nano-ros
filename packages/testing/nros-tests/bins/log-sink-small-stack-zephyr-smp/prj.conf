## CMakeLists.txt
```
# SPDX-License-Identifier: Apache-2.0
# Issue 2738 -- a thread on a small stack logs through nros_log on a Zephyr
# SMP image. With the sink's buffer pool every record reaches the console;
# with the old caller-stack buffer (`legacy-sink.conf`, the negative control)
# the thread overflows.

cmake_minimum_required(VERSION 3.20.0)

find_package(Zephyr REQUIRED HINTS $ENV{ZEPHYR_BASE})
project(log_sink_small_stack_zephyr_smp)

target_sources(app PRIVATE src/main.c)
```

## prj.conf
```kconfig
# Issue 2738 -- the log sink's buffers are the SINK's, not the logging
# thread's. Deferred mode: the mode the pool's claim-format-log-release cycle
# is designed around, and the one where Zephyr's own log core does not run on
# the caller's stack.
CONFIG_MAIN_STACK_SIZE=8192
CONFIG_HEAP_MEM_POOL_SIZE=32768

CONFIG_LOG=y
CONFIG_LOG_DEFAULT_LEVEL=3
CONFIG_LOG_MODE_DEFERRED=y
CONFIG_LOG_PROCESS_THREAD=y
# Large enough that the 50 records the thread logs never drop for want of
# log buffer: a drop must mean the thread died, not that Zephyr ran short.
CONFIG_LOG_BUFFER_SIZE=16384
CONFIG_PRINTK=y

# A stack overflow must be LOUD, not a silent corruption: the sentinel is
# checked at every context switch and raises a fatal error naming the thread.
CONFIG_STACK_SENTINEL=y
CONFIG_THREAD_STACK_INFO=y
CONFIG_INIT_STACKS=y
CONFIG_THREAD_NAME=y

# nros module -- C API only; zenoh satisfies `choice NROS_RMW_BACKEND`, and
# no RMW API is called.
CONFIG_NROS=y
CONFIG_NROS_C_API=y
CONFIG_NROS_RMW_ZENOH=y

CONFIG_POSIX_THREADS=y
CONFIG_POSIX_API=y
CONFIG_POSIX_THREAD_THREADS_MAX=8
CONFIG_MAX_PTHREAD_MUTEX_COUNT=64
CONFIG_MAX_PTHREAD_COND_COUNT=16

# zpico_zephyr.c references `iface->config.ip`, gated on CONFIG_NET_IP.
CONFIG_NETWORKING=y
CONFIG_NET_IPV4=y
CONFIG_NET_SOCKETS=y
```

## legacy-sink.conf
```kconfig
# The negative control: the sink formats every record in a 1280-byte buffer
# on the stack of the thread that logged, as it did before issue 2738. The
# thread's stack use must exceed the budget the pool image is held to; if it
# does not, the budget cannot tell the two sinks apart and the cell proves
# nothing.
CONFIG_NROS_ZEPHYR_LOG_SINK_BUFFERS=0
```

## src/main.c
```c
/*
 * Issue 2738 -- a thread on a small stack logs through nros_log.
 *
 * The thread logs RECORDS records and reports how many bytes of its stack it
 * used. Its stack is large enough that neither sink overflows it, so the
 * number is a measurement rather than a crash: the harness holds the pool
 * image to a budget a small thread can afford, and checks that the old
 * caller-stack buffer (`legacy-sink.conf`) exceeds it.
 *
 * An overflow is not the verdict because it is not reliably detected: the old
 * sink's buffer is written from its low end, past the sentinel word, so it
 * corrupts whatever lies below the stack and the thread often finishes.
 */

#include <zephyr/kernel.h>

#include <rclc/log.h>

#define THREAD_STACK 8192
#define RECORDS 50

uint32_t nros_zephyr_log_sink_fallbacks(void);

K_THREAD_STACK_DEFINE(small_stack, THREAD_STACK);
static struct k_thread small_thread;

static void small_entry(void* a, void* b, void* c) {
    (void)a;
    (void)b;
    (void)c;
    rclc_logger_t logger = rclc_log_get_logger("small");
    for (int i = 0; i < RECORDS; i++) {
        RCLC_LOG_INFO(logger, "small-stack record %d", i);
    }
    /* stack_info.size is the region k_thread_stack_space_get scans, so the
     * subtraction is in its units (THREAD_STACK_INFO). */
    size_t unused = 0;
    (void)k_thread_stack_space_get(k_current_get(), &unused);
    size_t size = k_current_get()->stack_info.size;
    printk("log-sink-small-stack: thread done, stack used %u of %u\n", (unsigned)(size - unused),
           (unsigned)size);
}

int main(void) {
    printk("log-sink-small-stack: boot\n");
    rclc_log_init();
    printk("log-sink-small-stack: start, sink buffers %d, cpus %d\n",
           CONFIG_NROS_ZEPHYR_LOG_SINK_BUFFERS, CONFIG_MP_MAX_NUM_CPUS);
    k_thread_create(&small_thread, small_stack, K_THREAD_STACK_SIZEOF(small_stack), small_entry,
                    NULL, NULL, NULL, K_PRIO_PREEMPT(5), 0, K_NO_WAIT);
    k_thread_name_set(&small_thread, "small_logger");
    (void)k_thread_join(&small_thread, K_SECONDS(10));
    /* Deferred mode: let the log thread drain before the summary. */
    k_sleep(K_MSEC(500));
    printk("log-sink-small-stack: done, fallbacks %u\n", nros_zephyr_log_sink_fallbacks());
    return 0;
}
```
