## CMakeLists.txt
```
# SPDX-License-Identifier: Apache-2.0
# Phase 88.15.e — Zephyr native_sim nros-log smoke fixture

cmake_minimum_required(VERSION 3.20.0)

find_package(Zephyr REQUIRED HINTS $ENV{ZEPHYR_BASE})
project(logging_smoke_zephyr_native_sim)

# Pulls the nros module — libnros_c.a + the Phase-88 Zephyr
# `PlatformLog` impl (routes records through LOG_INF / LOG_ERR /
# etc. under the hood).
target_sources(app PRIVATE src/main.c)
```

## prj.conf
```kconfig
# Phase 88.15.e — minimal nros-log smoke for Zephyr native_sim.
#
# Doesn't init RMW — just installs the nros-log dispatcher (which
# routes via `nros-platform-zephyr::PlatformLog` → Zephyr `LOG_*`)
# and emits every severity.

CONFIG_MAIN_STACK_SIZE=8192
CONFIG_HEAP_MEM_POOL_SIZE=32768

# Logging — required for the platform impl's LOG_INF / LOG_ERR
# forwarders.
CONFIG_LOG=y
CONFIG_LOG_DEFAULT_LEVEL=4
CONFIG_LOG_MODE_IMMEDIATE=y
CONFIG_PRINTK=y
CONFIG_EARLY_CONSOLE=y
CONFIG_LOG_BACKEND_RTT=n

# nros module — C API only; pick zenoh as the RMW choice to satisfy
# Kconfig's `choice NROS_RMW_BACKEND` but never call any RMW APIs.
CONFIG_NROS=y
CONFIG_NROS_C_API=y
CONFIG_NROS_RMW_ZENOH=y

# POSIX threading the staticlib needs. Issue 2187 -- CONFIG_POSIX_THREADS, not
# its 3.7 [DEPRECATED] alias PTHREAD_IPC, which 4.4 removed.
CONFIG_POSIX_THREADS=y
CONFIG_POSIX_API=y
CONFIG_POSIX_THREAD_THREADS_MAX=8
# 64, not 32 — the build derives a floor and refuses below it; see
# `_nros_mutex_floor` in `zephyr/cmake/nros_cargo_build.cmake`.
CONFIG_MAX_PTHREAD_MUTEX_COUNT=64
CONFIG_MAX_PTHREAD_COND_COUNT=16

# Networking — the Zephyr nros module's RMW-backend CMake branches
# all source `zpico_zephyr.c`, which references `iface->config.ip`.
# That member is gated on `CONFIG_NET_IP=y`, so a minimal app
# still has to enable IPv4 even if it never opens a socket.
CONFIG_NETWORKING=y
CONFIG_NET_IPV4=y
CONFIG_NET_SOCKETS=y
```

## boards/native_sim_native_64.conf
```kconfig
# Slow native_sim down so log lines reach stdout before the
# process exits.
CONFIG_NATIVE_SIM_SLOWDOWN_TO_REAL_TIME=y
```

## src/main.c
```c
/*
 * Phase 88.15.e — Zephyr native_sim nros-log smoke fixture.
 *
 * Boots Zephyr `native_sim`, installs the nros-log dispatcher
 * (`rclc_log_init`), grabs the catch-all logger handle
 * (`rclc_log_default_logger`), drives every Severity through
 * `NROS_LOG_*` plus one record through a child logger (`smoke.child`),
 * then exits via `posix_exit`. The harness drains
 * the native_sim process's stdout + stderr and asserts every
 * `[<LEVEL>] nros: <payload>` line appears.
 */

#include <zephyr/kernel.h>
#include <zephyr/logging/log.h>

LOG_MODULE_REGISTER(nros_log_smoke, LOG_LEVEL_INF);

#include <rclc/log.h>

#include <stdlib.h>

/* Zephyr native_sim cleanly halts the simulator process via
 * `nsi_exit(int)`. Plain libc `exit()` from a Zephyr thread leaves
 * the simulator main loop spinning. */
extern void nsi_exit(int exit_code);

int main(void) {
    LOG_INF("logging-smoke-zephyr-native-sim starting");

    /* Pin the nros-log dispatcher's `init` as a linker root and
     * install the default sink list. Phase 88.16.H. */
    rclc_log_init();

    rclc_logger_t logger = rclc_log_default_logger();

    RCLC_LOG_TRACE(logger, "trace payload");
    RCLC_LOG_DEBUG(logger, "debug payload");
    RCLC_LOG_INFO(logger,  "info payload");

    /* phase-479 W6 (RFC-0102) — one CHILD logger. A child of the catch-all is
     * a TOP-LEVEL name, so take a named parent first: the record must reach
     * Zephyr's LOG under the dotted name `smoke.child`. */
    rclc_logger_t child = rclc_logger_get_child(rclc_log_get_logger("smoke"), "child");
    if (child != NULL) {
        RCLC_LOG_INFO(child, "child payload");
    } else {
        RCLC_LOG_ERROR(logger, "rclc_logger_get_child failed");
    }

    RCLC_LOG_WARN(logger,  "warn payload");
    RCLC_LOG_ERROR(logger, "error payload");
    RCLC_LOG_FATAL(logger, "fatal payload");

    /* Give Zephyr's deferred LOG mode a chance to flush. */
    k_sleep(K_MSEC(100));

    /* `LOG_MODE_IMMEDIATE=y` makes records synchronous, but exit
     * with a small delay anyway for harness drain robustness. */
    nsi_exit(0);
    return 0;
}
```
