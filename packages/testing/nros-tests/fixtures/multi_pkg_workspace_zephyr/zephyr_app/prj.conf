## CMakeLists.txt
```
# Phase 212.H.1 fixture — Zephyr app that drives the adapter shim.
#
# Build:
#   west build -b native_sim/native/64 -d build \
#     packages/testing/nros-tests/fixtures/multi_pkg_workspace_zephyr/zephyr_app \
#     -- -DCONF_FILE="prj.conf;prj-zenoh.conf"
#
# The shim (`nros_system_generate(<bringup>)`) is exported by the
# nano-ros Zephyr module (`zephyr/cmake/nros_system_generate.cmake`,
# auto-included). Resolves the sibling `demo_bringup/` (Path A bringup
# pkg) and bakes its system.toml into ${CMAKE_BINARY_DIR}/nros-system/.

cmake_minimum_required(VERSION 3.20.0)

find_package(Zephyr REQUIRED HINTS $ENV{ZEPHYR_BASE})
project(nros_phase212_h1_fixture)

# Single-line consumer surface. The bringup pkg lives one level up
# (sibling to zephyr_app/). The shim resolves "demo_bringup" against
# ${CMAKE_CURRENT_SOURCE_DIR}/.. automatically.
nros_system_generate(demo_bringup)

# Issue 0154 — post-258 the shim bakes config only (no generated TU); Zephyr
# requires `app` to own a source, and this stub main consumes the baked header.
target_sources(app PRIVATE src/main.c)
```

## prj.conf
```kconfig
# Phase 212.H.1 fixture — minimal Zephyr config (matches examples/zephyr base).
CONFIG_LOG=y
CONFIG_LOG_DEFAULT_LEVEL=3
CONFIG_PRINTK=y
CONFIG_EARLY_CONSOLE=y

CONFIG_NETWORKING=y
CONFIG_NET_IPV4=y
CONFIG_NET_UDP=y
CONFIG_NET_TCP=y
CONFIG_NET_SOCKETS=y
CONFIG_NET_L2_ETHERNET=y
CONFIG_NET_MAX_CONTEXTS=16

CONFIG_SYS_CLOCK_TICKS_PER_SEC=1000

CONFIG_NROS=y
CONFIG_NROS_C_API=y

# RMW selected at the command line via prj-zenoh.conf overlay.
```

## prj-cyclonedds.conf
```kconfig
# phase-206 W2 fixture — CycloneDDS RMW overlay.
#
# The sibling `prj-zenoh.conf` selects zenoh and this one selects Cyclone,
# against the SAME bringup. That pairing is the point: `demo_bringup/rmw/`
# holds `cyclonedds.xml` and no `zenoh.conf`, so the zenoh image bakes
# nothing and the Cyclone image bakes the XML -- the active backend decides
# which file is read, with no second declaration naming it (RFC-0087's
# "derived from convention").
#
# `CONFIG_CPP` is not optional decoration: `NROS_RMW_CYCLONEDDS` reads
# `depends on NET_SOCKETS && POSIX_API && CPP` (zephyr/Kconfig:68), and an
# unmet dependency does not fail -- Kconfig silently leaves the choice on its
# default and the image builds ZENOH while every conf file says Cyclone. The
# first draft of this file omitted it and produced exactly that: rc=0, a green
# build, zenoh-pico TUs in the log and `rmw=zenoh` in the bake line.
CONFIG_NROS_RMW_CYCLONEDDS=y
CONFIG_CPP=y

# RTPS uses UDP multicast for SPDP discovery.
CONFIG_NET_IPV4_IGMP=y
CONFIG_POSIX_API=y

# Cyclone draws several locks per reader/writer/proxy and Zephyr's pools are
# per-OBJECT, so the defaults are a cap on workload size, not a tuning knob
# (issues 0371/0496).
CONFIG_MAX_PTHREAD_MUTEX_COUNT=2048
CONFIG_MAX_PTHREAD_COND_COUNT=1024
CONFIG_POSIX_THREAD_THREADS_MAX=16

# Resource sizing — Cyclone is heavy. Matched to the working native_sim
# Cyclone overlays under examples/zephyr/.
CONFIG_MAIN_STACK_SIZE=524288
CONFIG_HEAP_MEM_POOL_SIZE=4194304
CONFIG_SYSTEM_WORKQUEUE_STACK_SIZE=8192
# Issue 1633 -- no COMMON_LIBC_MALLOC_ARENA_SIZE here: ddsrt allocates from the
# nros heap (CONFIG_NROS_ZEPHYR_HEAP_SIZE, 1 MiB with Cyclone) since the Zephyr
# road compiles the platform funnel, and the module's Cyclone default for the
# libc arena (256 KiB) covers what still uses it.
CONFIG_DYNAMIC_THREAD_STACK_SIZE=32768

CONFIG_NET_PKT_RX_COUNT=64
CONFIG_NET_PKT_TX_COUNT=64
CONFIG_NET_BUF_RX_COUNT=128
CONFIG_NET_BUF_TX_COUNT=128

# NET_TCP -- Cyclone's sockwaitset self-pipe (loopback TCP socket pair).
CONFIG_NET_TCP=y
# NSOS (host sockets) is board `zephyr`'s `nros-nsos` snippet (issue 2157).

# Issue 1674 — Cyclone's receive thread select()s over a socket waitset of
# four fds here (self-pipe + three UDP sockets, measured on native_sim), and
# Zephyr's select refuses any set larger than this cap with ENOMEM — the image
# then delivers nothing and floods its console. Zephyr's default is 3. The
# module's Kconfig defaults it to 8 for Cyclone too; it is ALSO stated here
# because a Kconfig default never reaches an existing build dir (Zephyr reloads
# the old .config while the merged fragments are unchanged), and a fragment
# change does.
CONFIG_NET_SOCKETS_POLL_MAX=8
```

## prj-zenoh.conf
```kconfig
# Phase 212.H.1 fixture — zenoh RMW overlay.
CONFIG_NROS_RMW_ZENOH=y
CONFIG_POSIX_API=y
# 64, not 32 — the build derives a floor and refuses below it; see
# `_nros_mutex_floor` in `zephyr/cmake/nros_cargo_build.cmake`.
CONFIG_MAX_PTHREAD_MUTEX_COUNT=64
CONFIG_MAX_PTHREAD_COND_COUNT=16
CONFIG_POSIX_THREAD_THREADS_MAX=16
# CONFIG_MAIN_STACK_SIZE: the nano-ros module decides it per image (issue 2365)
CONFIG_HEAP_MEM_POOL_SIZE=65536
```

## src/main.c
```c
/* Phase 212.H.1 adapter-shim fixture main (issue 0154).
 *
 * Pre-258 this app had NO sources: `nros_system_generate()` attached the
 * baked `system_main.c` (extern `nros_component_*_register` decls + a
 * spin loop). Phase-258 retired that TU with the install seam, so the
 * shim now bakes CONFIG only (`system_config.h` / `system_config.cmake`)
 * — and Zephyr requires `app` to own at least one source. This stub is
 * that source: it proves the adapter-shim contract end to end by
 * compiling against the baked header and printing its values at boot
 * (the e2e asserts boot output, not runtime pub/sub — the fixture's
 * component pkgs are stubs).
 */
#include <zephyr/kernel.h>

#include "system_config.h"

int main(void)
{
	printk("nros adapter shim: rmw=%s domain=%u components=%d\n",
	       NROS_SYSTEM_RMW, (unsigned)NROS_SYSTEM_DOMAIN_ID,
	       NROS_SYSTEM_COMPONENT_COUNT);
	return 0;
}
```
