## CMakeLists.txt
```
cmake_minimum_required(VERSION 3.20)
# phase-292 W3.a — minimal Zephyr app importing the S32Z270-DC RTU0
# Cortex-R52 board crate via `nano_ros_use_board()`. Sibling of
# `board_import_fvp` (Phase 215.E.1): ZERO board-specific glue beyond the
# single include + call — BOARD id / prj.conf / per-board Kconfig + DTS
# overlay / default RMW (cyclonedds) all flow from
# `packages/boards/nros-board-s32z270dc2-r52/board.cmake`. This is the
# import surface the ASI `zephyr-s32z` platform consumes (ASI phase-3
# W4.a), replacing its hand-glued EXTRA_DTC_OVERLAY wiring.
include($ENV{NROS_REPO_DIR}/zephyr/cmake/nano_ros_use_board.cmake)
nano_ros_use_board(s32z270dc2-r52)
find_package(Zephyr REQUIRED HINTS $ENV{ZEPHYR_BASE})
project(board_import_s32z LANGUAGES C)
target_sources(app PRIVATE src/main.c)
```

## prj.conf
```kconfig
# phase-292 W3.a — near-empty on purpose: BOARD id / base config / per-board
# fragment + overlay / default RMW all flow from the board crate
# (nros-board-s32z270dc2-r52) via nano_ros_use_board(). The ONE thing a
# consumer must add is its language surface — this crate's base prj.conf is
# deliberately language-neutral (the phase-292 W1.a lesson: the ASI consumer
# is C++, the in-tree talker smoke is Rust; a board must not pick for them).
# This fixture is a C app.
CONFIG_NROS_C_API=y
```

## src/main.c
```c
/* phase-292 W3.a fixture (s32z sibling of Phase 215.E.1): trivial smoke. */
#include <stdio.h>
#include <zephyr/kernel.h>
int main(void) {
    printk("nros: smoke ok\n");
    return 0;
}
```
