## CMakeLists.txt
```
# SPDX-License-Identifier: Apache-2.0
# phase-282 W2 (#145) — Zephyr streaming tx benchmark.
#
# A tight-loop zpico publisher (stress-zenoh talker semantics) on
# native_sim, used to measure the Zephyr zsock tx ceiling across the
# ZPICO_TX_BATCH / Z_FEATURE_TX_SPLIT_LOCK knobs. The native
# `nros-bench/stress-zenoh` listener is the counting/validating sink.
# See README.md for the build + measurement procedure.

cmake_minimum_required(VERSION 3.20.0)

find_package(Zephyr REQUIRED HINTS $ENV{ZEPHYR_BASE})
project(stress_zenoh_zephyr)

# Benchmark shape knobs (cache vars so `west build -- -DSTRESS_*` works).
set(STRESS_COUNT 5000 CACHE STRING "number of publishes")
set(STRESS_SIZE 64 CACHE STRING "payload bytes (>=16)")
set(STRESS_EXPRESS 0 CACHE STRING "1 = declare the publisher express (bypass batching)")
set(STRESS_INTERVAL_MS 0 CACHE STRING "per-publish pacing, ms (0 = tight loop)")

target_sources(app PRIVATE src/main.c)
target_compile_definitions(app PRIVATE
    STRESS_COUNT=${STRESS_COUNT}
    STRESS_SIZE=${STRESS_SIZE}
    STRESS_EXPRESS=${STRESS_EXPRESS}
    STRESS_INTERVAL_MS=${STRESS_INTERVAL_MS})
```

## prj.conf
```kconfig
# phase-282 W2 (#145) — Zephyr streaming tx benchmark (zpico direct, no Rust).
# Zenoh RMW module (compiles zpico.c + zenoh-pico into the image).
CONFIG_NROS=y
CONFIG_NROS_RMW_ZENOH=y

# Networking base (mirrors the zephyr examples' prj.conf net section).
CONFIG_NETWORKING=y
CONFIG_NET_IPV4=y
CONFIG_NET_UDP=y
CONFIG_NET_SOCKETS=y
CONFIG_NET_L2_ETHERNET=y
CONFIG_NET_MAX_CONTEXTS=16

# zenoh-pico needs TCP + POSIX threads/mutexes (see ws-realtime prj-zenoh.conf).
CONFIG_NET_TCP=y
CONFIG_POSIX_API=y
# 64, not 32 — the build derives a floor and refuses below it; see
# `_nros_mutex_floor` in `zephyr/cmake/nros_cargo_build.cmake`.
CONFIG_MAX_PTHREAD_MUTEX_COUNT=64
CONFIG_MAX_PTHREAD_COND_COUNT=16
CONFIG_POSIX_THREAD_THREADS_MAX=16

# CONFIG_MAIN_STACK_SIZE: the nano-ros module decides it per image (issue 2365)
CONFIG_HEAP_MEM_POOL_SIZE=262144
CONFIG_COMMON_LIBC_MALLOC_ARENA_SIZE=1048576
CONFIG_SYSTEM_WORKQUEUE_STACK_SIZE=4096

CONFIG_NET_PKT_RX_COUNT=32
CONFIG_NET_PKT_TX_COUNT=32
CONFIG_NET_BUF_RX_COUNT=64
CONFIG_NET_BUF_TX_COUNT=64

# Wall-clock-true timing on native_sim (the benchmark reports elapsed_ms).
CONFIG_NATIVE_SIM_SLOWDOWN_TO_REAL_TIME=y
```

## src/main.c
```c
/* phase-282 W2 (#145) — Zephyr streaming tx benchmark.
 *
 * Tight-loop publisher over the zpico C shim (the exact tx path every
 * nano-ros language front-end uses), bypassing the executor so the number
 * isolates the TRANSPORT tx path. Publishes STRESS_COUNT payloads of
 * STRESS_SIZE bytes as fast as the loop allows, then reports
 * `PUBLISH_DONE: sent=<n> elapsed_ms=<t>` — the same summary the native
 * `nros-bench/stress-zenoh` talker prints, so measurement procedures match.
 *
 * Payload layout mirrors stress-zenoh's build_payload() so the native
 * stress listener validates integrity:
 *   [0..4]  CDR header 00 01 00 00
 *   [4..8]  sequence number (u32 LE)
 *   [8..12] total size (u32 LE)
 *   [12..]  fill pattern (i & 0xFF)
 *
 * Keyexpr matches the listener's typed Int32 subscription on /stress_test
 * at domain 0 (Humble keyexpr format, TypeHashNotSupported segment).
 */

#include <stdint.h>
#include <string.h>
#include <zephyr/kernel.h>
#include <zephyr/sys/printk.h>

#include "zpico.h"

#ifndef STRESS_COUNT
#define STRESS_COUNT 5000
#endif
#ifndef STRESS_SIZE
#define STRESS_SIZE 64
#endif
/* Issue 1131 — `g_payload[STRESS_SIZE]` is a fixed array AND `build_payload()`
 * writes indices 0..11 (CDR header, seq, size) with no bounds test, so anything
 * under 12 is an out-of-bounds write on a static object, not a smaller payload.
 * 16 is the floor the CMake cache entry has always documented (`payload bytes
 * (>=16)`); the fill loop starts at 12, so below it the bench also measures a
 * payload the stress listener cannot validate. Below the `#ifndef`, never above
 * it: an undefined identifier reads as 0 in `#if` (issue 1167). */
#if STRESS_SIZE < 16
#error "STRESS_SIZE must be >= 16: build_payload() writes 12 header bytes (issue 1015)"
#endif
#ifndef STRESS_EXPRESS
#define STRESS_EXPRESS 0
#endif
#ifndef STRESS_INTERVAL_MS
#define STRESS_INTERVAL_MS 0
#endif

#define STRESS_KEYEXPR "0/stress_test/std_msgs::msg::dds_::Int32_/TypeHashNotSupported"

static uint8_t g_payload[STRESS_SIZE];

static void build_payload(uint32_t seq) {
    g_payload[0] = 0x00;
    g_payload[1] = 0x01;
    g_payload[2] = 0x00;
    g_payload[3] = 0x00;
    g_payload[4] = (uint8_t)(seq & 0xFF);
    g_payload[5] = (uint8_t)((seq >> 8) & 0xFF);
    g_payload[6] = (uint8_t)((seq >> 16) & 0xFF);
    g_payload[7] = (uint8_t)((seq >> 24) & 0xFF);
    uint32_t size = STRESS_SIZE;
    g_payload[8] = (uint8_t)(size & 0xFF);
    g_payload[9] = (uint8_t)((size >> 8) & 0xFF);
    g_payload[10] = (uint8_t)((size >> 16) & 0xFF);
    g_payload[11] = (uint8_t)((size >> 24) & 0xFF);
    for (uint32_t i = 12; i < STRESS_SIZE; i++) {
        g_payload[i] = (uint8_t)((i - 12) & 0xFF);
    }
}

int main(void) {
    printk("stress-zenoh-zephyr: locator=%s count=%d size=%d\n", CONFIG_NROS_ZENOH_LOCATOR,
           STRESS_COUNT, STRESS_SIZE);

    /* phase-328 (issue 0348) — the zpico C API is handle-passing; acquire one
     * pool slot for this single-session stress image. */
    zpico_session_t* s = zpico_session_acquire();
    if (s == NULL) {
        printk("STRESS_FAIL: session pool full\n");
        return 1;
    }

    /* Session open with retry: the router may come up after the image. */
    int32_t rc = -1;
    for (int attempt = 0; attempt < 40; attempt++) {
        rc = zpico_init(s, CONFIG_NROS_ZENOH_LOCATOR);
        if (rc == 0) {
            rc = zpico_open(s);
            if (rc == 0) {
                break;
            }
        }
        k_sleep(K_MSEC(500));
    }
    if (rc != 0) {
        printk("STRESS_FAIL: session open rc=%d\n", rc);
        return 1;
    }
    printk("session open\n");

    /* Phase 282 W3 (#145) — STRESS_EXPRESS=1 declares the publisher express:
     * its samples bypass tx batching (wire EXPRESS flag) even in a batching
     * image, so per-message latency is not flush-cadence-quantized. RELIABLE,
     * like every ROS-default publisher (issue 2001). */
    int32_t handle = zpico_declare_publisher_ex(s, STRESS_KEYEXPR, STRESS_EXPRESS, 1);
    if (handle < 0) {
        printk("STRESS_FAIL: declare rc=%d\n", handle);
        return 1;
    }

    /* Let discovery settle so the (already running) subscriber matches. */
    k_sleep(K_SECONDS(2));
    printk("Publishing...\n");

    int64_t t0 = k_uptime_get();
    for (uint32_t seq = 0; seq < STRESS_COUNT; seq++) {
        build_payload(seq);
        (void)zpico_publish(s, handle, g_payload, STRESS_SIZE);
#if STRESS_INTERVAL_MS > 0
        k_sleep(K_MSEC(STRESS_INTERVAL_MS));
#endif
    }
    int64_t elapsed = k_uptime_get() - t0;
    printk("PUBLISH_DONE: sent=%d elapsed_ms=%lld\n", STRESS_COUNT, elapsed);

    /* Drain: give the flush thread / lease keepalives time to ship any
     * batched remainder before closing (close also flushes). */
    k_sleep(K_SECONDS(3));
    zpico_close(s);
    zpico_session_release(s);
    printk("STRESS_EXIT\n");
    return 0;
}
```
