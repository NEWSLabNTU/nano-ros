// Generated by `nros new` from the `action-server` template (C executable).
// Edit freely: this file is yours now.

/// @file main.c
/// @brief C action server example - Fibonacci action with feedback

#include <stdio.h>
#include <stdlib.h>
#include <string.h>
#include <signal.h>
#include <stdbool.h>

// The C API at rcl/rclc's include paths
#include <rclc/action_server.h>
#include <rclc/executor.h>
#include <rclc/init.h>
#include <rclc/node.h>

// Generated C bindings for example_interfaces/action/Fibonacci
#include "example_interfaces.h"

// ----------------------------------------------------------------------------
// Application state
// ----------------------------------------------------------------------------

// rclc's model: each incoming goal takes one of GOAL_HANDLES goal handles, and
// its request is deserialised into the matching element of `goal_requests`.
// The goal callback only DECIDES; the work runs in the main loop below, between
// spins, which is where rclc's own examples run it (they use a thread).
#define GOAL_HANDLES 2

typedef struct {
    int goal_count;
    // Accepted goals the main loop has not executed yet.
    rclc_action_goal_handle_t* pending[GOAL_HANDLES];
    size_t pending_count;
} server_context_t;

static struct {
    rclc_support_t support;
    rcl_node_t node;
    rclc_action_server_t action_server;
    rclc_executor_t executor;
    example_interfaces__action__Fibonacci_SendGoal_Request goal_requests[GOAL_HANDLES];
    server_context_t ctx;
} app;

static volatile sig_atomic_t g_running = 1;

// ----------------------------------------------------------------------------
// Signal handler for graceful shutdown
// ----------------------------------------------------------------------------

static void signal_handler(int signum) {
    (void)signum;
    g_running = 0;
}

// ----------------------------------------------------------------------------
// Action callbacks
// ----------------------------------------------------------------------------

static rcl_ret_t goal_callback(rclc_action_goal_handle_t* goal_handle, void* context) {
    server_context_t* ctx = (server_context_t*)context;
    const example_interfaces__action__Fibonacci_SendGoal_Request* req =
        (const example_interfaces__action__Fibonacci_SendGoal_Request*)
            goal_handle->ros_goal_request;

    printf("Received goal request with order %d\n", req->goal.order);

    // Reject negative orders or orders too large
    if (req->goal.order < 0 || req->goal.order >= 64) {
        printf("Goal rejected: order out of range\n");
        return RCL_RET_ACTION_GOAL_REJECTED;
    }
    if (ctx->pending_count >= GOAL_HANDLES) {
        return RCL_RET_ACTION_GOAL_REJECTED;
    }
    ctx->pending[ctx->pending_count++] = goal_handle;
    return RCL_RET_ACTION_GOAL_ACCEPTED;
}

static bool cancel_callback(rclc_action_goal_handle_t* goal_handle, void* context) {
    (void)context;
    printf("Cancel request for goal (uuid=%02x%02x...)\n", goal_handle->goal_id.uuid[0],
           goal_handle->goal_id.uuid[1]);
    return true;
}

// Compute the sequence the client asked for, publishing each step as feedback,
// then send the result. Runs between spins, never inside a callback.
static void execute_goal(server_context_t* ctx, rclc_action_goal_handle_t* goal_handle) {
    const example_interfaces__action__Fibonacci_SendGoal_Request* req =
        (const example_interfaces__action__Fibonacci_SendGoal_Request*)
            goal_handle->ros_goal_request;
    int32_t order = req->goal.order;
    ctx->goal_count++;

    printf("Executing goal\n");

    example_interfaces__action__Fibonacci_FeedbackMessage feedback;
    example_interfaces__action__Fibonacci_Feedback__Storage fb_storage;
    example_interfaces__action__Fibonacci_Feedback__init_in(&feedback.feedback, &fb_storage);
    example_interfaces__action__Fibonacci_Feedback* fb = &feedback.feedback;

    for (int32_t i = 0; i <= order; i++) {
        if (goal_handle->goal_cancelled) {
            break;
        }
        int32_t val;
        if (i == 0) {
            val = 0;
        } else if (i == 1) {
            val = 1;
        } else {
            val = fb->sequence.data[i - 1] + fb->sequence.data[i - 2];
        }
        fb->sequence.data[i] = val;
        fb->sequence.size = (uint32_t)(i + 1);

        // rclc_action_publish_feedback writes the goal id into the message.
        rcl_ret_t ret = rclc_action_publish_feedback(goal_handle, &feedback);
        if (ret != RCL_RET_OK) {
            fprintf(stderr, "Failed to publish feedback: %d\n", ret);
        } else {
            printf("Publish feedback\n");
        }
    }

    // Send result — copy the feedback sequence to the result.
    example_interfaces__action__Fibonacci_GetResult_Response response;
    example_interfaces__action__Fibonacci_Result__Storage result_storage;
    example_interfaces__action__Fibonacci_Result__init_in(&response.result, &result_storage);
    response.result.sequence.size = fb->sequence.size;
    memcpy(response.result.sequence.data, fb->sequence.data, fb->sequence.size * sizeof(int32_t));

    rcl_action_goal_state_t status =
        goal_handle->goal_cancelled ? GOAL_STATE_CANCELED : GOAL_STATE_SUCCEEDED;
    rcl_ret_t ret = rclc_action_send_result(goal_handle, status, &response);
    if (ret != RCL_RET_OK) {
        fprintf(stderr, "Failed to send result: %d\n", ret);
    } else if (status == GOAL_STATE_SUCCEEDED) {
        printf("Goal succeeded\n");
    } else {
        printf("Goal canceled\n");
    }
}

// ----------------------------------------------------------------------------
// Main
// ----------------------------------------------------------------------------

int main(int argc, char** argv) {
    (void)argc;
    (void)argv;

#ifdef _IOLBF /* absent on the bare-metal riscv64-threadx libc */
    setvbuf(stdout, NULL, _IOLBF, 0);
#endif

    printf("nros C Action Server (Fibonacci)\n");
    printf("===================================\n");

    // Zero-initialize all static state
    memset(&app, 0, sizeof(app));

    rcl_allocator_t allocator = rcl_get_default_allocator();
    RCLC_CHECK_RET(rclc_support_init(&app.support, argc, argv, &allocator), 1);
    printf("Support initialized\n");
    RCLC_CHECK_RET(rclc_node_init_default(&app.node, "@NODE@", "/", &app.support),
                   1);
    printf("Node created: %s\n", rcl_node_get_name(&app.node));

    RCLC_CHECK_RET(rclc_action_server_init_default(
                       &app.action_server, &app.node, &app.support,
                       ROSIDL_GET_ACTION_TYPE_SUPPORT(example_interfaces, action, Fibonacci),
                       "/fibonacci"),
                   1);
    printf("Action server created: /fibonacci\n");

    RCLC_CHECK_RET(rclc_executor_init(&app.executor, &app.support.context, 8, NULL), 1);
    RCLC_CHECK_RET(rclc_executor_add_action_server(&app.executor, &app.action_server, GOAL_HANDLES,
                                                   app.goal_requests, sizeof(app.goal_requests[0]),
                                                   goal_callback, cancel_callback, &app.ctx),
                   1);

    // Set up signal handler
    signal(SIGINT, signal_handler);
    signal(SIGTERM, signal_handler);

    printf("\nWaiting for action goals (Ctrl+C to exit)...\n\n");

    // Spin for up to 100 ms, then run whatever goals the spin accepted.
    while (g_running) {
        rcl_ret_t ret = rclc_executor_spin_some(&app.executor, 100000000ULL);
        if (ret != RCL_RET_OK && ret != RCL_RET_TIMEOUT && g_running) {
            fprintf(stderr, "Executor spin failed: %d\n", ret);
            break;
        }
        for (size_t i = 0; i < app.ctx.pending_count; i++) {
            execute_goal(&app.ctx, app.ctx.pending[i]);
        }
        app.ctx.pending_count = 0;
    }

    // Cleanup
    printf("\nShutting down...\n");
    printf("Total goals handled: %d\n", app.ctx.goal_count);
    rclc_executor_fini(&app.executor);
    rclc_action_server_fini(&app.action_server, &app.node);
    rcl_node_fini(&app.node);
    rclc_support_fini(&app.support);

    printf("Goodbye!\n");
    return 0;
}
