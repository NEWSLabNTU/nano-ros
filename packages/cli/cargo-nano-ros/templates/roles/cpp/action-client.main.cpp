// Generated by `nros new` from the `action-client` template (C++ executable).
// Edit freely: this file is yours now.

/// @file main.cpp
/// @brief C++ action client example - Fibonacci (blocking)

#include <stdio.h>
// <stdlib.h> (not <cstdlib>): newlib on the embedded cross toolchains does
// not inject strtoll/getenv into namespace std — the global C spellings are
// the portable ones (this source builds native AND on the RTOS boards).
#include <stdlib.h>

#define RCLCPP_TRY_LOG(file, line, expr, ret)                                                      \
    fprintf(stderr, "[nros] %s:%d %s -> %d\n", (file), (line), (expr), (int)(ret))

#include <rclcpp/rclcpp.hpp>

// Generated C++ bindings for example_interfaces/action/Fibonacci
#include "example_interfaces.hpp"

// ----------------------------------------------------------------------------
// Main
// ----------------------------------------------------------------------------

int main(int argc, char** argv) {
#ifdef _IOLBF /* absent on the bare-metal riscv64-threadx libc */
    setvbuf(stdout, nullptr, _IOLBF, 0);
#endif
    printf("nros C++ Action Client (Fibonacci)\n");
    printf("===================================\n");

    // Reads `$NROS_LOCATOR` / `$ROS_DOMAIN_ID` / `$RMW_IMPLEMENTATION` and
    // honours `--ros-args`; launch content arrives through the build.
    RCLCPP_TRY_RET(rclcpp::init_in(argc, argv), 1);

    rclcpp::Node node;
    RCLCPP_TRY_RET(rclcpp::create_node(node, "@NODE@"), 1);
    printf("Node created: %s\n", node.get_name());

    rclcpp_action::Client<example_interfaces::action::Fibonacci> client;
    RCLCPP_TRY_RET(node.create_action_client(client, "/fibonacci"), 1);
    rclcpp::Result ret;

    int32_t order = 10;
    ret = client.wait_for_action_server(10000);
    const bool blind = ret.code() == rclcpp::ErrorCode::Unsupported;
    if (!ret.ok() && ret.code() != rclcpp::ErrorCode::Unsupported) {
        fprintf(stderr, "Action server did not appear within 10s (ret=%d)\n", ret.raw());
        rclcpp::shutdown();
        return 2;
    }

    printf("\nSending goal\n");

    example_interfaces::action::Fibonacci::Goal goal;
    goal.order = order;

    uint8_t goal_id[16];
    for (int attempt = 0;; ++attempt) {
        ret = client.send_goal(goal, goal_id);
        if (ret.code() != rclcpp::ErrorCode::Timeout || !blind || attempt >= 2) {
            break;
        }
        printf("No goal response; sending the goal again\n");
    }
    if (!ret.ok()) {
        if (ret.code() == rclcpp::ErrorCode::Rejected) {
            fprintf(stderr, "Goal was rejected by server (order=%d)\n", order);
        } else if (ret.code() == rclcpp::ErrorCode::Timeout) {
            fprintf(stderr,
                    "No goal response from server (order=%d, ret=%d) — the goal may never "
                    "have been received\n",
                    order, ret.raw());
        } else {
            fprintf(stderr, "Failed to send goal (order=%d, ret=%d)\n", order, ret.raw());
        }
        rclcpp::shutdown();
        return 2;
    }

    printf("Goal accepted by server, waiting for result\n");

    // Poll for feedback while waiting — drain via the Stream<T> API,
    // which aligns the feedback receive surface with
    // Subscription<M>::stream() / Promise<T>::wait(). `try_recv_feedback`
    // below is still supported for callers that want the bool-convertible
    // helper.
    auto& feedback = client.feedback_stream();
    for (int i = 0; i < 20; i++) {
        rclcpp::spin_once(100);

        example_interfaces::action::Fibonacci::Feedback fb;
        while (feedback.try_next(fb).ok()) {
            printf("Next number in sequence received: [");
            for (uint32_t k = 0; k < fb.sequence.length(); k++) {
                if (k > 0) printf(", ");
                printf("%d", fb.sequence[k]);
            }
            printf("]\n");
        }
    }

    // Get result (blocking)
    example_interfaces::action::Fibonacci::Result result;
    ret = client.get_result(goal_id, result);
    if (ret.ok()) {
        printf("Result received: [");
        for (uint32_t i = 0; i < result.sequence.length(); i++) {
            if (i > 0) printf(", ");
            printf("%d", result.sequence[i]);
        }
        printf("]\n");
    } else {
        fprintf(stderr, "Failed to get result: %d\n", ret.raw());
        rclcpp::shutdown();
        return 1;
    }

    // Cleanup
    printf("\nShutting down...\n");
    rclcpp::shutdown();

    printf("Goodbye!\n");
    return 0;
}
