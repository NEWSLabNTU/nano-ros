// nros-cpp: Action server class
// Freestanding C++ — no exceptions, no STL required

/**
 * @file action_server.hpp
 * @ingroup grp_action
 * @brief `rclcpp_action::Server<A>` — typed action server.
 */

#ifndef NROS_RCLCPP_ACTION_SERVER_HPP
#define NROS_RCLCPP_ACTION_SERVER_HPP

#include <cstdint>
#include <cstddef>
#include <string.h>

#include "rclcpp/detail/callback_context.hpp" // phase-456 W3's one-word context carrier
#include "rclcpp/detail/config.hpp"
#include "rclcpp/detail/entity_name.hpp" // phase-444 — the one entity-name copy
#include "rclcpp/owned.hpp"              // issue 2015 — `Server<A>::SharedPtr`
#include "rclcpp/result.hpp"
#include "rclcpp_action/detail/upstream.hpp" // issue 2015 — hosted goal-handle plumbing
// issue 0964 — the feedback/result TX buffers below size through
// `detail::buffer_bounds`, so this header needs it directly rather than by
// luck through a transitive include.
#include "rclcpp/size_bound.hpp"

// Phase 118.D — most action_server FFI symbols come from
// `nros_cpp_ffi.h`; cbindgen renders Rust `*const [u8; 16]` as
// pointer-to-array (`const uint8_t (*goal_id)[16]`), so callsites
// below `reinterpret_cast` from the array-decay shape used in C++
// member-function signatures.
//
// `nros_cpp_action_server_set_callbacks` is excluded from cbindgen
// output (its Rust signature uses `Option<extern "C" fn(...)>`,
// which cbindgen renders as opaque structs). Declare locally below
// with plain function-pointer typedefs that match the actual ABI.
#include "rclcpp/detail/nros_cpp_ffi.h"

extern "C" {
typedef int32_t (*nros_cpp_goal_callback_t)(const uint8_t goal_id[16], const uint8_t* data,
                                            size_t len, void* ctx);
typedef int32_t (*nros_cpp_cancel_callback_t)(const uint8_t goal_id[16], void* ctx);
/* Issue 0796 — post-accept hook. Excluded from cbindgen for the same reason as
 * the two above (`Option<extern "C" fn>` renders as an opaque struct), so this
 * declaration is MIRRORED in `rclc/component.h` as well; `just check c`'s
 * cross-include TU is the gate that catches a half-updated mirror. */
typedef void (*nros_cpp_accepted_callback_t)(const uint8_t goal_id[16], void* ctx);

nros_cpp_ret_t nros_cpp_action_server_set_callbacks(void* handle, nros_cpp_goal_callback_t goal_cb,
                                                    nros_cpp_cancel_callback_t cancel_cb,
                                                    void* ctx);
nros_cpp_ret_t
nros_cpp_action_server_set_accepted_callback(void* handle, nros_cpp_accepted_callback_t accepted_cb,
                                             void* ctx);
} // extern "C"

namespace rclcpp {
namespace detail {

// Issue 1913 — the hash each of an action's five endpoints is keyed on. An
// Iron+ peer keys every endpoint on its own type, so the one `Goal::TYPE_HASH`
// these entry points used to pass matched none of them. Generated action types
// carry the five as `<Endpoint>_HASH` members; a type generated by an older
// `nros` does not, and gets all-NULL, which the runtime reads as "use the type
// hash" (the old behaviour). C++14, so detection is spelled by hand.
template <class...> struct nros_void_ {
    typedef void type;
};

template <class A, class = void> struct action_endpoint_hashes_of {
    static nros_cpp_action_hashes_t get() {
        nros_cpp_action_hashes_t h = {nullptr, nullptr, nullptr, nullptr, nullptr};
        return h;
    }
};

template <class A>
struct action_endpoint_hashes_of<A,
                                 typename nros_void_<decltype(A::SEND_GOAL_SERVICE_HASH)>::type> {
    static nros_cpp_action_hashes_t get() {
        nros_cpp_action_hashes_t h = {A::SEND_GOAL_SERVICE_HASH, A::CANCEL_GOAL_SERVICE_HASH,
                                      A::GET_RESULT_SERVICE_HASH, A::FEEDBACK_MESSAGE_HASH,
                                      A::STATUS_MESSAGE_HASH};
        return h;
    }
};

template <class A> inline nros_cpp_action_hashes_t action_endpoint_hashes() {
    return action_endpoint_hashes_of<A>::get();
}

} // namespace detail
} // namespace rclcpp

// phase-483 W1: the goal vocabulary lives in `rclcpp_action::`, where upstream
// keeps it. It was `nros::` until then, and `rclcpp_action::` re-exported two
// of the five names.
namespace rclcpp_action {

/// Value type for a goal identifier — the 16 bytes ROS 2 carries as
/// `unique_identifier_msgs/msg/UUID`.
///
/// Phase-417 W4.b. Every action signature here spelled the goal id
/// `const uint8_t goal_id[16]`, which DECAYS to a pointer: it cannot be
/// compared with `==`, cannot be returned by value, and cannot be stored in a
/// container. `rclcpp_action::GoalUUID` is a `std::array<uint8_t, 16>` and is
/// a map key in most real action servers, so the array-decay spelling is a
/// drop-in BLOCKER rather than a style difference.
///
/// C has had `rclc_goal_uuid_t` (`rclc/detail/nros_generated.h`) and Rust
/// `nros_core::GoalId` all along; C++ was the odd one out. This is a value
/// type over the SAME 16 bytes, not a second identity scheme: standard
/// layout, trivially copyable, `sizeof == 16`, no allocator, no call into
/// anything — so it reaches every target the freestanding headers do.
///
/// Generation is deliberately NOT here. C's `rclc_goal_uuid_generate` draws
/// randomness, which is behaviour, and RFC-0019 keeps behaviour Rust-side; the
/// goal id a server sees is the one the FFI hands it.
///
/// The raw `const uint8_t[16]` overloads are kept beside every `GoalUUID` one:
/// the FFI trampolines hand callbacks a `const uint8_t[16]`, and in-tree
/// examples spell it that way in their own callback signatures. The
/// converting constructor is `explicit` so a raw-array call site still selects
/// the raw-array overload rather than silently converting.
struct GoalUUID {
    /// Byte count — `unique_identifier_msgs/UUID` is a fixed `uint8[16]`.
    static const size_t SIZE = 16;

    /// UUID bytes, in wire order.
    uint8_t uuid[16];

    /// The zero ("null") goal id — mirrors `nros_core::GoalId::zero()`.
    GoalUUID() : uuid{} {}

    /// Copy the 16 bytes at `src`, which must point to at least that many.
    explicit GoalUUID(const uint8_t* src) : uuid{} {
        for (size_t i = 0; i < SIZE; ++i) {
            uuid[i] = src[i];
        }
    }

    /// Pointer to the 16 bytes — what the raw-array overloads and the FFI take.
    uint8_t* data() { return uuid; }
    const uint8_t* data() const { return uuid; }

    /// True when every byte is zero — mirrors `nros_core::GoalId::is_zero()`.
    bool is_zero() const {
        for (size_t i = 0; i < SIZE; ++i) {
            if (uuid[i] != 0) return false;
        }
        return true;
    }

    bool operator==(const GoalUUID& other) const {
        for (size_t i = 0; i < SIZE; ++i) {
            if (uuid[i] != other.uuid[i]) return false;
        }
        return true;
    }

    bool operator!=(const GoalUUID& other) const { return !(*this == other); }

    /// Lexicographic order over the 16 bytes, so `GoalUUID` is usable as a
    /// `std::map` key — the shape `rclcpp_action::GoalUUID` gets for free by
    /// being a `std::array`. The ordering carries no meaning beyond that.
    bool operator<(const GoalUUID& other) const {
        for (size_t i = 0; i < SIZE; ++i) {
            if (uuid[i] != other.uuid[i]) return uuid[i] < other.uuid[i];
        }
        return false;
    }
};

static_assert(sizeof(GoalUUID) == 16,
              "rclcpp_action::GoalUUID must be exactly the 16 bytes the FFI passes as uint8_t[16]");
static_assert(alignof(GoalUUID) == alignof(uint8_t),
              "rclcpp_action::GoalUUID must not add alignment over its uint8_t[16]");

/// Bound on the action name an action entity remembers for
/// `get_action_name()` — phase-417 W4.b.
///
/// ONE spelling for all four action classes. `PollingActionServer` and
/// `PollingActionClient` each defined their own `ACTION_NAME_MAX = 256` and
/// the two callback tiers had neither, which is how the accessor came to
/// exist on half the C++ action surface (ledger rows
/// `c:action_{client,server}_get_action_name`, "four surfaces, one
/// accessor"). Sized to match `rclcpp::SUBSCRIPTION_TOPIC_NAME_MAX` and the C
/// surface's `MAX_ACTION_NAME_LEN`, so a name that fits one entity fits all
/// of them and a truncation is not a per-class surprise.
static const size_t ACTION_NAME_MAX = 256;

/// Goal acceptance response returned from the user's goal callback.
///
/// Upstream's enum, value for value: `rclcpp_action::GoalResponse` is
/// `int8_t` with `REJECT = 1, ACCEPT_AND_EXECUTE = 2, ACCEPT_AND_DEFER = 3`,
/// and so is this one, enumerator for enumerator, so a ported `switch` or a
/// stored integer means the same thing on both. (Until issue 1637 these were
/// 0-based and CamelCase: `Reject = 0`, `AcceptAndExecute = 1`, ...)
///
/// The FFI below is 0-based (`RCLC_C_GOAL_REJECT = 0` in `component.h`),
/// because a zero-initialised decision slot must mean reject. That integer
/// is not this enum: convert with `rclcpp_action::to_ffi(GoalResponse)`, NEVER with a
/// `static_cast<int32_t>` — the cast yields upstream's value, and the FFI
/// reads `REJECT` (1) as accept-and-execute.
enum class GoalResponse : int8_t {
    REJECT = 1,
    ACCEPT_AND_EXECUTE = 2,
    ACCEPT_AND_DEFER = 3,
};

/// Per-goal cancel decision returned from the user's cancel callback.
///
/// Issue 0796 — this is NOT the `action_msgs/srv/CancelGoal` RPC status; that
/// is `CancelReturnCode` below. The two carry different meanings on
/// overlapping FFI values (reject and `Ok` are both 0 there), so never cast between
/// them. C names them apart too (`rclc_cancel_response_t` vs
/// `rclc_cancel_return_code_t`), and Rust now does (`nros_core::CancelResponse`
/// vs `nros_core::CancelReturnCode`).
///
/// Upstream's enum, value for value: `rclcpp_action::CancelResponse` is
/// `int8_t` with `REJECT = 1, ACCEPT = 2`, and so is this one (0-based and
/// CamelCase until issue 1637). The FFI is
/// 0-based (`RCLC_C_CANCEL_REJECT = 0`): convert with
/// `rclcpp_action::to_ffi(CancelResponse)`, never with a `static_cast<int32_t>`.
enum class CancelResponse : int8_t {
    REJECT = 1,
    ACCEPT = 2,
};

/// The FFI discriminant of a goal decision — `RCLC_C_GOAL_REJECT` (0),
/// `RCLC_C_GOAL_ACCEPT_AND_EXECUTE` (1), `RCLC_C_GOAL_ACCEPT_AND_DEFER` (2).
/// This is the value a raw component callback (`create_action_server_raw`)
/// returns. Anything outside upstream's three values maps to reject, the
/// FFI's own answer for "nobody decided".
constexpr int32_t to_ffi(GoalResponse r) {
    return (r == GoalResponse::ACCEPT_AND_EXECUTE) ? 1
           : (r == GoalResponse::ACCEPT_AND_DEFER) ? 2
                                                   : 0;
}

/// The FFI discriminant of a cancel decision — `RCLC_C_CANCEL_REJECT` (0),
/// `RCLC_C_CANCEL_ACCEPT` (1). Anything but `ACCEPT` maps to reject.
constexpr int32_t to_ffi(CancelResponse r) {
    return (r == CancelResponse::ACCEPT) ? 1 : 0;
}

/// `action_msgs/srv/CancelGoal` RPC return code — the WHOLE-REQUEST outcome
/// (issue 0796).
///
/// Written by a polling-tier server into `send_cancel_reply`, and read by a
/// client from `ActionClient::try_recv_cancel_response`. Distinct from the
/// per-goal `CancelResponse` above; these four discriminants are the wire
/// contract, fixed by `action_msgs`.
enum class CancelReturnCode : int8_t {
    Ok = 0,
    Rejected = 1,
    UnknownGoal = 2,
    GoalTerminated = 3,
};

/// Mirror of `action_msgs/msg/GoalStatus` — lifecycle state reported by
/// `for_each_active_goal`.
enum class GoalStatus : int8_t {
    Unknown = 0,
    Accepted = 1,
    Executing = 2,
    Canceling = 3,
    Succeeded = 4,
    Canceled = 5,
    Aborted = 6,
};

} // namespace rclcpp_action

/// `rclcpp::Node` is named by the friend declaration below and by the
/// out-of-line `Node::create_*` bodies further down. `rclcpp/node.hpp` (included
/// below, after the class, so a consumer pays only for the entities it uses)
/// has the definition; a qualified friend needs the name to EXIST first, which
/// an unqualified `friend class Node;` used to supply implicitly.
///
/// phase-427 W7 — declared in `rclcpp::`, which is where the definition lives.
namespace rclcpp {
class Node;
}

// ============================================================================
// `rclcpp_action::Server<A>` -- DEFINED here (RFC-0089: rclcpp_action:: is the home)
// ============================================================================
//
// phase-428: the definition moved from `nros::ActionServer<A>` to
// `rclcpp_action::Server<A>` (the `nros::` alias went in phase-483 W1). This one
// is a RENAME as well as a move -- upstream's namespace already says "action",
// so the type is `Server`, not `ActionServer`.
//
// The vocabulary the signatures use (`GoalUUID`, `GoalResponse`,
// `CancelResponse`, `GoalStatus`, `CancelReturnCode`) is declared above, in
// `rclcpp_action::` where upstream keeps it (phase-483 W1; it was `nros::`
// before). `GoalResponse` and `CancelResponse` carry upstream's values since
// issue 1637, so a ported `rclcpp_action::GoalResponse::REJECT` compiles AND
// means what it meant upstream. Before that they were 0-based, and exposing
// them under the upstream name would have turned a compile error into a silent
// renumbering.
namespace rclcpp_action {

template <typename A> class ServerGoalHandle;
namespace detail {
template <typename A> struct ServerUpstream;
} // namespace detail

/// Typed action server for a ROS 2 action.
///
/// Mirrors upstream's `rclcpp_action::Server<A>` with a callback-based API. The
/// action type `A` must provide nested `Goal`, `Result`, and `Feedback`
/// types with `TYPE_NAME`, `TYPE_HASH`, `SERIALIZED_SIZE_MAX`,
/// `ffi_serialize()`, and `ffi_deserialize()`.
///
/// Usage:
/// ```cpp
/// using Fib = example_interfaces::action::Fibonacci;
/// rclcpp_action::Server<Fib> srv;
/// RCLCPP_TRY(node.create_action_server(srv, "/fibonacci"));
///
/// srv.set_goal_callback(
///     [](const uint8_t[16], const Fib::Goal& g) {
///         if (g.order > 46) return rclcpp_action::GoalResponse::REJECT;
///         return rclcpp_action::GoalResponse::ACCEPT_AND_EXECUTE;
///     });
/// ```
///
/// Callbacks must be stateless (empty-capture lambdas or plain function
/// pointers). This is a freestanding C++14 library without `std::function`,
/// so per-instance closure storage is not available.
///
/// What upstream's `Server<A>` has and this one does not (ADOPT-BOUNDED):
/// - Not a `Waitable`: no `execute` / `is_ready` / `set_on_ready_callback` /
///   `clear_on_ready_callback`. RFC-0002's executor drives the server
///   directly through the RMW vtable; there is no wait set to join.
/// - Each missing member is a compile error (`no member named ...`).
///
/// Issue 2015 — on a HOSTED build (`NROS_CPP_STD`) upstream's construction
/// is a drop-in: `rclcpp_action::create_server<A>(node interfaces..., name,
/// handle_goal, handle_cancel, handle_accepted)` returns a `SharedPtr`
/// (`rclcpp::Owned<Server>`, the server by value) and the callbacks take
/// upstream's shapes — `std::shared_ptr<const Goal>` and a
/// `std::shared_ptr<ServerGoalHandle<A>>` whose `publish_feedback` /
/// `succeed` / `abort` / `canceled` / `is_canceling` forward to THIS server,
/// keyed by the goal id. The goals still live in the server's static arena;
/// the handle is a heap token over the id. A freestanding build keeps the
/// goal-id-keyed form below and refuses the handle shapes.
template <typename A> class Server {
  public:
    using GoalType = typename A::Goal;
    using ResultType = typename A::Result;
    using FeedbackType = typename A::Feedback;

    /// Issue 2015 — upstream's `Server<A>::SharedPtr`. Not a `std::shared_ptr`:
    /// `rclcpp::Owned<Server>` holds the server BY VALUE (no allocator), which
    /// is what `rclcpp_action::create_server` returns and what a member
    /// `rclcpp_action::Server<A>::SharedPtr action_server_;` stores.
    using SharedPtr = ::rclcpp::Owned<Server>;
    /// Upstream's `rclcpp_action::ServerGoalHandle<A>` for this action.
    using GoalHandle = ::rclcpp_action::ServerGoalHandle<A>;

    /// User-facing typed goal callback signature.
    using TypedGoalFn = ::rclcpp_action::GoalResponse (*)(const uint8_t uuid[16],
                                                          const GoalType& goal);
    /// User-facing typed goal callback signature with user context (Phase 84.G9).
    using TypedGoalFnWithCtx = ::rclcpp_action::GoalResponse (*)(const uint8_t uuid[16],
                                                                 const GoalType& goal, void* ctx);
    /// User-facing typed cancel callback signature.
    using TypedCancelFn = ::rclcpp_action::CancelResponse (*)(const uint8_t uuid[16]);
    /// User-facing typed cancel callback signature with user context (Phase 84.G9).
    using TypedCancelFnWithCtx = ::rclcpp_action::CancelResponse (*)(const uint8_t uuid[16],
                                                                     void* ctx);
    /// User-facing typed accepted-goal callback signature (issue 0796).
    using TypedAcceptedFn = void (*)(const uint8_t uuid[16]);
    /// User-facing typed accepted-goal callback signature with user context.
    using TypedAcceptedFnWithCtx = void (*)(const uint8_t uuid[16], void* ctx);
    /// User-facing visitor signature for `for_each_active_goal`.
    using TypedVisitorFn = void (*)(const uint8_t uuid[16], ::rclcpp_action::GoalStatus status);

    /// Register a typed goal callback.
    ///
    /// `F` must be a stateless callable that decays to `TypedGoalFn`
    /// (empty-capture lambda or plain function pointer).
    /// F must be a stateless callable convertible to TypedGoalFn
    /// (empty-capture lambda or plain function pointer).
    template <typename F>::rclcpp::Result set_goal_callback(F f) {
        if (!initialized_) return ::rclcpp::Result(::rclcpp::ErrorCode::NotInitialized);
        user_goal_fn_ = TypedGoalFn(f); // compile error if F is not convertible
        user_goal_fn_ctx_ = nullptr;    // mutually exclusive with _with_ctx
        user_goal_ctx_ = nullptr;
        return install_callbacks();
    }

    /// Register a typed goal callback with a user context pointer.
    ///
    /// The bare function pointer is stored alongside a `void*` that is
    /// forwarded to every invocation — lets callers reach stateful
    /// objects without capturing lambdas or file-scope globals. Overrides
    /// and is overridden by `set_goal_callback()` (the two modes are
    /// mutually exclusive).
    ::rclcpp::Result set_goal_callback_with_ctx(TypedGoalFnWithCtx f, void* ctx) {
        if (!initialized_) return ::rclcpp::Result(::rclcpp::ErrorCode::NotInitialized);
        user_goal_fn_ctx_ = f;
        user_goal_ctx_ = ctx;
        user_goal_fn_ = nullptr;
        return install_callbacks();
    }

    /// Register a cancel callback.
    ///
    /// F must be a stateless callable convertible to TypedCancelFn.
    template <typename F>::rclcpp::Result set_cancel_callback(F f) {
        if (!initialized_) return ::rclcpp::Result(::rclcpp::ErrorCode::NotInitialized);
        user_cancel_fn_ = TypedCancelFn(f); // compile error if F is not convertible
        user_cancel_fn_ctx_ = nullptr;      // mutually exclusive with _with_ctx
        user_cancel_ctx_ = nullptr;
        return install_callbacks();
    }

    /// Register a cancel callback with a user context pointer.
    ///
    /// Mirrors `set_goal_callback_with_ctx` — the bare function pointer
    /// receives a `void*` alongside each UUID so stateful cancel policies
    /// don't need captured lambdas or global state. Mutually exclusive
    /// with `set_cancel_callback()`.
    ::rclcpp::Result set_cancel_callback_with_ctx(TypedCancelFnWithCtx f, void* ctx) {
        if (!initialized_) return ::rclcpp::Result(::rclcpp::ErrorCode::NotInitialized);
        user_cancel_fn_ctx_ = f;
        user_cancel_ctx_ = ctx;
        user_cancel_fn_ = nullptr;
        return install_callbacks();
    }

    /// Register a callback invoked once per ACCEPTED goal (issue 0796).
    ///
    /// Fires after the accept reply has reached the client, for
    /// `GoalResponse::ACCEPT_AND_EXECUTE` and `GoalResponse::ACCEPT_AND_DEFER`
    /// alike. This is where a deferred goal starts executing: the goal
    /// callback answers accept/reject and must return promptly, so it is the
    /// wrong place to begin work.
    ///
    /// Upstream's `handle_accepted` receives an owning
    /// `std::shared_ptr<ServerGoalHandle>`; this callback receives the 16-byte goal id
    /// instead, and the goal is driven through this server (`publish_feedback`,
    /// `succeed`, ...) because goals live in the server's static arena.
    ///
    /// Mirrors C's `rclc_accepted_callback_t` (passed at
    /// `rclc_action_server_init_with_callbacks`) and Rust's third argument to
    /// `create_action_server_with_callbacks(goal, cancel, accepted)`. Without
    /// it a C++ user who returned ACCEPT_AND_DEFER was never told the goal had
    /// been accepted.
    ///
    /// F must be a stateless callable convertible to TypedAcceptedFn.
    template <typename F>::rclcpp::Result set_accepted_callback(F f) {
        if (!initialized_) return ::rclcpp::Result(::rclcpp::ErrorCode::NotInitialized);
        user_accepted_fn_ = TypedAcceptedFn(f); // compile error if F is not convertible
        user_accepted_fn_ctx_ = nullptr;        // mutually exclusive with _with_ctx
        user_accepted_ctx_ = nullptr;
        return install_callbacks();
    }

    /// Register an accepted-goal callback with a user context pointer.
    ///
    /// Mirrors `set_goal_callback_with_ctx`. Mutually exclusive with
    /// `set_accepted_callback()`.
    ::rclcpp::Result set_accepted_callback_with_ctx(TypedAcceptedFnWithCtx f, void* ctx) {
        if (!initialized_) return ::rclcpp::Result(::rclcpp::ErrorCode::NotInitialized);
        user_accepted_fn_ctx_ = f;
        user_accepted_ctx_ = ctx;
        user_accepted_fn_ = nullptr;
        return install_callbacks();
    }

    /// Publish feedback for an active goal.
    ///
    /// Upstream spells it `goal_handle->publish_feedback(std::shared_ptr<Feedback>)`.
    /// There is no goal handle here: the call is on the SERVER, keyed by goal id,
    /// and takes the feedback by const reference (no `shared_ptr`, no allocator).
    ///
    /// @param goal_id  16-byte goal UUID from the goal callback.
    /// @param feedback Feedback to publish.
    /// @return Result indicating success or failure.
    ::rclcpp::Result publish_feedback(const uint8_t goal_id[16], const FeedbackType& feedback) {
        if (!initialized_) return ::rclcpp::Result(::rclcpp::ErrorCode::NotInitialized);

        uint8_t buf[::rclcpp::detail::buffer_bounds<FeedbackType>::tx];
        size_t len = 0;
        if (FeedbackType::ffi_serialize(&feedback, buf, sizeof(buf), &len) != 0) {
            return ::rclcpp::Result(::rclcpp::ErrorCode::Error);
        }
        return ::rclcpp::Result(nros_cpp_action_server_publish_feedback(
            storage_, executor_, reinterpret_cast<const uint8_t(*)[16]>(goal_id), buf, len));
    }

    /// Terminate a goal with a result and the status it terminated in.
    ///
    /// Issue 0796 — `status` used to be hardcoded `Succeeded` inside the shim,
    /// so a server that aborted a goal reported success to the client. The
    /// parameter order matches `PollingActionServer::complete_goal` and the C
    /// API's `rclc_polling_action_server_complete_goal_raw`, so the three surfaces
    /// agree; `Succeeded` is defaulted because it is the common case and
    /// because that keeps existing two-argument calls compiling.
    ///
    /// rclcpp_action has no `complete_goal`: a goal ends through its
    /// `ServerGoalHandle` (`succeed` / `abort` / `canceled`). Here the terminal
    /// status is an argument and the goal is named by its id, because there is no
    /// goal handle; `succeed` / `abort` / `canceled` below are forwarders onto this.
    ::rclcpp::Result complete_goal(const uint8_t goal_id[16], ::rclcpp_action::GoalStatus status,
                                   const ResultType& result) {
        if (!initialized_) return ::rclcpp::Result(::rclcpp::ErrorCode::NotInitialized);

        uint8_t buf[::rclcpp::detail::buffer_bounds<ResultType>::tx];
        size_t len = 0;
        if (ResultType::ffi_serialize(&result, buf, sizeof(buf), &len) != 0) {
            return ::rclcpp::Result(::rclcpp::ErrorCode::Error);
        }
        return ::rclcpp::Result(nros_cpp_action_server_complete_goal(
            storage_, executor_, reinterpret_cast<const uint8_t(*)[16]>(goal_id),
            static_cast<int32_t>(status), buf, len));
    }

    /// Terminate a goal as SUCCEEDED. Equivalent to
    /// `complete_goal(goal_id, GoalStatus::Succeeded, result)`.
    ::rclcpp::Result complete_goal(const uint8_t goal_id[16], const ResultType& result) {
        return complete_goal(goal_id, ::rclcpp_action::GoalStatus::Succeeded, result);
    }

    /// @ref publish_feedback taking a `GoalUUID` value (phase-417 W4.b).
    ::rclcpp::Result publish_feedback(const ::rclcpp_action::GoalUUID& goal_id,
                                      const FeedbackType& feedback) {
        return publish_feedback(goal_id.data(), feedback);
    }

    /// @ref complete_goal taking a `GoalUUID` value (phase-417 W4.b).
    ::rclcpp::Result complete_goal(const ::rclcpp_action::GoalUUID& goal_id,
                                   ::rclcpp_action::GoalStatus status, const ResultType& result) {
        return complete_goal(goal_id.data(), status, result);
    }

    /// @ref complete_goal taking a `GoalUUID` value (phase-417 W4.b).
    ::rclcpp::Result complete_goal(const ::rclcpp_action::GoalUUID& goal_id,
                                   const ResultType& result) {
        return complete_goal(goal_id.data(), ::rclcpp_action::GoalStatus::Succeeded, result);
    }

    /// Start EXECUTING the accepted goal `goal_id` — issue 2027.
    ///
    /// Moves the goal from ACCEPTED to EXECUTING and publishes the status
    /// array: upstream's `goal_handle->execute()`, keyed by goal id, and C's
    /// `rclc_action_execute`. A goal the goal callback answered
    /// `GoalResponse::ACCEPT_AND_DEFER` starts this way, from the accepted
    /// callback or later. `NotFound` for a goal this server no longer holds,
    /// `NotAllowed` for one that is not ACCEPTED (already executing,
    /// canceling, or terminal), where upstream raises; nothing is changed or
    /// published then.
    ///
    /// The goal-id API leaves a goal ACCEPTED after `ACCEPT_AND_EXECUTE` (the
    /// status the Rust core records on accept); `create_server`'s upstream
    /// binding executes it for you before `handle_accepted`, as upstream does.
    ::rclcpp::Result execute(const uint8_t goal_id[16]) {
        if (!initialized_) return ::rclcpp::Result(::rclcpp::ErrorCode::NotInitialized);
        return ::rclcpp::Result(nros_cpp_action_server_execute(
            storage_, executor_, reinterpret_cast<const uint8_t(*)[16]>(goal_id)));
    }

    /// @ref execute taking a `GoalUUID` value.
    ::rclcpp::Result execute(const ::rclcpp_action::GoalUUID& goal_id) {
        return execute(goal_id.data());
    }

    /// Terminate `goal_id` as SUCCEEDED — phase-417 W4.b.
    ///
    /// C has `rclc_action_succeed` / `_abort` / `_canceled`, Rust has
    /// `ActionServerHandle::succeed` / `abort` / `canceled`, and every
    /// rclcpp_action server ends with `goal_handle->succeed(result)`. C++ had
    /// only `complete_goal`, so the terminal line of a ported server was one
    /// nobody could keep. These three are FORWARDERS onto `complete_goal`:
    /// the goal state machine stays Rust-side (RFC-0019), and no state is
    /// added here.
    ///
    /// `complete_goal` remains the general form for a status computed at
    /// runtime.
    ///
    /// Upstream's is `goal_handle->succeed(std::shared_ptr<Result>)`. Ours is on
    /// the server, keyed by goal id, result by const reference: there is no goal
    /// handle and no `shared_ptr` (goals live in the server's static arena).
    ::rclcpp::Result succeed(const uint8_t goal_id[16], const ResultType& result) {
        return complete_goal(goal_id, ::rclcpp_action::GoalStatus::Succeeded, result);
    }

    /// Terminate `goal_id` as ABORTED. See @ref succeed.
    ///
    /// Upstream's is `goal_handle->abort(std::shared_ptr<Result>)`; this is on the
    /// server, keyed by goal id, result by const reference — no goal handle.
    ::rclcpp::Result abort(const uint8_t goal_id[16], const ResultType& result) {
        return complete_goal(goal_id, ::rclcpp_action::GoalStatus::Aborted, result);
    }

    /// Terminate `goal_id` as CANCELED. See @ref succeed.
    ///
    /// Spelled `canceled` — rclcpp_action's and C's spelling — not `cancel`.
    /// Rust used to disagree here and was renamed to match in the same work
    /// item.
    ///
    /// Upstream's is `goal_handle->canceled(std::shared_ptr<Result>)`; this is on the
    /// server, keyed by goal id, result by const reference — no goal handle.
    ::rclcpp::Result canceled(const uint8_t goal_id[16], const ResultType& result) {
        return complete_goal(goal_id, ::rclcpp_action::GoalStatus::Canceled, result);
    }

    /// @ref succeed taking a `GoalUUID` value.
    ::rclcpp::Result succeed(const ::rclcpp_action::GoalUUID& goal_id, const ResultType& result) {
        return complete_goal(goal_id.data(), ::rclcpp_action::GoalStatus::Succeeded, result);
    }

    /// @ref abort taking a `GoalUUID` value.
    ::rclcpp::Result abort(const ::rclcpp_action::GoalUUID& goal_id, const ResultType& result) {
        return complete_goal(goal_id.data(), ::rclcpp_action::GoalStatus::Aborted, result);
    }

    /// @ref canceled taking a `GoalUUID` value.
    ::rclcpp::Result canceled(const ::rclcpp_action::GoalUUID& goal_id, const ResultType& result) {
        return complete_goal(goal_id.data(), ::rclcpp_action::GoalStatus::Canceled, result);
    }

    /// Iterate over every currently live goal and invoke `f(uuid, status)`.
    ///
    /// `F` must be a stateless callable convertible to
    /// `void (*)(const uint8_t uuid[16], GoalStatus status)`. The arena
    /// never stores the original goal CDR payload, so only identity +
    /// status are forwarded — if you need the goal bytes, stash them in
    /// a `{uuid → state}` table from inside `set_goal_callback`.
    /// F must be a stateless callable convertible to void(*)(const uint8_t[16], GoalStatus).
    /// phase-456 W3b — the visitor rides the `void* ctx` this FFI already has,
    /// carried by value through `rclcpp::detail::fn_to_context`, instead of a
    /// `TypedVisitorFn user_visitor_fn_` member set on entry and cleared on
    /// exit. That member was the only piece of per-instance state on this class
    /// that was `nullptr` everywhere except inside one function body, and the
    /// move constructor and move assignment each copied it — bookkeeping for a
    /// value known to be null at every point a move can observe it.
    ///
    /// The lifetime argument is stronger here than the one W3 made for a
    /// service handler: this FFI call is SYNCHRONOUS, so the context does not
    /// outlive the full-expression that built it. Nothing of the caller's is
    /// referenced after the call returns, which is also why the visitor needs
    /// no clearing step — there is nowhere for it to be left behind.
    template <typename F>::rclcpp::Result for_each_active_goal(F f) {
        if (!initialized_) return ::rclcpp::Result(::rclcpp::ErrorCode::NotInitialized);
        TypedVisitorFn visitor = TypedVisitorFn(f); // compile error if F is not convertible

        auto trampoline = [](const uint8_t goal_id[16], int8_t status, void* ctx) {
            TypedVisitorFn fn = ::rclcpp::detail::fn_from_context<TypedVisitorFn>(ctx);
            if (fn == nullptr) return;
            fn(goal_id, static_cast<::rclcpp_action::GoalStatus>(status));
        };
        return ::rclcpp::Result(nros_cpp_action_server_for_each_active_goal(
            storage_, executor_,
            reinterpret_cast<void (*)(const uint8_t(*)[16], int8_t, void*)>(+trampoline),
            ::rclcpp::detail::fn_to_context(visitor)));
    }

    /// Read back the action name this server was created on — phase-417 W4.b.
    ///
    /// The callback tier's half of "four surfaces, one accessor" (ledger row
    /// `c:action_server_get_action_name`): `PollingActionServer` and
    /// `PollingActionClient` have had `get_action_name()` all along, C now has
    /// `rcl_action_server_get_action_name`, and this tier — the one a ported
    /// `rclcpp_action` program uses — had a `char action_name_[256]` field
    /// populated at construction and read by nothing.
    ///
    /// The field is back, and it is now READ. The earlier removal was right
    /// about dead state and the note it left ("if an accessor is wanted, it
    /// belongs on an FFI getter over the name the runtime already owns") does
    /// not apply: the runtime does NOT own it here. `CppActionServer` keeps a
    /// raw arena handle and `nros_cpp_action_server_create` takes
    /// `_action_name` and drops it, so there is nothing FFI-side to hand back.
    /// `Subscription::get_topic_name` pays the same 256 bytes for the same
    /// reason, and a borrowed `const char*` was rejected — `create_action_server`
    /// takes a `const char*` that a hosted caller may well have obtained from a
    /// temporary.
    ///
    /// Returns `""` (never NULL) on an uninitialised server, matching
    /// `Subscription::get_topic_name` and the two polling tiers.
    const char* get_action_name() const { return initialized_ ? action_name_ : ""; }

    /// Is `goal_id` a goal this server still knows about? — phase-417 W4.b.
    ///
    /// rcl's `rcl_action_server_goal_exists`, and C's
    /// `rclc_action_server_goal_exists`. TRUE while the goal is ACTIVE and
    /// while its completed result is still retained for a later `get_result`,
    /// which is rcl's own window. A predicate rather than a `Result`, because
    /// the ported idiom is a guard.
    bool goal_exists(const uint8_t goal_id[16]) const {
        if (!initialized_) return false;
        return nros_cpp_action_server_goal_exists(storage_, executor_,
                                                  reinterpret_cast<const uint8_t(*)[16]>(goal_id));
    }

    /// @ref goal_exists taking a `GoalUUID` value.
    bool goal_exists(const ::rclcpp_action::GoalUUID& goal_id) const {
        return goal_exists(goal_id.data());
    }

    /// Check if the action server is initialized and valid.
    bool is_valid() const { return initialized_; }

    /// Destructor — RELEASES the arena entry (issue 1496).
    ///
    /// The action's five RMW entities (three service servers, the feedback and
    /// status publishers), its goal table and its result slab live in an
    /// `ActionServerRawArenaEntry` in the executor arena, and the entry's
    /// callback `context` is `storage_`. `nros_cpp_action_server_detach` drops
    /// that entry in place — the entities are destroyed, so the action leaves
    /// the graph and no late `send_goal` can dispatch into this storage — frees
    /// its callback slot, and returns its arena bytes to the executor's free
    /// list for the next registration that fits. A program that creates and
    /// destroys servers in a loop therefore does not exhaust
    /// `NROS_EXECUTOR_MAX_CBS` or the arena. (`nros_cpp_action_server_destroy`
    /// after it is a `drop_in_place` over `Copy` fields and runs no destructor
    /// itself; the release is the detach call's.)
    ~Server() {
        if (initialized_) {
            nros_cpp_action_server_detach(storage_, executor_);
            nros_cpp_action_server_destroy(storage_);
            initialized_ = false;
        }
    }

    // Move semantics (non-copyable). Relocation goes through the
    // `nros_cpp_action_server_relocate` runtime call (Phase 84.C1); then
    // `nros_cpp_action_server_retarget` re-points the executor's arena entry
    // (whose callback context is the STORAGE address) at the new storage —
    // issue 2015: without it a moved server dispatched through the moved-from
    // bytes — and `install_callbacks()` re-registers the goal/cancel
    // trampolines with the new `this` as THEIR context.
    Server(Server&& other)
        : executor_(other.executor_), user_goal_fn_(other.user_goal_fn_),
          user_goal_fn_ctx_(other.user_goal_fn_ctx_), user_goal_ctx_(other.user_goal_ctx_),
          user_cancel_fn_(other.user_cancel_fn_), user_cancel_fn_ctx_(other.user_cancel_fn_ctx_),
          user_cancel_ctx_(other.user_cancel_ctx_), user_accepted_fn_(other.user_accepted_fn_),
          user_accepted_fn_ctx_(other.user_accepted_fn_ctx_),
          user_accepted_ctx_(other.user_accepted_ctx_), action_name_{},
          initialized_(other.initialized_),
          upstream_(static_cast<detail::HostedBox&&>(other.upstream_)) {
        ::memcpy(action_name_, other.action_name_, sizeof(action_name_));
        if (other.initialized_) {
            nros_cpp_action_server_relocate(other.storage_, storage_);
            // issue 2015 — the arena entry follows the storage.
            (void)nros_cpp_action_server_retarget(storage_, executor_);
            other.initialized_ = false;
            (void)install_callbacks();
        }
        detail::ServerUpstream<A>::rehome(*this);
    }

    Server& operator=(Server&& other) {
        if (this != &other) {
            if (initialized_) {
                // issue 1496 — same pairing as `~Server()`: release the arena
                // entry this storage owns before the storage is overwritten by
                // the relocate below.
                nros_cpp_action_server_detach(storage_, executor_);
                nros_cpp_action_server_destroy(storage_);
            }
            executor_ = other.executor_;
            user_goal_fn_ = other.user_goal_fn_;
            user_goal_fn_ctx_ = other.user_goal_fn_ctx_;
            user_goal_ctx_ = other.user_goal_ctx_;
            user_cancel_fn_ = other.user_cancel_fn_;
            user_cancel_fn_ctx_ = other.user_cancel_fn_ctx_;
            user_cancel_ctx_ = other.user_cancel_ctx_;
            user_accepted_fn_ = other.user_accepted_fn_;
            user_accepted_fn_ctx_ = other.user_accepted_fn_ctx_;
            user_accepted_ctx_ = other.user_accepted_ctx_;
            ::memcpy(action_name_, other.action_name_, sizeof(action_name_));
            initialized_ = other.initialized_;
            upstream_ = static_cast<detail::HostedBox&&>(other.upstream_);
            if (other.initialized_) {
                nros_cpp_action_server_relocate(other.storage_, storage_);
                // issue 2015 — the arena entry follows the storage.
                (void)nros_cpp_action_server_retarget(storage_, executor_);
                other.initialized_ = false;
                (void)install_callbacks();
            }
            detail::ServerUpstream<A>::rehome(*this);
        }
        return *this;
    }

    /// Default constructor — creates an uninitialized action server.
    /// Use `Node::create_action_server()` to initialize.
    Server()
        : executor_(nullptr), user_goal_fn_(nullptr), user_goal_fn_ctx_(nullptr),
          user_goal_ctx_(nullptr), user_cancel_fn_(nullptr), user_cancel_fn_ctx_(nullptr),
          user_cancel_ctx_(nullptr), user_accepted_fn_(nullptr), user_accepted_fn_ctx_(nullptr),
          user_accepted_ctx_(nullptr), action_name_{}, initialized_(false) {}

  private:
    Server(const Server&) = delete;
    Server& operator=(const Server&) = delete;

    friend class ::rclcpp::Node;
    // Issue 2015 — the hosted goal handle asks this server for its goal's
    // status, and `create_server` binds upstream's callbacks onto it.
    friend class ::rclcpp_action::ServerGoalHandle<A>;
    friend struct detail::ServerUpstream<A>;

    /// The status of `goal_id` if the server still tracks it as active.
    bool goal_status(const uint8_t goal_id[16], int8_t& out) {
        if (!initialized_) return false;
        struct Query {
            const uint8_t* id;
            int8_t status;
            bool found;
        } q = {goal_id, 0, false};
        auto visit = [](const uint8_t(*id)[16], int8_t status, void* ctx) {
            Query* qq = static_cast<Query*>(ctx);
            if (::memcmp(*id, qq->id, 16) == 0) {
                qq->status = status;
                qq->found = true;
            }
        };
        if (nros_cpp_action_server_for_each_active_goal(storage_, executor_, +visit, &q) != 0)
            return false;
        out = q.status;
        return q.found;
    }

    // ── C trampolines ───────────────────────────────────────────────
    //
    // `ctx` is a pointer to this `ActionServer<A>` instance, so the
    // trampoline reads the user's stored function pointer via the
    // instance's own fields — no shared mutable statics.

    static int32_t goal_trampoline(const uint8_t goal_id[16], const uint8_t* data, size_t len,
                                   void* ctx) {
        auto* self = static_cast<Server*>(ctx);
        if (!self) return ::rclcpp_action::to_ffi(::rclcpp_action::GoalResponse::REJECT);
        GoalType g;
        if (GoalType::ffi_deserialize(data, len, &g) != 0) {
            return ::rclcpp_action::to_ffi(::rclcpp_action::GoalResponse::REJECT);
        }
        if (self->user_goal_fn_ctx_ != nullptr) {
            return ::rclcpp_action::to_ffi(
                self->user_goal_fn_ctx_(goal_id, g, self->user_goal_ctx_));
        }
        if (self->user_goal_fn_ != nullptr) {
            return ::rclcpp_action::to_ffi(self->user_goal_fn_(goal_id, g));
        }
        return ::rclcpp_action::to_ffi(::rclcpp_action::GoalResponse::REJECT);
    }

    static int32_t cancel_trampoline(const uint8_t goal_id[16], void* ctx) {
        auto* self = static_cast<Server*>(ctx);
        if (!self) return ::rclcpp_action::to_ffi(::rclcpp_action::CancelResponse::ACCEPT);
        if (self->user_cancel_fn_ctx_ != nullptr) {
            return ::rclcpp_action::to_ffi(
                self->user_cancel_fn_ctx_(goal_id, self->user_cancel_ctx_));
        }
        if (self->user_cancel_fn_ != nullptr) {
            return ::rclcpp_action::to_ffi(self->user_cancel_fn_(goal_id));
        }
        return ::rclcpp_action::to_ffi(::rclcpp_action::CancelResponse::ACCEPT);
    }

    static void accepted_trampoline(const uint8_t goal_id[16], void* ctx) {
        auto* self = static_cast<Server*>(ctx);
        if (!self) return;
        if (self->user_accepted_fn_ctx_ != nullptr) {
            self->user_accepted_fn_ctx_(goal_id, self->user_accepted_ctx_);
            return;
        }
        if (self->user_accepted_fn_ != nullptr) {
            self->user_accepted_fn_(goal_id);
        }
    }

    ::rclcpp::Result install_callbacks() {
        bool goal_set = (user_goal_fn_ != nullptr) || (user_goal_fn_ctx_ != nullptr);
        bool cancel_set = (user_cancel_fn_ != nullptr) || (user_cancel_fn_ctx_ != nullptr);
        bool accepted_set = (user_accepted_fn_ != nullptr) || (user_accepted_fn_ctx_ != nullptr);
        nros_cpp_goal_callback_t gcb = goal_set ? &goal_trampoline : nullptr;
        nros_cpp_cancel_callback_t ccb = cancel_set ? &cancel_trampoline : nullptr;
        nros_cpp_ret_t ret = nros_cpp_action_server_set_callbacks(storage_, gcb, ccb, this);
        if (ret != 0) return ::rclcpp::Result(ret);
        // Issue 0796 — a SECOND install call rather than a fourth parameter on
        // the first: `nros_cpp_action_server_set_callbacks` is declared in
        // three places and called directly by C components, so growing it
        // would have broken every one of them. Both calls pass the same
        // `this`, which is the shared context slot the runtime keeps.
        nros_cpp_accepted_callback_t acb = accepted_set ? &accepted_trampoline : nullptr;
        return ::rclcpp::Result(nros_cpp_action_server_set_accepted_callback(storage_, acb, this));
    }

    alignas(8) uint8_t storage_[NROS_CPP_ACTION_SERVER_STORAGE_SIZE];
    void* executor_; // Executor context needed for feedback/result operations
    TypedGoalFn user_goal_fn_;
    TypedGoalFnWithCtx user_goal_fn_ctx_;
    void* user_goal_ctx_;
    TypedCancelFn user_cancel_fn_;
    TypedCancelFnWithCtx user_cancel_fn_ctx_;
    void* user_cancel_ctx_;
    TypedAcceptedFn user_accepted_fn_;
    TypedAcceptedFnWithCtx user_accepted_fn_ctx_;
    void* user_accepted_ctx_;
    // phase-456 W3b — a `TypedVisitorFn user_visitor_fn_` sat here, written at
    // the head of `for_each_active_goal` and cleared at its tail. The visitor
    // travels in the FFI's own `void* ctx` now; see that function.
    // Phase 87.6 put a `char action_name_[256]` here for a `get_action_name()`
    // that was never written, and an earlier phase-417 W4.b wave deleted it as
    // dead state. W4.b's second half writes the accessor, so it is back and it
    // is read — see `get_action_name()` for why the FFI cannot answer instead.
    char action_name_[::rclcpp_action::ACTION_NAME_MAX];
    bool initialized_;
    /// Issue 2015 — upstream's `create_server` callbacks and the live goals'
    /// messages (hosted only; empty and never allocated on a freestanding
    /// build, and the same two pointers wide in both).
    detail::HostedBox upstream_;
};

/// `rclcpp_action::ServerGoalHandle<A>` — issue 2015, upstream's per-goal
/// handle on a HOSTED build.
///
/// A token over `(server, goal id)`, plus the goal message the goal callback
/// was handed: every call forwards to the server keyed by the id, and the
/// goal's state stays in the server's static arena (RFC-0019). Obtained only
/// as the `std::shared_ptr` upstream's `handle_cancel` / `handle_accepted`
/// receive; a freestanding build has no allocator for it, so `SharedPtr` is
/// refused there and the goal-id-keyed `Server<A>` calls are the form.
///
/// Envelope: the handle names its server by address, so the server must not
/// move while a handle is in use (it lives in a `SharedPtr`, which does not
/// move it). Called from the executor's own task only — a goal handle used
/// from a thread the application started races the executor (RFC-0002: no
/// hidden threads, and no lock on a one-level image); run the goal from the
/// accepted callback, or from a timer.
template <typename A> class ServerGoalHandle {
  public:
    using Goal = typename A::Goal;
    using Feedback = typename A::Feedback;
    using Result = typename A::Result;
#ifdef NROS_CPP_HAS_SHARED_PTR // hosted-family: action-interop
    using SharedPtr = ::std::shared_ptr<ServerGoalHandle>;
    using ConstSharedPtr = ::std::shared_ptr<const ServerGoalHandle>;
#else
    using SharedPtr = detail::Refused<ServerGoalHandle>;
    using ConstSharedPtr = detail::Refused<ServerGoalHandle>;
#endif

    ServerGoalHandle(Server<A>* server, const GoalUUID& uuid)
        : server_(server), uuid_(uuid), goal_() {}

    /// The goal's id.
    const GoalUUID& get_goal_id() const { return uuid_; }
    /// The goal is CANCELING: a cancel request for it was accepted.
    bool is_canceling() const { return status() == GoalStatus::Canceling; }
    /// The goal is EXECUTING.
    bool is_executing() const { return status() == GoalStatus::Executing; }
    /// Start EXECUTING this goal — issue 2027, upstream's `execute()`:
    /// ACCEPTED -> EXECUTING, publishing the status array. How a goal
    /// accepted with `GoalResponse::ACCEPT_AND_DEFER` starts (`create_server`
    /// already does it for `ACCEPT_AND_EXECUTE`, before `handle_accepted`).
    /// Upstream raises for a goal that is not ACCEPTED; this changes nothing
    /// then. `Server<A>::execute(goal_id)` reports which case it was.
    void execute() {
        if (server_ != nullptr) (void)server_->execute(uuid_.data());
    }
    /// The goal has not reached a terminal state.
    bool is_active() const {
        const GoalStatus s = status();
        return s == GoalStatus::Accepted || s == GoalStatus::Executing ||
               s == GoalStatus::Canceling;
    }

#ifdef NROS_CPP_HAS_SHARED_PTR // hosted-family: action-interop
    /// The goal message the goal callback was handed.
    ::std::shared_ptr<const Goal> get_goal() const {
        auto* g = goal_.template as<::std::shared_ptr<const Goal>>();
        return g != nullptr ? *g : ::std::shared_ptr<const Goal>();
    }
    /// Publish feedback for this goal (`Server<A>::publish_feedback`).
    void publish_feedback(::std::shared_ptr<Feedback> feedback) {
        if (feedback && server_ != nullptr)
            (void)server_->publish_feedback(uuid_.data(), *feedback);
    }
    /// Terminate this goal as SUCCEEDED (`Server<A>::succeed`).
    void succeed(::std::shared_ptr<Result> result) { terminate(GoalStatus::Succeeded, result); }
    /// Terminate this goal as ABORTED (`Server<A>::abort`).
    void abort(::std::shared_ptr<Result> result) { terminate(GoalStatus::Aborted, result); }
    /// Terminate this goal as CANCELED (`Server<A>::canceled`).
    void canceled(::std::shared_ptr<Result> result) { terminate(GoalStatus::Canceled, result); }
#endif

  private:
    friend struct detail::ServerUpstream<A>;

    GoalStatus status() const {
        int8_t s = 0;
        if (server_ == nullptr || !server_->goal_status(uuid_.data(), s))
            return GoalStatus::Unknown;
        return static_cast<GoalStatus>(s);
    }

#ifdef NROS_CPP_HAS_SHARED_PTR // hosted-family: action-interop
    void terminate(GoalStatus status, const ::std::shared_ptr<Result>& result) {
        if (server_ == nullptr) return;
        const Result empty{};
        (void)server_->complete_goal(uuid_.data(), status, result ? *result : empty);
        detail::ServerUpstream<A>::forget(*server_, uuid_);
    }
#endif

    Server<A>* server_;
    GoalUUID uuid_;
    /// The goal message (a heap `std::shared_ptr<const Goal>`, hosted only).
    detail::HostedBox goal_;
};

namespace detail {

/// Issue 2015 — binds upstream's three `create_server` callbacks onto a
/// `Server<A>` through its existing goal / cancel / accepted slots, and keeps
/// each live goal's message so its handle can answer `get_goal()`. Hosted
/// only; on a freestanding build every member is a no-op and nothing calls
/// `bind`.
template <typename A> struct ServerUpstream {
    using Goal = typename A::Goal;
    using Handle = ServerGoalHandle<A>;

    /// Point the bound state at `s` after a move.
    static void rehome(Server<A>& s) {
#ifdef NROS_CPP_HAS_SHARED_PTR // hosted-family: action-interop
        if (State* st = s.upstream_.template as<State>()) st->server = &s;
#else
        (void)s;
#endif
    }

#ifdef NROS_CPP_HAS_SHARED_PTR // hosted-family: action-interop
    using GoalFn = ::std::function<GoalResponse(const GoalUUID&, ::std::shared_ptr<const Goal>)>;
    using CancelFn = ::std::function<CancelResponse(::std::shared_ptr<Handle>)>;
    using AcceptedFn = ::std::function<void(::std::shared_ptr<Handle>)>;

    struct Entry {
        GoalUUID id;
        ::std::shared_ptr<const Goal> goal;
        /// Issue 2027 — answered ACCEPT_AND_EXECUTE: the server executes it
        /// before `handle_accepted`, as upstream's does.
        bool execute;
    };
    struct State {
        GoalFn goal;
        CancelFn cancel;
        AcceptedFn accepted;
        Server<A>* server;
        ::std::vector<Entry> goals;
    };

    static void destroy(void* p) { delete static_cast<State*>(p); }

    template <typename G, typename C, typename Acc>
    static ::rclcpp::Result bind(Server<A>& s, G&& goal, C&& cancel, Acc&& accepted) {
        State* st = new State{GoalFn(static_cast<G&&>(goal)),
                              CancelFn(static_cast<C&&>(cancel)),
                              AcceptedFn(static_cast<Acc&&>(accepted)),
                              &s,
                              {}};
        s.upstream_.reset(st, &destroy);
        ::rclcpp::Result r = s.set_goal_callback_with_ctx(&on_goal, st);
        if (r.ok()) r = s.set_cancel_callback_with_ctx(&on_cancel, st);
        if (r.ok()) r = s.set_accepted_callback_with_ctx(&on_accepted, st);
        return r;
    }

    /// Drop the kept goal message of a goal that reached a terminal state.
    static void forget(Server<A>& s, const GoalUUID& id) {
        State* st = s.upstream_.template as<State>();
        if (st == nullptr) return;
        for (size_t i = 0; i < st->goals.size(); ++i) {
            if (st->goals[i].id == id) {
                st->goals.erase(st->goals.begin() + static_cast<long>(i));
                return;
            }
        }
    }

  private:
    static ::std::shared_ptr<Handle> make_handle(State* st, const GoalUUID& id) {
        ::std::shared_ptr<Handle> h = ::std::make_shared<Handle>(st->server, id);
        for (const Entry& e : st->goals) {
            if (e.id == id) {
                h->goal_.reset(new ::std::shared_ptr<const Goal>(e.goal), [](void* p) {
                    delete static_cast<::std::shared_ptr<const Goal>*>(p);
                });
                break;
            }
        }
        return h;
    }

    static GoalResponse on_goal(const uint8_t uuid[16], const Goal& goal, void* ctx) {
        State* st = static_cast<State*>(ctx);
        if (!st->goal) return GoalResponse::REJECT;
        const GoalUUID id(uuid);
        ::std::shared_ptr<const Goal> msg = ::std::make_shared<const Goal>(goal);
        const GoalResponse r = st->goal(id, msg);
        if (r != GoalResponse::REJECT) {
            forget(*st->server, id);
            st->goals.push_back(Entry{id, msg, r == GoalResponse::ACCEPT_AND_EXECUTE});
        }
        return r;
    }

    static CancelResponse on_cancel(const uint8_t uuid[16], void* ctx) {
        State* st = static_cast<State*>(ctx);
        if (!st->cancel) return CancelResponse::REJECT;
        return st->cancel(make_handle(st, GoalUUID(uuid)));
    }

    static void on_accepted(const uint8_t uuid[16], void* ctx) {
        State* st = static_cast<State*>(ctx);
        const GoalUUID id(uuid);
        // Issue 2027 — upstream's server calls `execute()` itself for
        // ACCEPT_AND_EXECUTE, so the goal is EXECUTING (and the status array
        // says so) by the time `handle_accepted` sees it; ACCEPT_AND_DEFER
        // stays ACCEPTED until the handle's `execute()`.
        for (const Entry& e : st->goals) {
            if (e.id == id) {
                if (e.execute) (void)st->server->execute(uuid);
                break;
            }
        }
        if (st->accepted) st->accepted(make_handle(st, id));
    }
#endif
};

} // namespace detail

} // namespace rclcpp_action

// Phase 84.G8: out-of-line definition of Node::create_action_server<A>().
#include "rclcpp/node.hpp"

namespace rclcpp {} // namespace rclcpp

namespace rclcpp {
template <typename A>
Result Node::create_action_server(::rclcpp_action::Server<A>& out, const char* action_name,
                                  const ::rclcpp::QoS& qos,
                                  const ::rclcpp::ActionServerOptions& options) {
    if (!initialized_) return Result(::rclcpp::ErrorCode::NotInitialized);
    nros_cpp_qos_t ffi_qos = ::rclcpp::detail::qos_to_ffi(qos);
    nros_cpp_ret_t ret = nros_cpp_action_server_create(&handle_, action_name, A::TYPE_NAME,
                                                       A::Goal::TYPE_HASH, ffi_qos, out.storage_);
    if (ret != 0) return Result(ret);
    // Register with executor — creates transport handles (3 queryables + 2 publishers).
    // Deferred from create to avoid FreeRTOS QEMU deadlocks. Phase 87.6:
    // names are passed at register-time (buffers live on the C++
    // `rclcpp_action::Server<A>` class, not in the runtime struct).
    // Phase 189.M3.3.c — `sched_context` binds the action's (arena-registered)
    // goal-service handle to a scheduling context. UNSET ⇒ 0 (inherit, no-op).
    uint8_t sched = (options.sched_context == ::rclcpp::SCHED_CONTEXT_UNSET)
                        ? 0u
                        : static_cast<uint8_t>(options.sched_context);
    const nros_cpp_action_hashes_t hashes = ::rclcpp::detail::action_endpoint_hashes<A>();
    ret = nros_cpp_action_server_register(out.storage_, executor_handle_, action_name, A::TYPE_NAME,
                                          A::Goal::TYPE_HASH, &hashes, sched);
    if (ret == 0) {
        out.executor_ = executor_handle_;
        // phase-417 W4.b — remember the name for `get_action_name()`. Truncating
        // copy, as `Subscription`'s and the two polling tiers' do: a name longer
        // than `rclcpp_action::ACTION_NAME_MAX` is not a reason to fail a create that the
        // runtime already accepted.
        ::rclcpp::detail::assign_entity_name(out.action_name_, action_name);
        out.initialized_ = true;
    }
    return Result(ret);
}
} // namespace rclcpp

namespace rclcpp {} // namespace rclcpp

#endif // NROS_RCLCPP_ACTION_SERVER_HPP
