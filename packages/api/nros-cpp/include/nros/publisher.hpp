// nros-cpp: Publisher class
// Freestanding C++ — no exceptions, no STL required

/**
 * @file publisher.hpp
 * @ingroup grp_pubsub
 * @brief `nros::Publisher<M>` — typed topic publisher.
 */

#ifndef NROS_CPP_PUBLISHER_HPP
#define NROS_CPP_PUBLISHER_HPP

#include <cstdint>
#include <cstddef>
#include <string.h> // memcpy — `<cstring>` isn't in Zephyr's minimal libcpp

#include "nros/traits.hpp"
#include "nros/config.hpp"
#include "nros/entity_name.hpp" // phase-444 — the one entity-name copy
#include "nros/executor.hpp"    // phase-444 — the graph counter these forward to
#include "nros/owned.hpp" // phase-456 W5 — `Publisher<M>::SharedPtr` IS `Owned<Publisher<M>>`
#include "nros/result.hpp"
// RFC-0088 D5 — NROS_CPP_ASSERT_MESSAGE_FORMAT, expanded in the creator below.
#include "nros/serialization_format.hpp"

#include "nros_cpp_ffi.h"

// issue 1437 — `get_actual_qos()` returns a `nros::QoS` BY VALUE from an
// inline body, so the complete type must be here, not only by the time
// `nros/node.hpp` is pulled in below.
//
// AFTER `nros_cpp_ffi.h`, never before: `qos.hpp` defines the four
// `nros_cpp_qos_*_t` enums ITSELF under `#ifndef NROS_CPP_FFI_H`, so
// reaching it first makes the cbindgen header a REDEFINITION of all four.
#include "nros/qos.hpp"

// phase-456 W5 — THIS HEADER NO LONGER DETECTS ANYTHING, and the include that
// used to sit here is gone with the block it served.
//
// From phase-417 W1.a until now, `Publisher<M>::SharedPtr` and friends were
// `std::shared_ptr` / `std::unique_ptr`, so they needed `<memory>` — which a
// MINIMAL freestanding libcpp does not ship (Zephyr's is `<cstddef>`,
// `<cstdint>`, `<new>`, plus this repo's `zephyr/cxx-compat/`) — and the
// aliases were therefore ABSENT on exactly the targets ported source needs them
// on. The predicate that decided it needed three separate corrections to get
// right (issues 0112, 1187, 1240).
//
// The aliases name `nros::Owned<Publisher<M>>` now, which is ours and exists
// everywhere, so there is no capability left to probe: the alias is present
// unconditionally and means the same thing on every target. That is RFC-0096 D1
// — one API, no shape decided by a toolchain flag — reached by deleting the
// question rather than by answering it more carefully.

namespace nros {

/// Maximum topic name length stored inside a publisher (256).
/// The topic name is owned C++-side, not inside the runtime handle.
///
/// Stays in `nros::`: RFC-0089's flip moves the nine TYPES, and this is an
/// implementation bound of one of them, not a name upstream declares.
static constexpr size_t PUBLISHER_TOPIC_NAME_MAX = 256;

} // namespace nros

/// `rclcpp::Node` is named by the friend declaration below and by the
/// out-of-line `Node::create_*` bodies further down. `nros/node.hpp` (included
/// below, after the class, so a consumer pays only for the entities it uses)
/// has the definition; a qualified friend needs the name to EXIST first, which
/// an unqualified `friend class Node;` used to supply implicitly.
///
/// phase-427 W7 — declared in `rclcpp::`, which is where the definition moved.
/// An elaborated `class Node;` in `nros::` would now declare a SECOND, distinct
/// class and collide with the `rclcpp::Node` alias.
namespace rclcpp {
class Node;
}

// ============================================================================
// `rclcpp::Publisher<M>` -- DEFINED here (RFC-0089: rclcpp:: is the home)
// ============================================================================
//
// phase-428: the definition moved from `nros::` to `rclcpp::` and the alias
// turned around. The nested `SharedPtr` / `ConstSharedPtr` / `UniquePtr`
// aliases live on the class itself, so `rclcpp::Publisher<M>::SharedPtr` -- the
// way rclcpp users index types -- resolves with no wrapper in between.
namespace rclcpp {

/// Typed publisher for a ROS 2 topic.
///
/// Mirrors `rclcpp::Publisher<M>`. The message type `M` must provide
/// `TYPE_NAME`, `TYPE_HASH`, and `ffi_publish()` (generated by codegen).
///
/// Raw CDR publishing is always available via `publish_raw()`.
///
/// Inline storage holds the runtime publisher handle directly
/// (`NROS_PUBLISHER_SIZE` bytes; size auto-derived from the runtime) plus
/// one pointer: the contracted endpoint's monitor cell (phase-462 W1,
/// RFC-0052), which the runtime resolves at create time against the table
/// the entry installed with `nros_cpp_install_monitors` and bumps on every
/// publish, exactly as the Rust `EmbeddedPublisher` does. Null on an
/// uncontracted publisher. Topic name metadata lives C++-side in
/// `topic_name_`, avoiding a runtime hop for `get_topic_name()`.
///
/// WHY THIS ONE IS NOT AN ARENA HANDLE — phase-456 W4
///
/// Every other entity in this API is moving to a two-word handle over the Rust
/// executor arena, because the arena already owns the entity and the C++ object
/// was a second copy of state. A publisher is the exception, decided rather
/// than left over.
///
/// The arena holds only things the executor DISPATCHES to — its `EntryKind` is
/// subscription, service, client, timer, action server, action client, guard
/// condition — and a publisher is none of them. The Rust API says the same by
/// construction: `Node::create_publisher_with_qos` hands back an
/// `EmbeddedPublisher<M>` BY VALUE, a caller-owned value with a `Drop`. So the
/// phase's principle, that entity lifetime is a Rust data structure's, is
/// already satisfied here, and `nros::Owned<Publisher<M>>` mirrors that
/// structure exactly.
///
/// It also could not be moved without losing something. The arena is a bump
/// allocator with no removal path, so an arena publisher could never be
/// destroyed before its executor — `~Publisher()` below and `Owned<T>::reset()`
/// would become no-ops over a live RMW publisher.
///
/// Measured, so the question does not get re-opened on a size argument:
/// `sizeof(Publisher<M>)` is 872 bytes and INDEPENDENT of `M` — identical for a
/// 512-byte-bound string, an 8-byte `Int32` and a 65 552-byte image. It is
/// `storage_` 608 + `topic_name_` 256 + `initialized_` + padding. **Nothing
/// here is a transmit buffer sized from the type's bound**: serialisation goes
/// into the backend's outbound buffer, and `publish_streamed` stages on the
/// stack. That is what separates this type from the 888-byte `Subscription<M>`
/// whose `storage_` went unused on the dispatch path, and from the 4 672-byte
/// `Client<int>` that carried a reply buffer.
///
/// Usage:
/// ```cpp
/// nros::Publisher<std_msgs::msg::String> pub;
/// NROS_TRY(node.create_publisher(pub, "/chatter"));
/// pub.publish_raw(cdr_data, cdr_len);
/// ```
template <typename M> class Publisher {
  public:
    /// `rclcpp::Publisher<M>::SharedPtr` — phase-456 W5.
    ///
    /// `rclcpp::Publisher<M>::SharedPtr member_;` is close to universal in
    /// ported source, so this alias must exist on EVERY target — which
    /// `std::shared_ptr` does not. It names `nros::Owned<Publisher<M>>`: the
    /// publisher BY VALUE, with `operator->` so every ported `pub_->publish(m)`
    /// keeps working, and no allocator, control block or `<memory>` anywhere.
    ///
    /// IT IS NOT AN ARENA HANDLE, and that is a decision rather than an
    /// omission — W4 measured the case and refused it. The executor arena is a
    /// bump allocator with no removal path (`EntryKind` has no publisher at
    /// all), so an arena publisher would turn `~Publisher()` and
    /// `Owned<T>::reset()` into no-ops holding a live RMW publisher for the
    /// executor's lifetime. The Rust side settles it: `create_publisher_with_qos`
    /// returns an `EmbeddedPublisher<M>` BY VALUE, with a `Drop`, and this
    /// phase's principle is that the C++ lifetime mirrors the Rust one.
    /// `owned.hpp` carries the long form.
    ///
    /// WHAT CHANGED FOR A PORTED FILE: one reference, not a shared count. The
    /// entity is destroyed when the holder is, which is what upstream does when
    /// the holder was the last owner — and the W0 census found no entity handle
    /// copied anywhere in this tree or the porting corpus.
    using SharedPtr = ::nros::Owned<Publisher<M>>;
    /// `rclcpp::Publisher<M>::ConstSharedPtr` — the SAME type as `SharedPtr`.
    ///
    /// `Owned<const T>` is refused by a `static_assert` in `owned.hpp`: it
    /// declares cleanly and is ill-formed on the first move or `reset()`, which
    /// is worse than a refusal. A const/mutable distinction drawn over a
    /// handle presupposes shared ownership, which a sole owner does not have;
    /// `const SharedPtr&` already yields the `const Publisher<M>*` view.
    using ConstSharedPtr = ::nros::Owned<Publisher<M>>;
    /// `rclcpp::Publisher<M>::UniquePtr` — also the SAME type as `SharedPtr`.
    ///
    /// `Owned<T>` IS unique ownership — move-only, one owner, destroys on scope
    /// exit — so a separate alias would be a second spelling of one type.
    /// Measured before the collapse (phase-456 W5): zero uses in the tree
    /// outside this definition and the one probe asserting its old shape.
    using UniquePtr = ::nros::Owned<Publisher<M>>;

    /// Width of the buffer `get_gid()` fills — upstream's
    /// `RMW_GID_STORAGE_SIZE`, the phase-467 RMW gap-closure design study's
    /// Q1(a). Named here so a call site spells the size once and the compiler
    /// checks it, rather than copying a `24` that has already moved once.
    static constexpr size_t GID_SIZE = 24;

    /// Publish a typed message.
    ///
    /// Calls the codegen-generated `M::ffi_publish()` which serializes the
    /// message to CDR and publishes it.
    ///
    /// phase-417 stage 3 — the `initialized_` guard. `publish` was the ONLY
    /// entry point on this class without one, and the one that matters most:
    /// `M::ffi_publish` reaches `nros_cpp_publish_raw`, whose only check is
    /// `storage.is_null()`, and `storage_` is an in-object array that is never
    /// null. So an uninitialised publisher reinterpreted zero-initialised bytes
    /// as an `RmwPublisher` — silently wrong, then UB, with no diagnostic at any
    /// warning level. That is reachable straight from `create_publisher`, which
    /// returns a `Result` a ported node may not read and leaves `out` untouched
    /// on failure.
    Result publish(const M& msg) {
        if (!initialized_) return Result(::nros::ErrorCode::NotInitialized);
        return Result(M::ffi_publish(storage_, &msg));
    }

    /// Publish raw CDR bytes.
    Result publish_raw(const uint8_t* data, size_t len) {
        if (!initialized_) return Result(::nros::ErrorCode::NotInitialized);
        return Result(nros_cpp_publish_raw(storage_, data, len));
    }

    /// Phase 124.E.1 — streamed publish.
    ///
    /// `total_len` declares the full payload size; `writer` is
    /// invoked one or more times with a writable chunk and must
    /// return the bytes written. The runtime/backend allocates
    /// `total_len` bytes (in the outbound buffer when the backend
    /// natively streams, otherwise in a stack staging buffer
    /// capped at ~4 KiB) and drains the closure until full.
    ///
    /// `writer` signature: `size_t(uint8_t* chunk, size_t cap)`.
    template <typename W> Result publish_streamed(size_t total_len, W&& writer) {
        if (!initialized_) return Result(::nros::ErrorCode::NotInitialized);
        struct Ctx {
            W writer;
            size_t total;
        } ctx{static_cast<W&&>(writer), total_len};
        auto size_cb = [](size_t* out_total, void* user) {
            auto* c = static_cast<Ctx*>(user);
            *out_total = c->total;
        };
        auto chunk_cb = [](uint8_t* out_buf, size_t cap, size_t* out_written, void* user) {
            auto* c = static_cast<Ctx*>(user);
            *out_written = c->writer(out_buf, cap);
        };
        return Result(nros_cpp_publisher_publish_streamed(storage_, size_cb, chunk_cb,
                                                          static_cast<void*>(&ctx)));
    }

    // ====================================================================
    // Phase 124.A.7 — zero-copy publish (loan / commit / discard)
    // ====================================================================

    /// Phase 124.A.7 — writable slot returned by `Publisher::loan`. RAII:
    /// `commit(actual_len)` sends + consumes; `discard()` abandons + consumes;
    /// `Drop` without either calls discard automatically.
    class Loan {
      public:
        Loan() : pub_(nullptr), buf_(nullptr), cap_(0), token_(nullptr) {}
        Loan(Loan&& o) : pub_(o.pub_), buf_(o.buf_), cap_(o.cap_), token_(o.token_) {
            o.pub_ = nullptr;
            o.token_ = nullptr;
        }
        Loan& operator=(Loan&& o) {
            if (this != &o) {
                release();
                pub_ = o.pub_;
                buf_ = o.buf_;
                cap_ = o.cap_;
                token_ = o.token_;
                o.pub_ = nullptr;
                o.token_ = nullptr;
            }
            return *this;
        }
        Loan(const Loan&) = delete;
        Loan& operator=(const Loan&) = delete;
        ~Loan() { release(); }

        /// Writable view of the loaned bytes.
        uint8_t* data() { return buf_; }
        const uint8_t* data() const { return buf_; }
        size_t capacity() const { return cap_; }

        bool is_valid() const { return token_ != nullptr; }

        /// Send `actual_len` bytes. Consumes the loan.
        Result commit(size_t actual_len) {
            if (!token_) return Result(::nros::ErrorCode::NotInitialized);
            nros_cpp_ret_t ret = nros_cpp_publisher_commit(pub_, token_, actual_len);
            pub_ = nullptr;
            token_ = nullptr;
            buf_ = nullptr;
            cap_ = 0;
            return Result(ret);
        }

        /// Abandon without sending. Consumes the loan.
        Result discard() {
            if (!token_) return Result::success();
            nros_cpp_ret_t ret = nros_cpp_publisher_discard(pub_, token_);
            pub_ = nullptr;
            token_ = nullptr;
            buf_ = nullptr;
            cap_ = 0;
            return Result(ret);
        }

        /// Internal constructor — callers use `Publisher::loan()` not
        /// this directly.
        Loan(void* pub, uint8_t* buf, size_t cap, void* token)
            : pub_(pub), buf_(buf), cap_(cap), token_(token) {}

      private:
        void release() {
            if (token_ && pub_) {
                nros_cpp_publisher_discard(pub_, token_);
                token_ = nullptr;
            }
        }

        void* pub_;
        uint8_t* buf_;
        size_t cap_;
        void* token_;
    };

    /// Loan a writable slot of at least `requested_len` bytes. The returned
    /// `Loan` is RAII: call `commit(actual_len)` to send, `discard()` to
    /// abandon, or let it drop (auto-discard).
    ::nros::ResultOf<Loan> loan(size_t requested_len) {
        if (!initialized_)
            return ::nros::ResultOf<Loan>::error(Result(::nros::ErrorCode::NotInitialized));
        uint8_t* buf = nullptr;
        size_t cap = 0;
        void* token = nullptr;
        nros_cpp_ret_t ret = nros_cpp_publisher_loan(storage_, requested_len, &buf, &cap, &token);
        if (ret != 0) return ::nros::ResultOf<Loan>::error(Result(ret));
        return ::nros::ResultOf<Loan>::ok(Loan{storage_, buf, cap, token});
    }

    /// Get the topic name.
    const char* get_topic_name() const { return initialized_ ? topic_name_ : ""; }

    /// The QoS profile this publisher is ACTUALLY running — issue 1437.
    ///
    /// `rclcpp::Publisher::get_actual_qos`: what the BACKEND GRANTED, which
    /// differs from what `create_publisher` was handed whenever the backend
    /// serves something else — zenoh clamps history depth to its receive
    /// ring, DDS negotiates, and a launch-lowered QoS override has already
    /// been folded in before either. That difference is what answers "why is
    /// nothing arriving": a RELIABLE reader does not match a BEST_EFFORT
    /// writer, and a clamped depth drops samples the caller believed kept.
    ///
    /// **Per policy, and a policy the backend cannot report is an ABSENCE** —
    /// `ReliabilityUnknown`, `DurabilityUnknown`, ... — not your request
    /// echoed back. A backend with no read-back at all (XRCE) answers
    /// `Unknown` in every field. So compare field by field and check for the
    /// sentinel first; agreement you did not check for may be silence.
    ///
    /// Free: read once at create and retained on the handle, so this never
    /// re-enters the transport and is safe from a callback. An uninitialized
    /// publisher answers the all-absent profile.
    ::nros::QoS get_actual_qos() const {
        nros_cpp_qos_t f{};
        if (!initialized_ || nros_cpp_publisher_get_actual_qos(storage_, &f) != 0) {
            return ::nros::detail::qos_all_unknown();
        }
        return ::nros::detail::qos_from_ffi(f);
    }

    /// How many subscriptions are on this publisher's topic, RIGHT NOW —
    /// rclcpp's `Publisher::get_subscription_count`. phase-444.
    ///
    /// **A WEAKER QUESTION THAN UPSTREAM'S, and it is stated here rather than
    /// discovered.** Upstream counts the subscriptions MATCHED to THIS
    /// publisher — peers whose QoS is compatible with it. This counts every
    /// subscription DISCOVERED on the topic, matched or not, because that is
    /// what the graph can answer and a backend with no QoS negotiation cannot
    /// tell the two apart at all.
    ///
    /// Non-inverting, and in the safe direction: a topic nobody subscribes to
    /// still reads `0`, so the use this exists for — skip the work when nobody
    /// is listening — is answered exactly. An INCOMPATIBLE peer makes it read
    /// `1` where upstream reads `0`, i.e. you do work nobody receives. Never
    /// the reverse.
    ///
    /// **Takes the executor and an out-parameter**, neither of which upstream
    /// does. The executor because we open ONE transport session per image and
    /// it owns the session, so the graph is the executor's to read — the same
    /// receiver difference as every `Executor::get_*` graph verb (phase-381
    /// W4). The out-parameter because RFC-0018 forbids exceptions, so the
    /// error has to be the return value. Both weakenings are ones the compiler
    /// makes a porter notice, which is RFC-0089's mechanical-edit test.
    ///
    /// Reports what has been DISCOVERED and never blocks, so a small answer
    /// right after startup is "not seen yet", never "not there"; a backend
    /// that cannot read the graph returns an error, which is a DIFFERENT
    /// answer from `0` and leaves `*out_count` untouched.
    Result get_subscription_count(::nros::Executor& executor, size_t* out_count) const {
        if (!initialized_) return Result(::nros::ErrorCode::NotInitialized);
        return executor.count_subscribers(topic_name_, out_count);
    }

    /// Check if the publisher is initialized and valid.
    bool is_valid() const { return initialized_; }

    /// Destructor — releases publisher resources.
    ~Publisher() {
        if (initialized_) {
            nros_cpp_publisher_destroy(storage_);
            initialized_ = false;
        }
    }

    // Move semantics (non-copyable). Relocation goes through the
    // `nros_cpp_publisher_relocate` runtime call.
    Publisher(Publisher&& other) : initialized_(other.initialized_) {
        if (other.initialized_) {
            nros_cpp_publisher_relocate(other.storage_, storage_);
            ::memcpy(topic_name_, other.topic_name_, sizeof(topic_name_));
            other.initialized_ = false;
        }
    }

    Publisher& operator=(Publisher&& other) {
        if (this != &other) {
            if (initialized_) {
                nros_cpp_publisher_destroy(storage_);
                initialized_ = false;
            }
            if (other.initialized_) {
                nros_cpp_publisher_relocate(other.storage_, storage_);
                ::memcpy(topic_name_, other.topic_name_, sizeof(topic_name_));
                initialized_ = true;
                other.initialized_ = false;
            }
        }
        return *this;
    }

    /// Default constructor — creates an uninitialized publisher.
    /// Use `Node::create_publisher()` to initialize.
    Publisher() : storage_(), topic_name_{}, initialized_(false) {}

    // ====================================================================
    // Phase 108 — status events
    // ====================================================================

    /// Register a callback for liveliness-lost events on this publisher.
    Result on_liveliness_lost(nros_cpp_publisher_count_cb_t cb, void* user_context = nullptr) {
        if (!initialized_) return Result(::nros::ErrorCode::NotInitialized);
        return Result(nros_cpp_publisher_set_liveliness_lost(storage_, cb, user_context));
    }

    /// Register a callback for offered-deadline-missed events on this
    /// publisher.
    Result on_offered_deadline_missed(uint32_t deadline_ms, nros_cpp_publisher_count_cb_t cb,
                                      void* user_context = nullptr) {
        if (!initialized_) return Result(::nros::ErrorCode::NotInitialized);
        return Result(nros_cpp_publisher_set_offered_deadline_missed(storage_, deadline_ms, cb,
                                                                     user_context));
    }

    /// Phase 108.B.7 — manually assert liveliness. Required for
    /// publishers configured with `LivelinessManualByTopic` /
    /// `ManualByNode`; nothing to assert for `Automatic` / `None`, which
    /// answer `Ok` on every backend.
    ///
    /// **`ErrorCode::Unsupported` under a manual kind on a backend with no
    /// per-topic lease** — zenoh-pico, XRCE-DDS, uORB (the phase-467 RMW
    /// gap-closure design study's Row 7). The entity is fine; the assertion
    /// simply did not reach a peer, which is the one thing a caller uses this
    /// for. cyclonedds performs it for real.
    Result assert_liveliness() {
        if (!initialized_) return Result(::nros::ErrorCode::NotInitialized);
        return Result(nros_cpp_publisher_assert_liveliness(storage_));
    }

    /// This publisher's own global identifier — `rclcpp::PublisherBase::get_gid`.
    ///
    /// The phase-467 RMW gap-closure design study's Q1. Fills `out_gid` with
    /// [`GID_SIZE`](GID_SIZE) bytes on `Ok`, and writes nothing otherwise.
    ///
    /// Upstream returns `const rmw_gid_t &` and cannot fail. Ours can — a
    /// backend may have no identity for this publisher — and RFC-0018 leaves
    /// no exceptions to say so with, so the value leaves through a reference
    /// to a caller-placed array and the verdict through the `Result`. An
    /// array REFERENCE rather than a pointer is what makes the width a
    /// compile-time fact at every call site.
    ///
    /// **Three bounds, each of which a caller will otherwise assume away:**
    ///
    /// * **How many of the bytes MEAN anything is a backend property.** A
    ///   backend whose identity is narrower zero-extends into the tail, so
    ///   two gids naming one entity compare equal. Gids produced by two
    ///   different backends in one image are never comparable.
    /// * **Not comparable with the gid on a RECEIVED sample, yet.** Same
    ///   width, and on every backend but zenoh not the same source — issue
    ///   1495.
    /// * **An all-zero gid is never handed back as an answer.** A backend
    ///   with no identity for this publisher reports
    ///   `ErrorCode::Unsupported`, because all-zero is what an unwritten
    ///   buffer holds and the two must not read alike.
    Result get_gid(uint8_t (&out_gid)[GID_SIZE]) const {
        if (!initialized_) return Result(::nros::ErrorCode::NotInitialized);
        return Result(nros_cpp_publisher_get_gid(storage_, out_gid, GID_SIZE));
    }

  private:
    Publisher(const Publisher&) = delete;
    Publisher& operator=(const Publisher&) = delete;

    friend class ::rclcpp::Node;

    // `+ sizeof(void*)`: the monitor cell pointer the runtime stores beside
    // the handle (`CppPublisher` in nros-cpp's publisher.rs, whose
    // compile-time assert is the other half of this number).
    alignas(8) uint8_t storage_[NROS_PUBLISHER_SIZE + sizeof(void*)];
    char topic_name_[::nros::PUBLISHER_TOPIC_NAME_MAX];
    bool initialized_;
};

} // namespace rclcpp

// ============================================================================
// nros:: -- the in-tree spelling, now the ALIAS (RFC-0089). Declared here,
// before the out-of-line `Node::create_*` bodies below, which are written in
// the `nros::` vocabulary.
// ============================================================================
namespace nros {
template <typename M> using Publisher = ::rclcpp::Publisher<M>;
} // namespace nros

// Phase 84.G8: out-of-line definition of Node::create_publisher<M>().
// Placed here so consumers only pay for this template when they actually
// use publishers — including `nros/node.hpp` alone no longer drags in
// every entity's code path.
#include "nros/node.hpp"

namespace nros {} // namespace nros

namespace rclcpp {
template <typename M>
Result Node::create_publisher(Publisher<M>& out, const char* topic, const ::nros::QoS& qos) {
    // RFC-0088 D5 — one image, one backend, one encoding. Compile-time, so a
    // message the linked backend cannot encode never reaches the wire.
    NROS_CPP_ASSERT_MESSAGE_FORMAT(M);
    if (!initialized_) return Result(::nros::ErrorCode::NotInitialized);
    nros_cpp_qos_t ffi_qos = ::nros::detail::qos_to_ffi(qos);
    nros_cpp_ret_t ret = nros_cpp_publisher_create(&handle_, topic, M::TYPE_NAME, M::TYPE_HASH,
                                                   ffi_qos, out.storage_);
    if (ret == 0) {
        // Topic name lives C++-side; copy + null-terminate into the
        // fixed-size buffer. Truncation is silent.
        ::nros::detail::assign_entity_name(out.topic_name_, topic);
        out.initialized_ = true;
    }
    return Result(ret);
}
} // namespace rclcpp

namespace nros {

/// Phase 189.M3.1 — named-options overload. `PublisherOptions` is a
/// reserved/empty struct (a publisher has no callback ⇒ no sched-context
/// or message-info axis), so this simply forwards to the qos-only create.
/// It exists for rclcpp symmetry and as the seam for future intra-process
/// / loaned-message knobs.
} // namespace nros

namespace rclcpp {
template <typename M>
Result Node::create_publisher(Publisher<M>& out, const char* topic, const ::nros::QoS& qos,
                              const ::nros::PublisherOptions& options) {
    (void)options; // reserved — no live fields today
    return create_publisher<M>(out, topic, qos);
}
} // namespace rclcpp

namespace nros {

/// Phase 123.B.4 — value-returning publisher factory. Wraps the
/// out-param `Node::create_publisher` in `ResultOf<Publisher<M>>`
/// so users can write
/// `auto pub = nros::create_publisher<Int32>(node, "/chatter");`
/// in the rclcpp-style.
template <typename M>
inline ResultOf<Publisher<M>> create_publisher(::rclcpp::Node& node, const char* topic,
                                               const QoS& qos = QoS::default_profile()) {
    Publisher<M> p;
    Result r = node.create_publisher<M>(p, topic, qos);
    if (!r.ok()) return ResultOf<Publisher<M>>::error(r);
    return ResultOf<Publisher<M>>::ok(::nros::tr::forward_rvalue(p));
}

} // namespace nros

#endif // NROS_CPP_PUBLISHER_HPP
