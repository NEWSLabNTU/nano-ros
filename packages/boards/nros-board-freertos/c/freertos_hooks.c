/*
 * freertos_hooks.c — generic FreeRTOS kernel hooks
 *
 * Phase 152.1.B.1 — extracted from build.rs's `STARTUP_C` const
 * as part of the per-board → generic-crate refactor. Contains
 * hook functions FreeRTOS calls back into (assert, idle, malloc-
 * failed, stack-overflow, SysTick) plus the semihosting helpers
 * those hooks use to report failures. No board-specific code
 * here — `freertos_hooks.c` is the candidate for promotion into
 * the generic `nros-board-freertos` crate in 152.1.B.4.
 */

#include <stdint.h>

#include "FreeRTOS.h"
#include "task.h"

/* ---- Semihosting trap instruction ----
 *
 * The instruction that enters the debugger is INSTRUCTION-SET dependent, and
 * this family is no longer Thumb-only: `bkpt #0xAB` is the T32 encoding, while
 * an A/R-profile board running in ARM state (Cortex-R52 — phase-385) must use
 * `svc #0x123456`. Compiled for ARM state, a `bkpt #0xAB` is not recognised as
 * a semihosting call at all: QEMU takes a real prefetch/data abort and the
 * image ends up spinning in the abort vector with no output — which reads as a
 * dead image rather than a wrong console.
 *
 * `__thumb__` is defined by the compiler for the TU's own instruction set, so
 * this selects correctly per board without a board-specific #define.
 */
#if defined(__thumb__)
#define NROS_SEMIHOST_TRAP "bkpt #0xAB\n"
#else
#define NROS_SEMIHOST_TRAP "svc #0x123456\n"
#endif

/* ---- Semihosting helpers ---- */

void semihosting_write0(const char *s) {
    __asm__ volatile("mov r0, #0x04\n"
                     "mov r1, %0\n"
                     NROS_SEMIHOST_TRAP
                     :
                     : "r"(s)
                     : "r0", "r1", "memory");
}

static void semihosting_write_int(int val) {
    char buf[12];
    char *p = buf + sizeof(buf) - 1;
    *p = '\0';
    if (val < 0) { semihosting_write0("-"); val = -val; }
    if (val == 0) { semihosting_write0("0"); return; }
    while (val > 0) { *--p = '0' + (val % 10); val /= 10; }
    semihosting_write0(p);
}

/* Phase 121.3.freertos-parity — alias used by hook callers. */
static void semihost_write0(const char *s) {
    semihosting_write0(s);
}

/* phase-370 — the family console hook `freertos_run_tiers.c` reports through.
 *
 * That TU used to call `semihosting_write0` directly, which tied a file about
 * FreeRTOS tiers to one board family's debug transport. On a Cortex-M board
 * under QEMU the console IS semihosting, so this is a one-line forward; the
 * POSIX simulator board defines the same symbol over `stderr`. Exactly one
 * strong definition per image, because exactly one board TU is compiled. */
void nros_board_freertos_console_write(const char *s) {
    semihosting_write0(s);
}

/* ---- C++ static-object ABI stubs (phase-370 W4) ----
 *
 * Keeping `.init_array` (below) retains C++ objects with static storage
 * duration, and a static object WITH A DESTRUCTOR registers that destructor
 * through `__cxa_atexit(dtor, obj, &__dso_handle)`. A `-nostartfiles` image
 * links no crt, so neither symbol exists and the link fails with
 * `undefined reference to __dso_handle` / `_fini` — a message about the C++ ABI
 * that says nothing about the linker-script change that caused it.
 *
 * `_fini` is reached the same way: newlib's `__libc_fini_array` is pulled in
 * alongside the atexit machinery and calls it.
 *
 * Defining them as no-ops is the standard bare-metal answer and is CORRECT
 * here rather than a papering-over: this image never exits. `main` does not
 * return, the FreeRTOS scheduler owns the CPU until power-off, so a static
 * destructor could only ever run at a point that does not exist. Registering
 * them would cost RAM for a list nothing walks.
 *
 * `__dso_handle`'s value is never dereferenced — it is an identity token for
 * "which shared object registered this", and there is exactly one here. */
void *__dso_handle = 0;

int __cxa_atexit(void (*destructor)(void *), void *arg, void *dso) {
    (void) destructor;
    (void) arg;
    (void) dso;
    /* 0 = "registered". Reporting failure would make a conforming C++ runtime
     * call `std::terminate` at static-init time. */
    return 0;
}

void __cxa_finalize(void *dso) {
    (void) dso;
}

void _fini(void) {
}

/* ---- Static constructors (phase-370 W4, the #195 pattern) ----
 *
 * A flat bare-metal image has no crt0 and no `__libc_init_array`, so nothing
 * runs `.init_array` unless the board does. The Cyclone message-descriptor
 * registration TUs are `__attribute__((constructor))` (generated by
 * `nros_rmw_cyclonedds_idlc_compile`), so on FreeRTOS every descriptor stayed
 * unregistered and `nros_publisher_init` returned a bare `-1` naming nothing —
 * issue 0733. `nros-board-threadx-qemu-riscv64` has done exactly this since
 * issue #195; this is the same walk for the FreeRTOS family.
 *
 * The bounds come from the shared `config/nros-freertos-cortex-m.ld`
 * `.init_array` KEEP block. `PROVIDE` gives them values even when no ctor
 * exists, in which case start == end and the loop simply does not run — so a
 * board or image with no constructors needs no special case.
 *
 * IDEMPOTENT: called from the C/C++ lane's `freertos_c_entry.c` and from the
 * Rust lane's boot, and an image has exactly one of those — but a board that
 * called both would otherwise construct twice, and a ctor is not required to
 * tolerate that. The guard costs one byte of bss.
 *
 * Must run BEFORE anything looks a descriptor up, i.e. before `app_main` and
 * before any session opens. */
void nros_board_freertos_run_init_array(void) {
    extern void (*__init_array_start[])(void);
    extern void (*__init_array_end[])(void);

    static uint8_t done = 0u;
    if (done) {
        return;
    }
    done = 1u;

    for (void (**ctor)(void) = __init_array_start; ctor < __init_array_end; ++ctor) {
        (*ctor)();
    }
}

/* ---- FreeRTOS assert ---- */
void freertos_assert_failed(const char *file, int line) {
    semihosting_write0("FreeRTOS ASSERT FAILED: ");
    semihosting_write0(file);
    semihosting_write0(":");
    semihosting_write_int(line);
    semihosting_write0("\n");
    __asm__ volatile("bkpt #0");
    for (;;) {}
}

/* ---- FreeRTOS malloc failed hook ---- */
void vApplicationMallocFailedHook(void) {
    semihost_write0("*** MALLOC FAILED ***\n");
    for (;;) { __asm__ volatile("wfi"); }
}

/* Phase 121.3.freertos-parity diagnostic — stack overflow hook.
 * Prints offending task name via semihosting so the regression
 * is localized at runtime instead of silently hanging. */
void vApplicationStackOverflowHook(TaskHandle_t xTask, char *pcTaskName) {
    (void) xTask;
    semihost_write0("*** STACK OVERFLOW: ");
    semihost_write0(pcTaskName);
    semihost_write0(" ***\n");
    for (;;) { __asm__ volatile("wfi"); }
}

/* ---- FreeRTOS idle hook: WFI for QEMU ---- */
/* On real hardware, WFI saves power. In QEMU, it yields CPU time back to
 * the main event loop so that the TAP network FD can be serviced. Without
 * this, the idle task busy-loops and QEMU never processes incoming network
 * frames from the host (ARP replies, TCP SYN-ACKs, etc.). */
void vApplicationIdleHook(void) {
    __asm__ volatile("wfi");
}

/* ---- FreeRTOS SysTick handler ---- */
extern void xPortSysTickHandler(void);

void SysTick_Handler(void) {
    if (xTaskGetSchedulerState() != taskSCHEDULER_NOT_STARTED) {
        xPortSysTickHandler();
    }
}
