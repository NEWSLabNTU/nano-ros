## zephyr/west.yml
```yaml
# west manifest fragment for the nano-ros Zephyr module.
#
# Downstream workspaces import this from their own `west.yml` so that
# `west update` pulls nano-ros and Zephyr discovers it as a module:
#
#   manifest:
#     remotes:
#       - name: nano-ros
#         url-base: https://github.com/NEWSLabNTU
#     projects:
#       - name: nano-ros
#         remote: nano-ros
#         revision: main          # the repo's default branch is `main`,
#                                 # NOT `master` — without this `west`
#                                 # defaults to master and fetch fails.
#         path: modules/nano-ros
#         import:
#           file: zephyr/west.yml
#
# After `west update`, `west build -b <board>` finds this directory via
# the `zephyr/module.yml` sibling and links `NanoRos::NanoRos` into the app.
# (Phase 208.D.7 folded the legacy `integrations/zephyr/` shell into this
# single `zephyr/` module — one Kconfig / module.yml / CMakeLists.txt set.)

manifest:
  version: "1.0"
  # No projects of our own — this fragment exists so downstream
  # workspaces can `import:` it and pick up nano-ros without rewriting
  # their manifest. Self-import is a no-op: the surrounding workspace
  # already cloned nano-ros to provide this file.
  projects: []
```
