## CMakeLists.txt
```
# SPDX-License-Identifier: Apache-2.0
# Phase 117.14 — nros pub/sub demo on the ARM FVP Base_RevC AEMv8-R
# Cortex-A SMP target under Zephyr. Copy-out template per CLAUDE.md
# examples convention — no walk-up paths, no shared example-only
# helpers. The nros module supplies the C++ API + codegen.

cmake_minimum_required(VERSION 3.20.0)

find_package(Zephyr REQUIRED HINTS $ENV{ZEPHYR_BASE})
project(nros_zephyr_aemv8r_cyclonedds_talker LANGUAGES CXX)

# Generate C++ message bindings for the Int32 type used by the talker.
# `nros_generate_interfaces()` is provided by the nros Zephyr module
# (CONFIG_NROS=y, CONFIG_NROS_CPP_API=y).
nros_generate_interfaces(std_msgs LANGUAGE CPP)

target_sources(app PRIVATE src/main.cpp)
```

## prj.conf
```kconfig
# Phase 117.14 — Zephyr config for the FVP AEMv8-R Cortex-A SMP
# pub/sub demo. nros C++ API + DDS backend.

# =============================================================================
# Kernel + threading
# =============================================================================
CONFIG_MAIN_STACK_SIZE=16384
CONFIG_HEAP_MEM_POOL_SIZE=131072
CONFIG_SYSTEM_WORKQUEUE_STACK_SIZE=4096
CONFIG_SYS_CLOCK_TICKS_PER_SEC=1000

CONFIG_MAX_PTHREAD_COUNT=16
CONFIG_POSIX_THREAD_THREADS_MAX=16
CONFIG_MAX_PTHREAD_MUTEX_COUNT=32
CONFIG_MAX_PTHREAD_COND_COUNT=16

# =============================================================================
# C++ Support
# =============================================================================
CONFIG_CPP=y
CONFIG_STD_CPP14=y

# =============================================================================
# POSIX (DDS pthreads + sockets)
# =============================================================================
CONFIG_POSIX_API=y

# =============================================================================
# Networking — IPv4 + UDP/TCP, ethernet L2.
# =============================================================================
CONFIG_NETWORKING=y
CONFIG_NET_IPV4=y
CONFIG_NET_IPV6=n
CONFIG_NET_TCP=y
CONFIG_NET_UDP=y
CONFIG_NET_SOCKETS=y
CONFIG_NET_L2_ETHERNET=y
CONFIG_NET_PKT_RX_COUNT=32
CONFIG_NET_PKT_TX_COUNT=32
CONFIG_NET_BUF_RX_COUNT=64
CONFIG_NET_BUF_TX_COUNT=64
CONFIG_NET_MAX_CONTEXTS=16

# =============================================================================
# Logging / console
# =============================================================================
CONFIG_LOG=y
CONFIG_LOG_DEFAULT_LEVEL=3
CONFIG_PRINTK=y
CONFIG_EARLY_CONSOLE=y
CONFIG_LOG_BACKEND_RTT=n

# =============================================================================
# nros module — C++ API + DDS backend (dust-dds today; Cyclone once
# the Zephyr-Cyclone build glue lands).
# =============================================================================
CONFIG_NROS=y
CONFIG_NROS_CPP_API=y
CONFIG_NROS_RMW_DDS=y
```

## src/main.cpp
```c
/**
 * @file main.cpp
 * @brief Phase 117.14 — Zephyr C++ pub/sub demo on the ARM FVP
 *        Base_RevC AEMv8-R Cortex-A SMP board, exercising `nros-cpp`
 *        + the codegen pipeline end-to-end.
 *
 * Publishes `std_msgs/Int32 { data = count }` on `/chatter` once a
 * second. Pair with a stock ROS 2 `ros2 topic echo /chatter
 * std_msgs/msg/Int32` peer for the runtime interop check, or with
 * the matching `examples/zephyr/cpp/dds/listener` running on
 * native_sim for an in-tree round-trip.
 *
 * The Cyclone DDS RMW lands on POSIX today (Phase 117.12); this
 * example builds against the Zephyr nros module's existing DDS
 * backend (`CONFIG_NROS_RMW_DDS=y`, dust-dds). Swap to Cyclone once
 * the Zephyr build glue at `packages/dds/nros-rmw-cyclonedds/` is
 * extended to ship a Zephyr module (tracked separately).
 */

#include <zephyr/kernel.h>
#include <zephyr/logging/log.h>

#include <nros/nros.hpp>

#include "std_msgs.hpp"

LOG_MODULE_REGISTER(nros_aemv8r_cyclonedds_talker, LOG_LEVEL_INF);

int main(void)
{
    LOG_INF("Phase 117.14 — nros C++ talker on FVP AEMv8-R");

    nros::Result ret = nros::init("", CONFIG_NROS_DOMAIN_ID);
    if (!ret.ok()) {
        LOG_ERR("Init failed: %d", ret.raw());
        return 1;
    }

    nros::Node node;
    ret = nros::create_node(node, "aemv8r_cyclonedds_talker");
    if (!ret.ok()) {
        LOG_ERR("Node creation failed: %d", ret.raw());
        nros::shutdown();
        return 1;
    }

    nros::Publisher<std_msgs::msg::Int32> pub;
    ret = node.create_publisher(pub, "/chatter");
    if (!ret.ok()) {
        LOG_ERR("Publisher creation failed: %d", ret.raw());
        nros::shutdown();
        return 1;
    }

    LOG_INF("Publishing /chatter (std_msgs/Int32) at 1 Hz...");

    int32_t count = 0;
    while (true) {
        ++count;
        std_msgs::msg::Int32 msg;
        msg.data = count;

        ret = pub.publish(msg);
        if (ret.ok()) {
            LOG_INF("Published: %d", count);
        } else {
            LOG_ERR("Publish failed: %d", ret.raw());
        }
        k_sleep(K_SECONDS(1));
    }

    nros::shutdown();
    return 0;
}
```
