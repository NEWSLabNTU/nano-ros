## CMakeLists.txt
```
# SPDX-License-Identifier: Apache-2.0
# nano-ros Zephyr BYO starter app (zenoh, C) — TYPED component
# (RFC-0043 / phase-244.C4). The node is a stateful C component
# (`RCLC_C_COMPONENT(talker_t, talker_configure)`); the nano-ros module's Zephyr
# typed carrier (the shared entry pack) generates the entry +
# composes it into `app` (ZephyrBoard::run_components) — no hand-written
# `nros_app_main`. The node publishes `std_msgs/Int32` through the generated C
# bindings, so the app declares `std_msgs` here and in `package.xml` (issue
# 2140: it once claimed to need none, and a copy did not compile).
cmake_minimum_required(VERSION 3.20.0)
find_package(Zephyr REQUIRED HINTS $ENV{ZEPHYR_BASE})
project(nano_ros_byo_talker)

# The nano-ros Zephyr module (auto-loaded via find_package(Zephyr) when
# CONFIG_NROS=y) provides both packages; find_package(std_msgs) generates the
# typed C bindings Talker.c includes. The same shape as examples/zephyr/c/talker.
find_package(nano_ros REQUIRED)
find_package(std_msgs REQUIRED)

nano_ros_auto_add_library(byo_talker_lib STATIC src/Talker.c)

nros_components_register_node(byo_talker_lib
    PLUGIN nano_ros_byo_talker::Talker
    EXECUTABLE byo_talker
    SHAPE configure
    TYPED
    DEPLOY zephyr)
```

## prj.conf
```kconfig
# nano-ros Zephyr starter — zenoh RMW, C API (Phase 205.A).
# The RMW is `system.toml`'s; for xrce/cyclonedds see
# modules/nano-ros/examples/zephyr/c/talker (one image per RMW).

CONFIG_LOG=y
CONFIG_LOG_DEFAULT_LEVEL=3
CONFIG_PRINTK=y
CONFIG_EARLY_CONSOLE=y

# Networking (any networked RMW on QEMU / native_sim)
CONFIG_NETWORKING=y
CONFIG_NET_IPV4=y
CONFIG_NET_UDP=y
CONFIG_NET_TCP=y
CONFIG_NET_SOCKETS=y
CONFIG_NET_L2_ETHERNET=y
CONFIG_NET_MAX_CONTEXTS=16
CONFIG_DNS_RESOLVER=n
CONFIG_SYS_CLOCK_TICKS_PER_SEC=1000

# nano-ros: enable the module. The RMW (zenoh) and the API are NOT stated here:
# the module renders them from `system.toml`'s image (phase-481, RFC-0098 D11).
# (ROS edition is a build-time Cargo feature, NOT a Kconfig symbol — do not set
# CONFIG_NROS_ROS_EDITION; Zephyr aborts on the undefined symbol.)
CONFIG_NROS=y
# The TYPED Zephyr carrier entry is C++ (it drives the C component's
# factory/configure seam via ZephyrBoard::run_components) and compiles as
# C++17 (nros-cpp qos.hpp uses mutating constexpr members).
CONFIG_STD_CPP17=y

# zenoh-pico needs POSIX threads + a roomy heap/stack
CONFIG_POSIX_API=y
# 64, not 32 — the build derives a floor and refuses below it; see
# `_nros_mutex_floor` in `zephyr/cmake/nros_cargo_build.cmake`.
CONFIG_MAX_PTHREAD_MUTEX_COUNT=64
CONFIG_MAX_PTHREAD_COND_COUNT=16
CONFIG_POSIX_THREAD_THREADS_MAX=16
# CONFIG_MAIN_STACK_SIZE: the nano-ros module decides it per image (issue 2365)
CONFIG_HEAP_MEM_POOL_SIZE=65536
CONFIG_SYSTEM_WORKQUEUE_STACK_SIZE=4096
CONFIG_NET_PKT_RX_COUNT=32
CONFIG_NET_PKT_TX_COUNT=32
CONFIG_NET_BUF_RX_COUNT=64
CONFIG_NET_BUF_TX_COUNT=64
```

## src/main.c
```c
/**
 * @file main.c
 * @brief nano-ros Zephyr starter — zenoh C talker (Phase 205.A).
 *
 * Publishes a std_msgs/Int32 on `/chatter` once per second. Copy this app, edit
 * the topic/message/logic. Booting it needs a zenoh router at
 * CONFIG_NROS_ZENOH_LOCATOR (e.g. `zenohd -l tcp/127.0.0.1:7456`).
 */

#include <zephyr/autoconf.h>
#include <zephyr/kernel.h>
#include <zephyr/logging/log.h>

#include <nros/platform_zephyr.h>

LOG_MODULE_REGISTER(app_talker, LOG_LEVEL_INF);

/* nano-ros's NROS_CHECK_* macros log via this hook. */
#define NROS_CHECK_LOG(file, line, expr, ret)                                                      \
    LOG_ERR("%s:%d %s -> %d", (file), (line), (expr), (int)(ret))

#include <nros/app_main.h>
#include <nros/check.h>
#include <nros/init.h>
#include <nros/log.h>
#include <nros/node.h>
#include <nros/publisher.h>

#include "std_msgs.h"

static nros_logger_t g_logger = NULL;

int nros_app_main(int argc, char** argv) {
    (void)argc;
    (void)argv;

    LOG_INF("nano-ros BYO talker (zenoh)");

    if (nros_platform_zephyr_wait_network(CONFIG_NROS_INIT_DELAY_MS) != 0) {
        LOG_ERR("Network not ready");
        return 1;
    }

    nros_support_t support = nros_support_get_zero_initialized();
    NROS_CHECK_RET(nros_support_init(&support, CONFIG_NROS_ZENOH_LOCATOR, CONFIG_NROS_DOMAIN_ID), 1);

    nros_node_t node = nros_node_get_zero_initialized();
    NROS_CHECK_RET(nros_node_init(&node, &support, "byo_talker", "/"), 1);
    g_logger = nros_node_get_logger(&node);

    nros_publisher_t pub = nros_publisher_get_zero_initialized();
    NROS_CHECK_RET(
        nros_publisher_init(&pub, &node, std_msgs_msg_int32_get_type_support(), "/chatter"), 1);

    int32_t count = 0;
    std_msgs_msg_int32 msg;
    std_msgs_msg_int32_init(&msg);

    LOG_INF("Publishing messages...");

    while (1) {
        count++;
        msg.data = count;
        NROS_SOFTCHECK(std_msgs_msg_int32_publish(&pub, &msg));
        NROS_LOG_INFO(g_logger, "Published: %d", count);
        k_sleep(K_SECONDS(1));
    }

    nros_publisher_fini(&pub);
    nros_node_fini(&node);
    nros_support_fini(&support);
    return 0;
}

NROS_APP_MAIN_REGISTER_ZEPHYR()
```

## src/Talker.c
```c
/// @file Talker.c
/// @brief nano-ros Zephyr BYO starter — zenoh C talker, typed component
/// (RFC-0043 / phase-244.C4).
///
/// `talker_configure` creates a publisher on `/chatter` + a timer that
/// publishes an Int32 counter each tick, with the C API. Copy this app, edit the
/// topic / message / logic. `RCLC_C_COMPONENT` emits the C-ABI factory/configure
/// the Zephyr typed Entry carrier (the shared entry pack) calls;
/// the carrier runs it on the real executor (ZephyrBoard::run_components) — no
/// hand-written `main`. Booting needs a zenoh router at
/// CONFIG_NROS_ZENOH_LOCATOR (e.g.
/// `ZENOH_CONFIG_OVERRIDE='listen/endpoints=["tcp/127.0.0.1:7447"];scouting/multicast/enabled=false'
/// ros2 run rmw_zenoh_cpp rmw_zenohd`).

#include <stddef.h>
#include <stdint.h>
#include <stdio.h>

#include <std_msgs/std_msgs.h>
#include <rclc/rclc.h>

typedef struct {
    rcl_publisher_t pub;
    rcl_timer_t timer;
    int32_t count;
} talker_t;

static void on_tick(rcl_timer_t* timer, int64_t last_call_time) {
    talker_t* self = RCLC_CONTAINER_OF(timer, talker_t, timer);
    (void)last_call_time;
    std_msgs__msg__Int32 msg = {.data = self->count};
    if (rcl_publish(&self->pub, &msg, NULL) == RCL_RET_OK) {
        printf("Published: %d\n", (int)self->count);
    }
    self->count++;
}

static rcl_ret_t talker_configure(rcl_node_t* node, rclc_executor_t* executor, talker_t* self) {
    setvbuf(stdout, NULL, _IONBF, 0);
    self->count = 0;
    self->pub = rcl_get_zero_initialized_publisher();
    rcl_ret_t rc = rclc_publisher_init_default(
        &self->pub, node, ROSIDL_GET_MSG_TYPE_SUPPORT(std_msgs, msg, Int32), "/chatter");
    if (rc != RCL_RET_OK) {
        return rc;
    }
    self->timer = rcl_get_zero_initialized_timer();
    rc = rclc_timer_init_default(&self->timer, NULL, 1000ULL * 1000000ULL, on_tick);
    if (rc != RCL_RET_OK) {
        return rc;
    }
    return rclc_executor_add_timer(executor, &self->timer);
}

RCLC_C_COMPONENT(talker_t, talker_configure)
```
