## CMakeLists.txt
```
# SPDX-License-Identifier: Apache-2.0
# nros Zephyr Service Client Example (C) — TYPED component (RFC-0043 / phase-244.C2).
#
# Instead of a hand-written imperative `main.c`, the node is a stateful C
# component (`RCLC_C_COMPONENT(add_client_t, client_configure)`); the Zephyr typed
# carrier (the shared entry pack, a C++ entry that drives the C
# component's `__nros_c_component_<pkg>_{create,configure}` seam) generates the
# entry + composes it into the Zephyr `app`.

cmake_minimum_required(VERSION 3.20.0)

find_package(Zephyr REQUIRED HINTS $ENV{ZEPHYR_BASE})
project(nros_zephyr_zenoh_service_client_c)

# package.xml SSoT (issue #11): resolve + generate the transitive interface
# closure declared in package.xml (<depend>example_interfaces</depend>) into `app`.

# Cyclone DDS topic descriptors for this image's interface packages are generated
# by the shared interface pipeline (`zephyr/cmake/nros_generate_interfaces.cmake`)
# when `find_package(<pkg>)` runs below. A hand-written descriptor block here
# used to generate the same descriptors a second time; with the global
# `--allow-multiple-definition` gone (issue 1636) that was a duplicate-symbol
# link error, so it is gone too (issue 1673).

# The Zephyr typed carrier branch (LANGUAGE C) configure_files
# the shared entry pack (`nros dev codegen entry-node`) + compiles src/AddTwoIntsClient.c with
# -DNROS_PKG_NAME=<pkg sym> so its RCLC_C_COMPONENT factory/configure seam links
# against the generated entry, all into the global `app`. No second executable.
find_package(nano_ros REQUIRED)
find_package(example_interfaces REQUIRED)

nano_ros_auto_add_library(add_two_ints_client_lib STATIC src/AddTwoIntsClient.c)

nros_components_register_node(add_two_ints_client_lib
    PLUGIN nros_zephyr_zenoh_service_client_c::AddTwoIntsClient
    EXECUTABLE add_two_ints_client
    SHAPE configure
    TYPED)
```

## prj.conf
```kconfig
# Base config (Phase 168.4 collapsed shape). RMW choice + RMW-specific
# sizing come from prj-<rmw>.conf overlays.

CONFIG_LOG=y
CONFIG_LOG_DEFAULT_LEVEL=3
CONFIG_PRINTK=y
CONFIG_EARLY_CONSOLE=y
CONFIG_LOG_BACKEND_RTT=n

CONFIG_NETWORKING=y
CONFIG_NET_IPV4=y
CONFIG_NET_UDP=y
CONFIG_NET_SOCKETS=y
CONFIG_NET_L2_ETHERNET=y
CONFIG_NET_MAX_CONTEXTS=16
CONFIG_DNS_RESOLVER=n

CONFIG_SYS_CLOCK_TICKS_PER_SEC=1000

CONFIG_NROS=y
CONFIG_NROS_C_API=y
# Phase 244.C2 — the TYPED Zephyr carrier entry is C++ (drives the C component's
# factory/configure seam via ZephyrBoard::run_components), so the nros-cpp header
# surface (component.hpp/main.hpp/nros.hpp) must be on the app include path, and
# the carrier compiles as C++14 (nros-cpp qos.hpp uses mutating constexpr members).
CONFIG_NROS_CPP_API=y
CONFIG_STD_CPP14=y

CONFIG_NET_LOG=y
CONFIG_NET_STATISTICS=y
```

## prj-cyclonedds.conf
```kconfig
# Zephyr-native settings the cyclonedds image needs -- named by
# `[image.zephyr_cyclonedds] conf` in system.toml, which the nano-ros module adds
# to the build. The RMW choice and every nano-ros knob are the image's
# (phase-481, RFC-0098 D10/D11): never `CONFIG_NROS_*` here.

CONFIG_CPP=y

# RTPS uses UDP multicast for SPDP discovery.
CONFIG_NET_IPV4_IGMP=y
CONFIG_POSIX_API=y
CONFIG_MAX_PTHREAD_MUTEX_COUNT=2048
CONFIG_MAX_PTHREAD_COND_COUNT=1024
CONFIG_POSIX_THREAD_THREADS_MAX=16

# Resource sizing — Cyclone is heavy.
CONFIG_MAIN_STACK_SIZE=524288
CONFIG_HEAP_MEM_POOL_SIZE=4194304
CONFIG_SYSTEM_WORKQUEUE_STACK_SIZE=8192

CONFIG_NET_PKT_RX_COUNT=64
CONFIG_NET_PKT_TX_COUNT=64
CONFIG_NET_BUF_RX_COUNT=128
CONFIG_NET_BUF_TX_COUNT=128

# Phase 171.0.a — runtime parity with the Rust/C++ service CycloneDDS
# overlays: Cyclone needs a larger libc arena and native_sim must use
# NSOS socket offload so host UDP multicast discovery works without TAP.
# Issue 1633 -- no COMMON_LIBC_MALLOC_ARENA_SIZE here: ddsrt allocates from the
# nros heap (CONFIG_NROS_ZEPHYR_HEAP_SIZE, 1 MiB with Cyclone) since the Zephyr
# road compiles the platform funnel, and the module's Cyclone default for the
# libc arena (256 KiB) covers what still uses it.
CONFIG_DYNAMIC_THREAD_STACK_SIZE=32768
CONFIG_NET_TCP=y
CONFIG_ASSERT=y
CONFIG_ASSERT_VERBOSE=y
CONFIG_PICOLIBC_ASSERT_VERBOSE=y
CONFIG_LOG_MODE_IMMEDIATE=y
CONFIG_NET_DRIVERS=y
CONFIG_NET_SOCKETS_OFFLOAD=y
CONFIG_NET_NATIVE_OFFLOADED_SOCKETS=y

# Issue 1674 — Cyclone's receive thread select()s over a socket waitset of
# four fds here (self-pipe + three UDP sockets, measured on native_sim), and
# Zephyr's select refuses any set larger than this cap with ENOMEM — the image
# then delivers nothing and floods its console. Zephyr's default is 3. The
# module's Kconfig defaults it to 8 for Cyclone too; it is ALSO stated here
# because a Kconfig default never reaches an existing build dir (Zephyr reloads
# the old .config while the merged fragments are unchanged), and a fragment
# change does.
CONFIG_NET_SOCKETS_POLL_MAX=8
```

## prj-xrce.conf
```kconfig
CONFIG_NROS_RMW_XRCE=y
CONFIG_NROS_XRCE_AGENT_ADDR="127.0.0.1"
CONFIG_NROS_XRCE_AGENT_PORT=2018

CONFIG_NET_TCP=y

CONFIG_MAIN_STACK_SIZE=16384
CONFIG_HEAP_MEM_POOL_SIZE=65536
CONFIG_SYSTEM_WORKQUEUE_STACK_SIZE=4096

CONFIG_NET_PKT_RX_COUNT=32
CONFIG_NET_PKT_TX_COUNT=32
CONFIG_NET_BUF_RX_COUNT=64
CONFIG_NET_BUF_TX_COUNT=64

# Issue 1010 / 1033 — `xrce_session_state_t` is ONE heap allocation out of the
# platform arena (CONFIG_NROS_ZEPHYR_HEAP_SIZE, default 65536), and these three
# caps decide its size at BUILD time. At the crate defaults (8 subscribers / 4
# service servers / 4 service clients) it is 423,824 bytes — 6.4x the whole
# arena in a single request, so the image cannot boot on any host, ever.
#
# STATED rather than derived because a standalone Zephyr application reaches no
# entity inventory: it calls no `nano_ros_entry`, and phase-412 retired the
# `ENTITIES` declaration that used to feed the standalone composer. The cmake
# bridge therefore reports `left to its crate default -- no value stated and
# none derivable` for both -1 knobs, which is what these lines answer. The six
# C++ overlays have carried them since issue 1033; the C and Rust ones had not,
# which is why six of the nine Zephyr XRCE cells died at `Executor::open`.
#
# This image creates: service_client:example_interfaces/srv/AddTwoInts:/add_two_ints + timer
# so: one service client; no subscription, no service server.
CONFIG_NROS_XRCE_MAX_SUBSCRIBERS=0
CONFIG_NROS_XRCE_MAX_SERVICE_SERVERS=0
CONFIG_NROS_XRCE_MAX_SERVICE_CLIENTS=1
```

## src/main.c
```c
/**
 * @file main.c
 * @brief Zephyr C service client (Phase 168.4 collapsed shape).
 */

#include <zephyr/kernel.h>
#include <zephyr/logging/log.h>
#include <zephyr/autoconf.h>

#include <nros/platform_zephyr.h>

LOG_MODULE_REGISTER(nros_service_client, LOG_LEVEL_INF);

#define NROS_CHECK_LOG(file, line, expr, ret)                                                      \
    LOG_ERR("%s:%d %s -> %d", (file), (line), (expr), (int)(ret))

#include <nros/app_main.h>
#include <nros/check.h>
#include <nros/client.h>
#include <nros/executor.h>
#include <nros/init.h>
#include <nros/log.h>
#include <nros/node.h>

#include "example_interfaces.h"

static nros_logger_t g_logger = NULL;

int nros_app_main(int argc, char** argv) {
    (void)argc;
    (void)argv;
    LOG_INF("nros Zephyr Service Client");

    if (nros_platform_zephyr_wait_network(CONFIG_NROS_INIT_DELAY_MS) != 0) {
        LOG_ERR("Network not ready");
        return 1;
    }

    nros_support_t support = nros_support_get_zero_initialized();
#if defined(CONFIG_NROS_RMW_ZENOH)
    NROS_CHECK_RET(nros_support_init(&support, CONFIG_NROS_ZENOH_LOCATOR, CONFIG_NROS_DOMAIN_ID),
                   1);
#elif defined(CONFIG_NROS_RMW_XRCE)
    NROS_CHECK_RET(nros_support_init_named(&support,
                                           CONFIG_NROS_XRCE_AGENT_ADDR
                                           ":" STRINGIFY(CONFIG_NROS_XRCE_AGENT_PORT),
                                           CONFIG_NROS_DOMAIN_ID, "xrce_service_client"),
                   1);
#elif defined(CONFIG_NROS_RMW_CYCLONEDDS)
    NROS_CHECK_RET(nros_support_init(&support, "", CONFIG_NROS_DOMAIN_ID), 1);
#else
#error "Phase 168.4 requires CONFIG_NROS_RMW_{ZENOH,XRCE,CYCLONEDDS}=y"
#endif

    nros_node_t node = nros_node_get_zero_initialized();
    NROS_CHECK_RET(nros_node_init(&node, &support, "zephyr_service_client", "/"), 1);
    g_logger = nros_node_get_logger(&node);

    nros_service_type_t type = {
        .type_name = example_interfaces_srv_add_two_ints_get_type_name(),
        .type_hash = example_interfaces_srv_add_two_ints_get_type_hash(),
    };

    nros_client_t client = nros_client_get_zero_initialized();
    NROS_CHECK_RET(nros_client_init(&client, &node, &type, "/add_two_ints"), 1);

    nros_executor_t executor;
    NROS_CHECK_RET(nros_executor_init(&executor, &support, 4), 1);
    NROS_CHECK_RET(nros_executor_add_client(&executor, &client), 1);

    LOG_INF("Calling service...");

    example_interfaces_srv_add_two_ints_request request;
    example_interfaces_srv_add_two_ints_request_init(&request);
    request.a = 5;
    request.b = 3;

    uint8_t req_buf[256];
    int32_t req_len =
        example_interfaces_srv_add_two_ints_request_serialize(&request, req_buf, sizeof(req_buf));
    if (req_len < 0) {
        LOG_ERR("Serialize failed");
        return 1;
    }

    uint8_t resp_buf[256];
    size_t resp_len = 0;
    nros_ret_t ret =
        nros_client_call(&client, req_buf, (size_t)req_len, resp_buf, sizeof(resp_buf), &resp_len);
    if (ret == NROS_RET_OK) {
        example_interfaces_srv_add_two_ints_response response;
        if (example_interfaces_srv_add_two_ints_response_deserialize(&response, resp_buf,
                                                                     resp_len) == 0) {
            NROS_LOG_INFO(g_logger, "Result: %lld + %lld = %lld", (long long)request.a,
                          (long long)request.b, (long long)response.sum);
        }
    } else {
        LOG_ERR("Call failed: %d", ret);
    }

    nros_executor_fini(&executor);
    nros_client_fini(&client);
    nros_node_fini(&node);
    nros_support_fini(&support);
    return 0;
}

NROS_APP_MAIN_REGISTER_ZEPHYR()
```

## src/AddTwoIntsClient.c
```c
/// @file AddTwoIntsClient.c
/// @brief Zephyr C AddTwoInts service client — typed component.
///
/// `client_configure` creates a service client + a timer that polls: the first
/// tick sends ONE fixed request (2, 3); later ticks poll the reply and print
/// the sum, then the client goes quiet. Poll model, with the generated typed
/// helpers (`example_interfaces__srv__AddTwoInts__client_{send_request,
/// take_response}`) over the C API.

#include <stddef.h>
#include <stdint.h>
#include <stdio.h>

#include <rclc/rclc.h>

#include <example_interfaces/srv/add_two_ints.h>

typedef struct {
    rcl_client_t client;
    rcl_timer_t timer;
    int64_t a;
    int64_t b;
    int awaiting;
    int done;
} add_client_t;

static void on_tick(rcl_timer_t* timer, int64_t last_call_time) {
    add_client_t* self = RCLC_CONTAINER_OF(timer, add_client_t, timer);
    (void)last_call_time;
    uint8_t scratch[64];
    if (self->done) {
        return;
    }
    if (!self->awaiting) {
        example_interfaces__srv__AddTwoInts_Request req = {.a = self->a, .b = self->b};
        if (example_interfaces__srv__AddTwoInts__client_send_request(
                &self->client, &req, scratch, sizeof(scratch)) == RCL_RET_OK) {
            self->awaiting = 1;
        }
        return;
    }
    example_interfaces__srv__AddTwoInts_Response resp;
    if (example_interfaces__srv__AddTwoInts__client_take_response(&self->client, &resp, scratch,
                                                                  sizeof(scratch)) == RCL_RET_OK) {
        printf("Result of add_two_ints: %lld\n", (long long)resp.sum);
        self->done = 1;
    }
}

static rcl_ret_t client_configure(rcl_node_t* node, rclc_executor_t* executor, add_client_t* self) {
    setvbuf(stdout, NULL, _IONBF, 0);
    self->a = 2;
    self->b = 3;
    self->awaiting = 0;
    self->done = 0;
    self->client = rcl_get_zero_initialized_client();
    rcl_ret_t rc = rclc_client_init_default(
        &self->client, node, ROSIDL_GET_SRV_TYPE_SUPPORT(example_interfaces, srv, AddTwoInts),
        "/add_two_ints");
    if (rc != RCL_RET_OK) {
        return rc;
    }
    rc = rclc_executor_attach_client(executor, &self->client);
    if (rc != RCL_RET_OK) {
        return rc;
    }
    self->timer = rcl_get_zero_initialized_timer();
    rc = rclc_timer_init_default(&self->timer, NULL, 1000ULL * 1000000ULL, on_tick);
    if (rc != RCL_RET_OK) {
        return rc;
    }
    rc = rclc_executor_add_timer(executor, &self->timer);
    if (rc == RCL_RET_OK) {
        printf("Sending request\n");
    }
    return rc;
}

RCLC_C_COMPONENT(add_client_t, client_configure)
```
