## CMakeLists.txt
```
# SPDX-License-Identifier: Apache-2.0
# nros Zephyr Action Server Example (C) — TYPED component (RFC-0043 / phase-244.C2).
#
# Instead of a hand-written imperative `main.c`, the node is a stateful C
# component (`RCLC_C_COMPONENT(fib_server_t, server_configure)`); the Zephyr typed
# carrier (the shared entry pack, a C++ entry that drives the C
# component's `__nros_c_component_<pkg>_{create,configure}` seam) generates the
# entry + composes it into the Zephyr `app`. The raw action server carries the
# type name as a string, so no message headers are needed on the carrier side —
# but the Cyclone DDS descriptors below still provide the type's C structs.

cmake_minimum_required(VERSION 3.20.0)

find_package(Zephyr REQUIRED HINTS $ENV{ZEPHYR_BASE})
project(nros_zephyr_zenoh_action_server_c)

# package.xml SSoT (issue #11): resolve + generate the transitive interface
# closure declared in package.xml (<depend>example_interfaces</depend>) into
# `app` — resolve-deps pulls action_msgs / unique_identifier_msgs too.

# Cyclone DDS topic descriptors for this image's interface packages are generated
# by the shared interface pipeline (`zephyr/cmake/nros_generate_interfaces.cmake`)
# when `find_package(<pkg>)` runs below. A hand-written descriptor block here
# used to generate the same descriptors a second time; with the global
# `--allow-multiple-definition` gone (issue 1636) that was a duplicate-symbol
# link error, so it is gone too (issue 1673).

# The Zephyr typed carrier branch (LANGUAGE C) configure_files
# the shared entry pack (`nros dev codegen entry-node`) + compiles src/FibonacciServer.c with
# -DNROS_PKG_NAME=<pkg sym> so its RCLC_C_COMPONENT factory/configure seam links
# against the generated entry, all into the global `app`. No second executable.
find_package(nano_ros REQUIRED)
find_package(example_interfaces REQUIRED)

nano_ros_auto_add_library(fibonacci_action_server_lib STATIC src/FibonacciServer.c)

nros_components_register_node(fibonacci_action_server_lib
    PLUGIN nros_zephyr_zenoh_action_server_c::FibonacciServer
    EXECUTABLE fibonacci_action_server
    SHAPE configure
    TYPED)
```

## prj.conf
```kconfig
# Base config (Phase 168.4 collapsed shape). RMW choice + RMW-specific
# sizing come from prj-<rmw>.conf overlays.

CONFIG_LOG=y
CONFIG_LOG_DEFAULT_LEVEL=3
CONFIG_PRINTK=y
CONFIG_EARLY_CONSOLE=y
CONFIG_LOG_BACKEND_RTT=n

CONFIG_NETWORKING=y
CONFIG_NET_IPV4=y
CONFIG_NET_UDP=y
CONFIG_NET_SOCKETS=y
CONFIG_NET_L2_ETHERNET=y
CONFIG_NET_MAX_CONTEXTS=16
CONFIG_DNS_RESOLVER=n

CONFIG_SYS_CLOCK_TICKS_PER_SEC=1000

CONFIG_NROS=y
CONFIG_NROS_C_API=y

CONFIG_NET_LOG=y
CONFIG_NET_STATISTICS=y
```

## prj-cyclonedds.conf
```kconfig
# Zephyr-native settings the cyclonedds image needs -- named by
# `[image.zephyr_cyclonedds] conf` in system.toml, which the nano-ros module adds
# to the build. The RMW choice and every nano-ros knob are the image's
# (phase-481, RFC-0098 D10/D11): never `CONFIG_NROS_*` here.

CONFIG_CPP=y

# RTPS uses UDP multicast for SPDP discovery.
CONFIG_NET_IPV4_IGMP=y
CONFIG_POSIX_API=y
# Actions exhaust Zephyr's fixed POSIX mutex pool at 256 (each Cyclone
# reader/writer/proxy draws several locks); ddsrt_mutex_init ignores the
# ENOMEM, so the next lock aborts mid-SEDP. Phase 184.8.
CONFIG_MAX_PTHREAD_MUTEX_COUNT=2048
CONFIG_MAX_PTHREAD_COND_COUNT=1024
CONFIG_POSIX_THREAD_THREADS_MAX=16

# Resource sizing — Cyclone is heavy.
CONFIG_MAIN_STACK_SIZE=524288
CONFIG_HEAP_MEM_POOL_SIZE=4194304
CONFIG_SYSTEM_WORKQUEUE_STACK_SIZE=8192

CONFIG_NET_PKT_RX_COUNT=64
CONFIG_NET_PKT_TX_COUNT=64
CONFIG_NET_BUF_RX_COUNT=128
CONFIG_NET_BUF_TX_COUNT=128

# Match the working native_sim Cyclone DDS overlays: use host socket
# offload instead of zeth/TAP and give Cyclone's worker threads/libc
# allocations enough room during participant discovery.
# Issue 1633 -- no COMMON_LIBC_MALLOC_ARENA_SIZE here: ddsrt allocates from the
# nros heap (CONFIG_NROS_ZEPHYR_HEAP_SIZE, 1 MiB with Cyclone) since the Zephyr
# road compiles the platform funnel, and the module's Cyclone default for the
# libc arena (256 KiB) covers what still uses it.
CONFIG_DYNAMIC_THREAD_STACK_SIZE=32768
CONFIG_NET_TCP=y
CONFIG_ASSERT=y
CONFIG_ASSERT_VERBOSE=y
CONFIG_PICOLIBC_ASSERT_VERBOSE=y
CONFIG_LOG_MODE_IMMEDIATE=y
# NSOS (host sockets) is board `zephyr`'s `nros-nsos` snippet (issue 2157).

# Issue 1674 — Cyclone's receive thread select()s over a socket waitset of
# four fds here (self-pipe + three UDP sockets, measured on native_sim), and
# Zephyr's select refuses any set larger than this cap with ENOMEM — the image
# then delivers nothing and floods its console. Zephyr's default is 3. The
# module's Kconfig defaults it to 8 for Cyclone too; it is ALSO stated here
# because a Kconfig default never reaches an existing build dir (Zephyr reloads
# the old .config while the merged fragments are unchanged), and a fragment
# change does.
CONFIG_NET_SOCKETS_POLL_MAX=8
```

## prj-xrce.conf
```kconfig
CONFIG_NROS_RMW_XRCE=y
CONFIG_NROS_XRCE_AGENT_ADDR="127.0.0.1"
CONFIG_NROS_XRCE_AGENT_PORT=2018

CONFIG_NET_TCP=y

CONFIG_MAIN_STACK_SIZE=16384
CONFIG_HEAP_MEM_POOL_SIZE=65536
CONFIG_SYSTEM_WORKQUEUE_STACK_SIZE=4096

CONFIG_NET_PKT_RX_COUNT=32
CONFIG_NET_PKT_TX_COUNT=32
CONFIG_NET_BUF_RX_COUNT=64
CONFIG_NET_BUF_TX_COUNT=64

# Issue 1010 / 1033 — `xrce_session_state_t` is ONE heap allocation out of the
# platform arena (CONFIG_NROS_ZEPHYR_HEAP_SIZE, default 65536), and these three
# caps decide its size at BUILD time. At the crate defaults (8 subscribers / 4
# service servers / 4 service clients) it is 423,824 bytes — 6.4x the whole
# arena in a single request, so the image cannot boot on any host, ever.
#
# STATED rather than derived because a standalone Zephyr application reaches no
# entity inventory: it calls no `nano_ros_entry`, and phase-412 retired the
# `ENTITIES` declaration that used to feed the standalone composer. The cmake
# bridge therefore reports `left to its crate default -- no value stated and
# none derivable` for both -1 knobs, which is what these lines answer. The six
# C++ overlays have carried them since issue 1033; the C and Rust ones had not,
# which is why six of the nine Zephyr XRCE cells died at `Executor::open`.
#
# This image creates: action_server:example_interfaces/action/Fibonacci:/fibonacci + timer
# so: one action server = ACTION_SERVER_QUERYABLES (3) service servers
# (send_goal / cancel_goal / get_result); feedback and status are topics.
CONFIG_NROS_XRCE_MAX_SUBSCRIBERS=0
CONFIG_NROS_XRCE_MAX_SERVICE_SERVERS=3
CONFIG_NROS_XRCE_MAX_SERVICE_CLIENTS=0
```

## prj-zenoh.conf
```kconfig
CONFIG_NROS_RMW_ZENOH=y

CONFIG_NET_TCP=y
CONFIG_POSIX_API=y
# 64, not 32 — the build derives a floor and refuses below it; see
# `_nros_mutex_floor` in `zephyr/cmake/nros_cargo_build.cmake`.
CONFIG_MAX_PTHREAD_MUTEX_COUNT=64
CONFIG_MAX_PTHREAD_COND_COUNT=16
CONFIG_POSIX_THREAD_THREADS_MAX=16

CONFIG_MAIN_STACK_SIZE=16384
CONFIG_HEAP_MEM_POOL_SIZE=65536
CONFIG_SYSTEM_WORKQUEUE_STACK_SIZE=4096

CONFIG_NET_PKT_RX_COUNT=32
CONFIG_NET_PKT_TX_COUNT=32
CONFIG_NET_BUF_RX_COUNT=64
CONFIG_NET_BUF_TX_COUNT=64
```

## src/main.c
```c
/**
 * @file main.c
 * @brief Zephyr C action server (Phase 168.4 collapsed shape).
 */

#include <zephyr/kernel.h>
#include <zephyr/logging/log.h>
#include <zephyr/autoconf.h>
#include <string.h>

#include <nros/platform_zephyr.h>

LOG_MODULE_REGISTER(nros_action_server, LOG_LEVEL_INF);

#define NROS_CHECK_LOG(file, line, expr, ret)                                                      \
    LOG_ERR("%s:%d %s -> %d", (file), (line), (expr), (int)(ret))

#include <nros/action.h>
#include <nros/app_main.h>
#include <nros/check.h>
#include <nros/executor.h>
#include <nros/init.h>
#include <nros/log.h>
#include <nros/node.h>

#include "example_interfaces.h"

static nros_logger_t g_logger = NULL;
static int g_goal_count = 0;

static nros_goal_response_t goal_callback(nros_action_server_t* server,
                                          const nros_goal_handle_t* goal,
                                          const uint8_t* goal_request, size_t goal_len,
                                          void* context) {
    (void)server;
    (void)context;
    example_interfaces_action_fibonacci_goal goal_msg;
    if (example_interfaces_action_fibonacci_goal_deserialize(&goal_msg, goal_request, goal_len) !=
        0) {
        return NROS_GOAL_REJECT;
    }
    NROS_LOG_INFO(g_logger, "Goal request: order=%d", goal_msg.order);
    if (goal_msg.order < 0 || goal_msg.order >= 64) return NROS_GOAL_REJECT;
    return NROS_GOAL_ACCEPT_AND_EXECUTE;
}

static nros_cancel_response_t cancel_callback(nros_action_server_t* server,
                                              const nros_goal_handle_t* goal, void* context) {
    (void)server;
    (void)goal;
    (void)context;
    return NROS_CANCEL_ACCEPT;
}

static void accepted_callback(nros_action_server_t* server, const nros_goal_handle_t* goal,
                              void* context) {
    (void)context;
    g_goal_count++;
    int32_t order = 10;
    nros_ret_t ret = nros_action_execute(server, goal);
    if (ret != NROS_RET_OK) return;

    example_interfaces_action_fibonacci_feedback fb;
    example_interfaces_action_fibonacci_feedback_init(&fb);

    for (int32_t i = 0; i <= order; i++) {
        int32_t val;
        if (i == 0)
            val = 0;
        else if (i == 1)
            val = 1;
        else
            val = fb.sequence.data[i - 1] + fb.sequence.data[i - 2];
        fb.sequence.data[i] = val;
        fb.sequence.size = (uint32_t)(i + 1);

        uint8_t fb_buf[512];
        int32_t fb_len =
            example_interfaces_action_fibonacci_feedback_serialize(&fb, fb_buf, sizeof(fb_buf));
        if (fb_len > 0) nros_action_publish_feedback(server, goal, fb_buf, (size_t)fb_len);
    }

    example_interfaces_action_fibonacci_result result;
    example_interfaces_action_fibonacci_result_init(&result);
    result.sequence.size = fb.sequence.size;
    memcpy(result.sequence.data, fb.sequence.data, fb.sequence.size * sizeof(int32_t));

    uint8_t result_buf[512];
    int32_t result_len = example_interfaces_action_fibonacci_result_serialize(&result, result_buf,
                                                                              sizeof(result_buf));
    if (result_len > 0 &&
        nros_action_succeed(server, goal, result_buf, (size_t)result_len) == NROS_RET_OK) {
        NROS_LOG_INFO(g_logger, "Goal completed (len=%u)", result.sequence.size);
    }
}

int nros_app_main(int argc, char** argv) {
    (void)argc;
    (void)argv;
    LOG_INF("nros Zephyr Action Server");

    if (nros_platform_zephyr_wait_network(CONFIG_NROS_INIT_DELAY_MS) != 0) {
        LOG_ERR("Network not ready");
        return 1;
    }

    nros_support_t support = nros_support_get_zero_initialized();
#if defined(CONFIG_NROS_RMW_ZENOH)
    NROS_CHECK_RET(nros_support_init(&support, CONFIG_NROS_ZENOH_LOCATOR, CONFIG_NROS_DOMAIN_ID),
                   1);
#elif defined(CONFIG_NROS_RMW_XRCE)
    NROS_CHECK_RET(nros_support_init_named(&support,
                                           CONFIG_NROS_XRCE_AGENT_ADDR
                                           ":" STRINGIFY(CONFIG_NROS_XRCE_AGENT_PORT),
                                           CONFIG_NROS_DOMAIN_ID, "xrce_action_server"),
                   1);
#elif defined(CONFIG_NROS_RMW_CYCLONEDDS)
    NROS_CHECK_RET(nros_support_init(&support, "", CONFIG_NROS_DOMAIN_ID), 1);
#else
#error "Phase 168.4 requires CONFIG_NROS_RMW_{ZENOH,XRCE,CYCLONEDDS}=y"
#endif

    nros_node_t node = nros_node_get_zero_initialized();
    NROS_CHECK_RET(nros_node_init(&node, &support, "zephyr_action_server", "/"), 1);
    g_logger = nros_node_get_logger(&node);

    nros_action_type_t fib_type = {
        .type_name = example_interfaces_action_fibonacci_get_type_name(),
        .type_hash = example_interfaces_action_fibonacci_get_type_hash(),
        .goal_serialized_size_max = 8,
        .result_serialized_size_max = 264,
        .feedback_serialized_size_max = 264,
    };

    nros_action_server_t server = nros_action_server_get_zero_initialized();
    NROS_CHECK_RET(nros_action_server_init(&server, &node, "/fibonacci", &fib_type, goal_callback,
                                           cancel_callback, accepted_callback, NULL),
                   1);

    nros_executor_t executor = nros_executor_get_zero_initialized();
    NROS_CHECK_RET(nros_executor_init(&executor, &support, 8), 1);
    NROS_CHECK_RET(nros_executor_register_action_server(&executor, &server), 1);

    LOG_INF("Waiting for goals...");
    nros_executor_spin_period(&executor, 100000000ULL);

    nros_executor_fini(&executor);
    nros_action_server_fini(&server);
    nros_node_fini(&node);
    nros_support_fini(&support);
    return 0;
}

NROS_APP_MAIN_REGISTER_ZEPHYR()
```

## src/FibonacciServer.c
```c
/// @file FibonacciServer.c
/// @brief Zephyr C Fibonacci action server — typed component.
///
/// `server_configure` creates an action server on `/fibonacci` in rclc's shape
/// (`rclc_action_server_init_default` + `rclc_executor_add_action_server`).
/// The goal callback reads the order out of the deserialised
/// `Fibonacci_SendGoal_Request` and accepts; a component has no main loop, so
/// a 20 ms timer runs the accepted goal and answers it with
/// `rclc_action_send_result`. No interpreter.

#include <stdbool.h>
#include <stddef.h>
#include <stdint.h>
#include <stdio.h>
#include <string.h>

#include <rclc/rclc.h>

#include <example_interfaces/action/fibonacci.h>

typedef struct {
    rclc_action_server_t server;
    rcl_timer_t timer;
    // One goal handle: its request lands here.
    example_interfaces__action__Fibonacci_SendGoal_Request goal_request;
    // The accepted goal the timer has not run yet.
    rclc_action_goal_handle_t* pending;
} fib_server_t;

static rcl_ret_t on_goal(rclc_action_goal_handle_t* goal_handle, void* ctx) {
    fib_server_t* self = (fib_server_t*)ctx;
    const example_interfaces__action__Fibonacci_SendGoal_Request* req =
        (const example_interfaces__action__Fibonacci_SendGoal_Request*)
            goal_handle->ros_goal_request;
    printf("Received goal request with order %d\n", (int)req->goal.order);
    self->pending = goal_handle;
    return RCL_RET_ACTION_GOAL_ACCEPTED;
}

static bool on_cancel(rclc_action_goal_handle_t* goal_handle, void* ctx) {
    (void)goal_handle;
    (void)ctx;
    return false;
}

static void on_tick(rcl_timer_t* timer, int64_t last_call_time) {
    (void)last_call_time;
    fib_server_t* self = RCLC_CONTAINER_OF(timer, fib_server_t, timer);
    rclc_action_goal_handle_t* goal_handle = self->pending;
    if (goal_handle == NULL) {
        return;
    }
    self->pending = NULL;
    printf("Executing goal\n");

    int32_t n = self->goal_request.goal.order;
    if (n < 0) {
        n = 0;
    }
    if (n > 16) {
        n = 16;
    }
    example_interfaces__action__Fibonacci_GetResult_Response response;
    example_interfaces__action__Fibonacci_Result__Storage result_storage;
    example_interfaces__action__Fibonacci_Result__init_in(&response.result, &result_storage);
    example_interfaces__action__Fibonacci_Result* result = &response.result;
    int32_t i;
    for (i = 0; i < n; ++i) {
        result->sequence.data[i] =
            (i == 0)   ? 0
            : (i == 1) ? 1
                       : result->sequence.data[i - 1] + result->sequence.data[i - 2];
    }
    result->sequence.size = (size_t)n;

    rcl_ret_t rc = rclc_action_send_result(goal_handle, GOAL_STATE_SUCCEEDED, &response);
    if (rc == RCL_RET_OK) {
        printf("Goal succeeded\n");
    } else {
        printf("Failed to complete goal (rc=%d)\n", (int)rc);
    }
}

static rcl_ret_t server_configure(rcl_node_t* node, rclc_executor_t* executor, fib_server_t* self) {
    setvbuf(stdout, NULL, _IONBF, 0);
    self->pending = NULL;
    self->server = rcl_action_get_zero_initialized_server();
    // A component has no support to pass; NULL is accepted, as for timers.
    rcl_ret_t rc = rclc_action_server_init_default(
        &self->server, node, NULL,
        ROSIDL_GET_ACTION_TYPE_SUPPORT(example_interfaces, action, Fibonacci), "/fibonacci");
    if (rc != RCL_RET_OK) {
        return rc;
    }
    rc = rclc_executor_add_action_server(executor, &self->server, 1, &self->goal_request,
                                         sizeof(self->goal_request), on_goal, on_cancel, self);
    if (rc != RCL_RET_OK) {
        return rc;
    }
    self->timer = rcl_get_zero_initialized_timer();
    rc = rclc_timer_init_default(&self->timer, NULL, 20ULL * 1000000ULL, on_tick);
    if (rc != RCL_RET_OK) {
        return rc;
    }
    rc = rclc_executor_add_timer(executor, &self->timer);
    if (rc == RCL_RET_OK) {
        /* Readiness marker the e2e harness greps before sending a goal. */
        printf("Waiting for action goals\n");
    }
    return rc;
}

RCLC_C_COMPONENT(fib_server_t, server_configure)
```
