## CMakeLists.txt
```
# SPDX-License-Identifier: Apache-2.0
# nros Zephyr Action Client Example (C, Zenoh)

cmake_minimum_required(VERSION 3.20.0)

find_package(Zephyr REQUIRED HINTS $ENV{ZEPHYR_BASE})
project(nros_zephyr_zenoh_action_client_c)

# package.xml SSoT (issue #11): resolve + generate the transitive interface
# closure declared in package.xml (<depend>example_interfaces</depend>) into
# `app` — resolve-deps pulls action_msgs / unique_identifier_msgs too.

# Cyclone DDS topic descriptors for this image's interface packages are generated
# by the shared interface pipeline (`zephyr/cmake/nros_generate_interfaces.cmake`)
# when `find_package(<pkg>)` runs below. A hand-written descriptor block here
# used to generate the same descriptors a second time; with the global
# `--allow-multiple-definition` gone (issue 1636) that was a duplicate-symbol
# link error, so it is gone too (issue 1673).

# TYPED component (RFC-0043 / phase-244.C2). The Zephyr typed carrier branch
# (LANGUAGE C) generates the entry TU through the shared pack (a C++ entry
# that drives the C component's RCLC_C_COMPONENT factory/configure seam) +
# compiles src/FibonacciClient.c into the global `app`. No hand-written main.c.
find_package(nano_ros REQUIRED)
find_package(example_interfaces REQUIRED)

nano_ros_auto_add_library(fibonacci_action_client_lib STATIC src/FibonacciClient.c)

nros_components_register_node(fibonacci_action_client_lib
    PLUGIN nros_zephyr_zenoh_action_client_c::FibonacciClient
    EXECUTABLE fibonacci_action_client
    SHAPE configure
    TYPED)
```

## prj.conf
```kconfig
# Base config (Phase 168.4 collapsed shape). RMW choice + RMW-specific
# sizing come from prj-<rmw>.conf overlays.

CONFIG_LOG=y
CONFIG_LOG_DEFAULT_LEVEL=3
CONFIG_PRINTK=y
CONFIG_EARLY_CONSOLE=y
CONFIG_LOG_BACKEND_RTT=n

CONFIG_NETWORKING=y
CONFIG_NET_IPV4=y
CONFIG_NET_UDP=y
CONFIG_NET_SOCKETS=y
CONFIG_NET_L2_ETHERNET=y
CONFIG_NET_MAX_CONTEXTS=16
CONFIG_DNS_RESOLVER=n

CONFIG_SYS_CLOCK_TICKS_PER_SEC=1000

CONFIG_NROS=y
# The TYPED Zephyr carrier entry is C++ (it drives the C component's
# factory/configure seam via ZephyrBoard::run_components) and compiles as
# C++17 (nros-cpp qos.hpp uses mutating constexpr members). The nano-ros API
# choice itself is rendered from system.toml (phase-481, RFC-0098 D11).
CONFIG_STD_CPP17=y

CONFIG_NET_LOG=y
CONFIG_NET_STATISTICS=y
```

## prj-cyclonedds.conf
```kconfig
# Zephyr-native settings the cyclonedds image needs -- named by
# `[image.zephyr_cyclonedds] conf` in system.toml, which the nano-ros module adds
# to the build. The RMW choice and every nano-ros knob are the image's
# (phase-481, RFC-0098 D10/D11): never `CONFIG_NROS_*` here.

CONFIG_CPP=y

# RTPS uses UDP multicast for SPDP discovery.
CONFIG_NET_IPV4_IGMP=y
CONFIG_POSIX_API=y
# Actions exhaust Zephyr's fixed POSIX mutex pool at 256 (each Cyclone
# reader/writer/proxy draws several locks); ddsrt_mutex_init ignores the
# ENOMEM, so the next lock aborts mid-SEDP. Phase 184.8.
CONFIG_MAX_PTHREAD_MUTEX_COUNT=2048
CONFIG_MAX_PTHREAD_COND_COUNT=1024
CONFIG_POSIX_THREAD_THREADS_MAX=16

# Resource sizing — Cyclone is heavy.
CONFIG_MAIN_STACK_SIZE=524288
CONFIG_HEAP_MEM_POOL_SIZE=4194304
CONFIG_SYSTEM_WORKQUEUE_STACK_SIZE=8192

CONFIG_NET_PKT_RX_COUNT=64
CONFIG_NET_PKT_TX_COUNT=64
CONFIG_NET_BUF_RX_COUNT=128
CONFIG_NET_BUF_TX_COUNT=128

# Match the working native_sim Cyclone DDS overlays: use host socket
# offload instead of zeth/TAP and give Cyclone's worker threads/libc
# allocations enough room during participant discovery.
# Issue 1633 -- no COMMON_LIBC_MALLOC_ARENA_SIZE here: ddsrt allocates from the
# nros heap (CONFIG_NROS_ZEPHYR_HEAP_SIZE, 1 MiB with Cyclone) since the Zephyr
# road compiles the platform funnel, and the module's Cyclone default for the
# libc arena (256 KiB) covers what still uses it.
CONFIG_DYNAMIC_THREAD_STACK_SIZE=32768
CONFIG_NET_TCP=y
CONFIG_ASSERT=y
CONFIG_ASSERT_VERBOSE=y
CONFIG_PICOLIBC_ASSERT_VERBOSE=y
CONFIG_LOG_MODE_IMMEDIATE=y
CONFIG_NET_DRIVERS=y
CONFIG_NET_SOCKETS_OFFLOAD=y
CONFIG_NET_NATIVE_OFFLOADED_SOCKETS=y

# Issue 1674 — Cyclone's receive thread select()s over a socket waitset of
# four fds here (self-pipe + three UDP sockets, measured on native_sim), and
# Zephyr's select refuses any set larger than this cap with ENOMEM — the image
# then delivers nothing and floods its console. Zephyr's default is 3. The
# module's Kconfig defaults it to 8 for Cyclone too; it is ALSO stated here
# because a Kconfig default never reaches an existing build dir (Zephyr reloads
# the old .config while the merged fragments are unchanged), and a fragment
# change does.
CONFIG_NET_SOCKETS_POLL_MAX=8
```

## prj-xrce.conf
```kconfig
CONFIG_NROS_RMW_XRCE=y
CONFIG_NROS_XRCE_AGENT_ADDR="127.0.0.1"
CONFIG_NROS_XRCE_AGENT_PORT=2018

CONFIG_NET_TCP=y

CONFIG_MAIN_STACK_SIZE=16384
CONFIG_HEAP_MEM_POOL_SIZE=65536
CONFIG_SYSTEM_WORKQUEUE_STACK_SIZE=4096

CONFIG_NET_PKT_RX_COUNT=32
CONFIG_NET_PKT_TX_COUNT=32
CONFIG_NET_BUF_RX_COUNT=64
CONFIG_NET_BUF_TX_COUNT=64

# Issue 1010 / 1033 — `xrce_session_state_t` is ONE heap allocation out of the
# platform arena (CONFIG_NROS_ZEPHYR_HEAP_SIZE, default 65536), and these three
# caps decide its size at BUILD time. At the crate defaults (8 subscribers / 4
# service servers / 4 service clients) it is 423,824 bytes — 6.4x the whole
# arena in a single request, so the image cannot boot on any host, ever.
#
# STATED rather than derived because a standalone Zephyr application reaches no
# entity inventory: it calls no `nano_ros_entry`, and phase-412 retired the
# `ENTITIES` declaration that used to feed the standalone composer. The cmake
# bridge therefore reports `left to its crate default -- no value stated and
# none derivable` for both -1 knobs, which is what these lines answer. The six
# C++ overlays have carried them since issue 1033; the C and Rust ones had not,
# which is why six of the nine Zephyr XRCE cells died at `Executor::open`.
#
# This image creates: action_client:example_interfaces/action/Fibonacci:/fibonacci
# so: one action client = 3 service clients (send_goal / cancel_goal /
# get_result) + ACTION_CLIENT_SUBSCRIPTIONS (1) subscription (feedback).
CONFIG_NROS_XRCE_MAX_SUBSCRIBERS=1
CONFIG_NROS_XRCE_MAX_SERVICE_SERVERS=0
CONFIG_NROS_XRCE_MAX_SERVICE_CLIENTS=3
```

## src/main.c
```c
/**
 * @file main.c
 * @brief Zephyr C action client (Phase 168.4 collapsed shape).
 */

#include <zephyr/kernel.h>
#include <zephyr/logging/log.h>
#include <zephyr/autoconf.h>

#include <nros/platform_zephyr.h>

LOG_MODULE_REGISTER(nros_action_client, LOG_LEVEL_INF);

#define NROS_CHECK_LOG(file, line, expr, ret)                                                      \
    LOG_ERR("%s:%d %s -> %d", (file), (line), (expr), (int)(ret))

#include <nros/action.h>
#include <nros/app_main.h>
#include <nros/check.h>
#include <nros/executor.h>
#include <nros/init.h>
#include <nros/log.h>
#include <nros/node.h>

#include "example_interfaces.h"

static nros_logger_t g_logger = NULL;

int nros_app_main(int argc, char** argv) {
    (void)argc;
    (void)argv;
    LOG_INF("nros Zephyr Action Client");

    if (nros_platform_zephyr_wait_network(CONFIG_NROS_INIT_DELAY_MS) != 0) {
        LOG_ERR("Network not ready");
        return 1;
    }

    nros_support_t support = nros_support_get_zero_initialized();
#if defined(CONFIG_NROS_RMW_ZENOH)
    NROS_CHECK_RET(nros_support_init(&support, CONFIG_NROS_ZENOH_LOCATOR, CONFIG_NROS_DOMAIN_ID),
                   1);
#elif defined(CONFIG_NROS_RMW_XRCE)
    NROS_CHECK_RET(nros_support_init_named(&support,
                                           CONFIG_NROS_XRCE_AGENT_ADDR
                                           ":" STRINGIFY(CONFIG_NROS_XRCE_AGENT_PORT),
                                           CONFIG_NROS_DOMAIN_ID, "xrce_action_client"),
                   1);
#elif defined(CONFIG_NROS_RMW_CYCLONEDDS)
    NROS_CHECK_RET(nros_support_init(&support, "", CONFIG_NROS_DOMAIN_ID), 1);
#else
#error "Phase 168.4 requires CONFIG_NROS_RMW_{ZENOH,XRCE,CYCLONEDDS}=y"
#endif

    nros_node_t node = nros_node_get_zero_initialized();
    NROS_CHECK_RET(nros_node_init(&node, &support, "zephyr_action_client", "/"), 1);
    g_logger = nros_node_get_logger(&node);

    nros_action_type_t fib_type = {
        .type_name = example_interfaces_action_fibonacci_get_type_name(),
        .type_hash = example_interfaces_action_fibonacci_get_type_hash(),
        .goal_serialized_size_max = 8,
        .result_serialized_size_max = 264,
        .feedback_serialized_size_max = 264,
    };

    nros_action_client_t client = nros_action_client_get_zero_initialized();
    NROS_CHECK_RET(nros_action_client_init(&client, &node, "/fibonacci", &fib_type), 1);

    nros_executor_t executor = nros_executor_get_zero_initialized();
    NROS_CHECK_RET(nros_executor_init(&executor, &support, 4), 1);
    NROS_CHECK_RET(nros_executor_register_action_client(&executor, &client), 1);

    example_interfaces_action_fibonacci_goal goal;
    example_interfaces_action_fibonacci_goal_init(&goal);
    goal.order = 10;

    uint8_t goal_buf[64];
    int32_t goal_len =
        example_interfaces_action_fibonacci_goal_serialize(&goal, goal_buf, sizeof(goal_buf));
    if (goal_len < 0) goto cleanup;

    LOG_INF("Sending goal: order=%d", goal.order);
    nros_goal_uuid_t goal_uuid;
    nros_ret_t ret =
        nros_action_send_goal(&client, &executor, goal_buf, (size_t)goal_len, &goal_uuid);
    if (ret != NROS_RET_OK) {
        LOG_ERR("Send goal failed: %d", ret);
        goto cleanup;
    }

    nros_goal_status_t final_status;
    uint8_t result_buf[512];
    size_t result_len = 0;
    ret = nros_action_get_result(&client, &executor, &goal_uuid, &final_status, result_buf,
                                 sizeof(result_buf), &result_len);
    if (ret == NROS_RET_OK) {
        LOG_INF("Result status: %s", nros_goal_status_to_string(final_status));
        example_interfaces_action_fibonacci_result result;
        if (example_interfaces_action_fibonacci_result_deserialize(&result, result_buf,
                                                                   result_len) == 0) {
            LOG_INF("Sequence length: %u", result.sequence.size);
        }
    } else {
        LOG_ERR("Get result failed: %d", ret);
    }

cleanup:
    nros_executor_fini(&executor);
    nros_action_client_fini(&client);
    nros_node_fini(&node);
    nros_support_fini(&support);
    return 0;
}

NROS_APP_MAIN_REGISTER_ZEPHYR()
```

## src/FibonacciClient.c
```c
/// @file FibonacciClient.c
/// @brief Zephyr C Fibonacci action client — typed component.
///
/// `client_configure` creates an action client with the C API, registers the
/// goal-response / feedback / result callbacks, a poll timer that drains the
/// replies each tick, then sends one goal (`rclc_action_send_goal_async`).
/// Acceptance and the result arrive in the callbacks.

#include <stddef.h>
#include <stdint.h>
#include <stdio.h>

#include <rclc/rclc.h>

#include <example_interfaces/action/fibonacci.h>

typedef struct {
    rcl_action_client_t client;
    rcl_timer_t timer;
    rclc_goal_uuid_t goal_id;
    int32_t order;
} fib_client_t;

/* Print an int32 sequence CDR payload as `<prefix>[0, 1, 1, ...]`. */
static void print_sequence(const char* prefix, const uint8_t* data, size_t len) {
    example_interfaces__action__Fibonacci_Result r;
    example_interfaces__action__Fibonacci_Result__Storage storage;
    example_interfaces__action__Fibonacci_Result__init_in(&r, &storage);
    printf("%s[", prefix);
    if (example_interfaces__action__Fibonacci_Result__deserialize(&r, data, len) == 0) {
        size_t i;
        for (i = 0; i < r.sequence.size; ++i) {
            if (i > 0) {
                printf(", ");
            }
            printf("%d", (int)r.sequence.data[i]);
        }
    }
    printf("]\n");
}

static void on_goal_response(const rclc_goal_uuid_t* goal_id, bool accepted, void* ctx) {
    fib_client_t* self = (fib_client_t*)ctx;
    if (accepted) {
        printf("Goal accepted by server, waiting for result\n");
        (void)rclc_action_get_result_async(&self->client, goal_id);
    } else {
        printf("Goal rejected by server\n");
    }
}

static void on_feedback(const rclc_goal_uuid_t* goal_id, const uint8_t* data, size_t len,
                        void* ctx) {
    (void)goal_id;
    (void)ctx;
    /* Feedback and Result carry the same `int32[] sequence` field. */
    print_sequence("Next number in sequence received: ", data, len);
}

static void on_result(const rclc_goal_uuid_t* goal_id, rclc_goal_status_t status,
                      const uint8_t* data, size_t len, void* ctx) {
    (void)goal_id;
    (void)status;
    (void)ctx;
    print_sequence("Result received: ", data, len);
}

static void on_poll(rcl_timer_t* timer, int64_t last_call_time) {
    fib_client_t* self = RCLC_CONTAINER_OF(timer, fib_client_t, timer);
    (void)last_call_time;
    (void)rclc_action_client_poll(&self->client); /* drain replies -> callbacks */
}

static rcl_ret_t client_configure(rcl_node_t* node, rclc_executor_t* executor, fib_client_t* self) {
    setvbuf(stdout, NULL, _IONBF, 0); /* callbacks print on transitions only */
    self->order = 10;
    self->client = rcl_action_get_zero_initialized_client();
    rcl_ret_t rc = rcl_action_client_init(
        &self->client, node, ROSIDL_GET_ACTION_TYPE_SUPPORT(example_interfaces, action, Fibonacci),
        "/fibonacci", NULL);
    if (rc != RCL_RET_OK) {
        return rc;
    }
    (void)rclc_action_client_set_goal_response_callback(&self->client, on_goal_response, self);
    (void)rclc_action_client_set_feedback_callback(&self->client, on_feedback, self);
    (void)rclc_action_client_set_result_callback(&self->client, on_result, self);
    rc = rclc_executor_attach_action_client(executor, &self->client);
    if (rc != RCL_RET_OK) {
        return rc;
    }
    self->timer = rcl_get_zero_initialized_timer();
    rc = rclc_timer_init_default(&self->timer, NULL, 20ULL * 1000000ULL, on_poll);
    if (rc != RCL_RET_OK) {
        return rc;
    }
    rc = rclc_executor_add_timer(executor, &self->timer);
    if (rc != RCL_RET_OK) {
        return rc;
    }
    /* Send one goal (async — acceptance arrives in on_goal_response). */
    example_interfaces__action__Fibonacci_Goal goal = {.order = self->order};
    uint8_t buf[16];
    size_t n = 0;
    printf("Sending goal\n");
    if (example_interfaces__action__Fibonacci_Goal__serialize(&goal, buf, sizeof(buf), &n) == 0) {
        (void)rclc_action_send_goal_async(&self->client, buf, n, &self->goal_id);
    }
    return RCL_RET_OK;
}

RCLC_C_COMPONENT(fib_client_t, client_configure)
```
