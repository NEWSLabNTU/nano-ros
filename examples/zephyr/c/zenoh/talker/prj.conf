## CMakeLists.txt
```
# SPDX-License-Identifier: Apache-2.0
# nros Zephyr Talker Example (C)

cmake_minimum_required(VERSION 3.20.0)

find_package(Zephyr REQUIRED HINTS $ENV{ZEPHYR_BASE})
project(nros_zephyr_talker_c)

# nros module (CONFIG_NROS=y, CONFIG_NROS_C_API=y) provides zenoh shim,
# platform support, and the nros-c library automatically.

nros_generate_interfaces(std_msgs "msg/Int32.msg")

target_sources(app PRIVATE src/main.c)
```

## prj.conf
```kconfig
# nros Zephyr Talker (C) Configuration
#
# This configuration enables the nros C API and networking.

# =============================================================================
# General
# =============================================================================
CONFIG_MAIN_STACK_SIZE=16384
CONFIG_HEAP_MEM_POOL_SIZE=65536
CONFIG_SYSTEM_WORKQUEUE_STACK_SIZE=4096

# =============================================================================
# Logging
# =============================================================================
CONFIG_LOG=y
CONFIG_LOG_DEFAULT_LEVEL=3
CONFIG_PRINTK=y
CONFIG_EARLY_CONSOLE=y

# Use printk backend for logging (not RTT)
CONFIG_LOG_BACKEND_RTT=n

# =============================================================================
# Networking
# =============================================================================
CONFIG_NETWORKING=y
CONFIG_NET_IPV4=y
CONFIG_NET_TCP=y
CONFIG_NET_UDP=y
CONFIG_NET_SOCKETS=y

# Network buffers
CONFIG_NET_PKT_RX_COUNT=32
CONFIG_NET_PKT_TX_COUNT=32
CONFIG_NET_BUF_RX_COUNT=64
CONFIG_NET_BUF_TX_COUNT=64
CONFIG_NET_MAX_CONTEXTS=16

# Network interface
CONFIG_NET_L2_ETHERNET=y

# DNS (optional)
CONFIG_DNS_RESOLVER=n

# =============================================================================
# POSIX API (required by zenoh-pico)
# =============================================================================
CONFIG_POSIX_API=y

# zenoh-pico allocates POSIX mutexes for transport and write filters.
# Zephyr defaults to 5 which is insufficient for zenoh-pico.
CONFIG_MAX_PTHREAD_MUTEX_COUNT=32
CONFIG_MAX_PTHREAD_COND_COUNT=16

# =============================================================================
# nros Module
# =============================================================================
CONFIG_NROS=y
CONFIG_NROS_C_API=y
CONFIG_NROS_ZENOH_LOCATOR="tcp/127.0.0.1:7556"
CONFIG_NROS_DOMAIN_ID=0

# =============================================================================
# Timing
# =============================================================================
CONFIG_SYS_CLOCK_TICKS_PER_SEC=1000

# =============================================================================
# Debug
# =============================================================================
CONFIG_DEBUG=y
CONFIG_DEBUG_INFO=y

# Network debug logging
CONFIG_NET_LOG=y
CONFIG_NET_STATISTICS=y
CONFIG_NET_SHELL=y
CONFIG_NET_CONNECTION_MANAGER=y
CONFIG_MAX_PTHREAD_COUNT=16
CONFIG_POSIX_THREAD_THREADS_MAX=16
```

## boards/native_sim_native_64.conf
```kconfig
# Native Sim Offloaded Sockets (NSOS) — uses host kernel BSD sockets
# instead of TAP devices. No bridge/root needed. Multiple instances work.
CONFIG_ETH_NATIVE_POSIX=n
CONFIG_NET_DRIVERS=y
CONFIG_NET_SOCKETS_OFFLOAD=y
CONFIG_NET_NATIVE_OFFLOADED_SOCKETS=y
CONFIG_NATIVE_SIM_SLOWDOWN_TO_REAL_TIME=y
# No static IP config needed (NSOS uses host networking)
CONFIG_NET_CONFIG_SETTINGS=n
# Override locator to host loopback (NSOS bypasses TAP bridge)
CONFIG_NROS_ZENOH_LOCATOR="tcp/127.0.0.1:7456"
```

## src/main.c
```c
/**
 * @file main.c
 * @brief Zephyr C talker example using nros-c API
 *
 * This example demonstrates publishing Int32 messages on Zephyr RTOS
 * using the nros C API (nros/init.h, nros/node.h, nros/publisher.h).
 * The nros module handles zenoh initialization and platform support.
 */

#include <zephyr/kernel.h>
#include <zephyr/logging/log.h>

LOG_MODULE_REGISTER(nros_talker, LOG_LEVEL_INF);

// Route NROS_CHECK / NROS_SOFTCHECK through Zephyr's LOG_ERR.
#define NROS_CHECK_LOG(file, line, expr, ret) \
    LOG_ERR("%s:%d %s -> %d", (file), (line), (expr), (int)(ret))

#include <nros/app_main.h>
#include <nros/check.h>
#include <nros/init.h>
#include <nros/log.h>
#include <nros/node.h>
#include <nros/publisher.h>
#include <zpico_zephyr.h>

// Generated message bindings
#include "std_msgs.h"

/* ============================================================================
 * Application
 * ============================================================================ */

// Phase 88.16.G — set after `nros_node_init`; used by post-init
// diagnostics. NULL before init = `NROS_LOG_*` silently drops.
static nros_logger_t g_logger = NULL;

int nros_app_main(int argc, char **argv)
{
    (void)argc;
    (void)argv;

    LOG_INF("nros Zephyr C Talker");
    LOG_INF("=====================");

    /* Wait for network interface */
    if (zpico_zephyr_wait_network(CONFIG_NROS_INIT_DELAY_MS) != 0) {
        LOG_ERR("Network not ready");
        return 1;
    }

    /* Initialize support context */
    nros_support_t support = nros_support_get_zero_initialized();
    NROS_CHECK_RET(nros_support_init(
        &support,
        CONFIG_NROS_ZENOH_LOCATOR,
        CONFIG_NROS_DOMAIN_ID), 1);

    /* Create node */
    nros_node_t node = nros_node_get_zero_initialized();
    NROS_CHECK_RET(nros_node_init(&node, &support, "zephyr_talker", "/"), 1);
    g_logger = nros_node_get_logger(&node);

    /* Create publisher using generated type support */
    nros_publisher_t pub = nros_publisher_get_zero_initialized();
    NROS_CHECK_RET(nros_publisher_init(
        &pub, &node, std_msgs_msg_int32_get_type_support(), "/chatter"), 1);

    /* Publish messages */
    int32_t count = 0;
    std_msgs_msg_int32 msg;
    std_msgs_msg_int32_init(&msg);

    LOG_INF("Publishing messages...");

    while (1) {
        count++;
        msg.data = count;
        NROS_SOFTCHECK(std_msgs_msg_int32_publish(&pub, &msg));
        NROS_LOG_INFO(g_logger, "Published: %d", count);
        k_sleep(K_SECONDS(1));
    }

    /* Cleanup (unreachable in this example) */
    nros_publisher_fini(&pub);
    nros_node_fini(&node);
    nros_support_fini(&support);

    return 0;
}

NROS_APP_MAIN_REGISTER_ZEPHYR()
```
