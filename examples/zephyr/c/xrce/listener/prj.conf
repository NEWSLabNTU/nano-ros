## CMakeLists.txt
```
# SPDX-License-Identifier: Apache-2.0
# nros Zephyr XRCE Listener Example (C)

cmake_minimum_required(VERSION 3.20.0)

find_package(Zephyr REQUIRED HINTS $ENV{ZEPHYR_BASE})
project(nros_zephyr_xrce_listener_c)

# nros module (CONFIG_NROS=y, CONFIG_NROS_C_API=y, CONFIG_NROS_RMW_XRCE=y)
# provides XRCE transport glue and the nros-c library automatically.

nros_generate_interfaces(std_msgs "msg/Int32.msg")

target_sources(app PRIVATE src/main.c)
```

## prj.conf
```kconfig
# nros Zephyr XRCE Listener (C) Configuration
#
# This configuration enables the nros C API with XRCE-DDS backend.

# =============================================================================
# General
# =============================================================================
CONFIG_MAIN_STACK_SIZE=16384
CONFIG_HEAP_MEM_POOL_SIZE=65536
CONFIG_SYSTEM_WORKQUEUE_STACK_SIZE=4096

# =============================================================================
# Logging
# =============================================================================
CONFIG_LOG=y
CONFIG_LOG_DEFAULT_LEVEL=3
CONFIG_PRINTK=y
CONFIG_EARLY_CONSOLE=y

# Use printk backend for logging (not RTT)
CONFIG_LOG_BACKEND_RTT=n

# =============================================================================
# Networking
# =============================================================================
CONFIG_NETWORKING=y
CONFIG_NET_IPV4=y
CONFIG_NET_TCP=y
CONFIG_NET_UDP=y
CONFIG_NET_SOCKETS=y

# Network buffers
CONFIG_NET_PKT_RX_COUNT=32
CONFIG_NET_PKT_TX_COUNT=32
CONFIG_NET_BUF_RX_COUNT=64
CONFIG_NET_BUF_TX_COUNT=64
CONFIG_NET_MAX_CONTEXTS=16

# Network interface
CONFIG_NET_L2_ETHERNET=y

# DNS (optional)
CONFIG_DNS_RESOLVER=n

# =============================================================================
# nros Module
# =============================================================================
CONFIG_NROS=y
CONFIG_NROS_C_API=y
CONFIG_NROS_RMW_XRCE=y
CONFIG_NROS_XRCE_AGENT_ADDR="127.0.0.1"
CONFIG_NROS_XRCE_AGENT_PORT=2018
CONFIG_NROS_DOMAIN_ID=0

# =============================================================================
# Timing
# =============================================================================
CONFIG_SYS_CLOCK_TICKS_PER_SEC=1000

# =============================================================================
# Debug
# =============================================================================
CONFIG_DEBUG=y
CONFIG_DEBUG_INFO=y

# Network debug logging
CONFIG_NET_LOG=y
CONFIG_NET_STATISTICS=y
CONFIG_NET_SHELL=y
CONFIG_NET_CONNECTION_MANAGER=y
CONFIG_MAX_PTHREAD_COUNT=16
CONFIG_POSIX_THREAD_THREADS_MAX=16
```

## src/main.c
```c
/**
 * @file main.c
 * @brief Zephyr C listener example using nros-c API with XRCE-DDS backend
 *
 * This example demonstrates subscribing to Int32 messages on Zephyr RTOS
 * using the nros C API with Micro-XRCE-DDS transport.
 * The nros module handles XRCE transport setup and platform support.
 */

#include <zephyr/kernel.h>
#include <zephyr/logging/log.h>
#include <xrce_zephyr.h>

LOG_MODULE_REGISTER(nros_xrce_listener, LOG_LEVEL_INF);

#define NROS_CHECK_LOG(file, line, expr, ret) \
    LOG_ERR("%s:%d %s -> %d", (file), (line), (expr), (int)(ret))

#include <nros/app_main.h>
#include <nros/check.h>
#include <nros/executor.h>
#include <nros/init.h>
#include <nros/log.h>
#include <nros/node.h>
#include <nros/subscription.h>

/* Generated message bindings */
#include "std_msgs.h"

/* ============================================================================
 * Subscription Callback
 * ============================================================================ */

static int message_count = 0;

static void on_message(const uint8_t *data, size_t len, void *context)
{
    (void)context;

    std_msgs_msg_int32 msg;
    std_msgs_msg_int32_init(&msg);

    if (std_msgs_msg_int32_deserialize(&msg, data, len) == 0) {
        message_count++;
        NROS_LOG_INFO(g_logger, "Received: %d", msg.data);
    } else {
        LOG_ERR("Failed to deserialize message (len=%zu)", len);
    }
}

/* ============================================================================
 * Application
 * ============================================================================ */

int nros_app_main(int argc, char **argv) {
    (void)argc;
    (void)argv;

    LOG_INF("nros Zephyr XRCE C Listener");
    LOG_INF("============================");

    /* Initialize support context (handles network wait + transport setup) */
    if (xrce_zephyr_wait_network(CONFIG_NROS_INIT_DELAY_MS) != 0) {
        return 1;
    }
    nros_support_t support = nros_support_get_zero_initialized();
    NROS_CHECK_RET(nros_support_init_named(
        &support,
        CONFIG_NROS_XRCE_AGENT_ADDR ":" STRINGIFY(CONFIG_NROS_XRCE_AGENT_PORT),
        CONFIG_NROS_DOMAIN_ID,
        "xrce_listener"), 1);

    /* Create node */
    nros_node_t node = nros_node_get_zero_initialized();
    NROS_CHECK_RET(nros_node_init(&node, &support, "zephyr_xrce_listener", "/"), 1);
    g_logger = nros_node_get_logger(&node);

    /* Create subscription using generated type support */
    nros_subscription_t sub = nros_subscription_get_zero_initialized();
    NROS_CHECK_RET(nros_subscription_init(
        &sub, &node, std_msgs_msg_int32_get_type_support(), "/chatter",
        on_message, NULL), 1);

    /* Create executor and add subscription */
    nros_executor_t executor = nros_executor_get_zero_initialized();
    NROS_CHECK_RET(nros_executor_init(&executor, &support, 1), 1);
    NROS_CHECK_RET(nros_executor_register_subscription(
        &executor, &sub, NROS_EXECUTOR_ON_NEW_DATA), 1);

    LOG_INF("Waiting for messages...");

    /* Spin forever — executor dispatches callbacks */
    nros_executor_spin(&executor);

    /* Cleanup (unreachable in this example) */
    nros_executor_fini(&executor);
    nros_subscription_fini(&sub);
    nros_node_fini(&node);
    nros_support_fini(&support);

    return 0;
}

NROS_APP_MAIN_REGISTER_ZEPHYR()
```
