## CMakeLists.txt
```
# SPDX-License-Identifier: Apache-2.0
# nros Zephyr Service Server Example (C, XRCE)

cmake_minimum_required(VERSION 3.20.0)

find_package(Zephyr REQUIRED HINTS $ENV{ZEPHYR_BASE})
project(nros_zephyr_xrce_service_server_c)

nros_generate_interfaces(example_interfaces "srv/AddTwoInts.srv")

target_sources(app PRIVATE src/main.c)
```

## prj.conf
```kconfig
# nros Zephyr Service Server (C, XRCE) Configuration

CONFIG_MAIN_STACK_SIZE=16384
CONFIG_HEAP_MEM_POOL_SIZE=65536
CONFIG_SYSTEM_WORKQUEUE_STACK_SIZE=4096

CONFIG_LOG=y
CONFIG_LOG_DEFAULT_LEVEL=3
CONFIG_PRINTK=y
CONFIG_EARLY_CONSOLE=y
CONFIG_LOG_BACKEND_RTT=n

CONFIG_NETWORKING=y
CONFIG_NET_IPV4=y
CONFIG_NET_TCP=y
CONFIG_NET_UDP=y
CONFIG_NET_SOCKETS=y
CONFIG_NET_PKT_RX_COUNT=32
CONFIG_NET_PKT_TX_COUNT=32
CONFIG_NET_BUF_RX_COUNT=64
CONFIG_NET_BUF_TX_COUNT=64
CONFIG_NET_MAX_CONTEXTS=16
CONFIG_NET_L2_ETHERNET=y
CONFIG_DNS_RESOLVER=n

CONFIG_NROS=y
CONFIG_NROS_C_API=y
CONFIG_NROS_RMW_XRCE=y
CONFIG_NROS_XRCE_AGENT_ADDR="127.0.0.1"
CONFIG_NROS_XRCE_AGENT_PORT=2018
CONFIG_NROS_DOMAIN_ID=0

CONFIG_SYS_CLOCK_TICKS_PER_SEC=1000

CONFIG_DEBUG=y
CONFIG_DEBUG_INFO=y
CONFIG_NET_LOG=y
CONFIG_NET_STATISTICS=y
CONFIG_NET_SHELL=y
CONFIG_NET_CONNECTION_MANAGER=y
CONFIG_MAX_PTHREAD_COUNT=16
CONFIG_POSIX_THREAD_THREADS_MAX=16
```

## src/main.c
```c
/**
 * @file main.c
 * @brief Zephyr C service server example using nros-c API (XRCE)
 */

#include <zephyr/kernel.h>
#include <zephyr/logging/log.h>
#include <xrce_zephyr.h>

LOG_MODULE_REGISTER(nros_xrce_service_server, LOG_LEVEL_INF);

#define NROS_CHECK_LOG(file, line, expr, ret) \
    LOG_ERR("%s:%d %s -> %d", (file), (line), (expr), (int)(ret))

#include <nros/app_main.h>
#include <nros/check.h>
#include <nros/executor.h>
#include <nros/init.h>
#include <nros/log.h>
#include <nros/node.h>
#include <nros/service.h>

#include "example_interfaces.h"

static int g_request_count = 0;

static bool service_callback(const uint8_t* request_data,
                             size_t request_len,
                             uint8_t* response_data,
                             size_t response_capacity,
                             size_t* response_len,
                             void* context) {
    (void)context;

    example_interfaces_srv_add_two_ints_request request;
    if (example_interfaces_srv_add_two_ints_request_deserialize(
            &request, request_data, request_len) != 0) {
        LOG_ERR("Failed to deserialize request");
        return false;
    }

    g_request_count++;

    example_interfaces_srv_add_two_ints_response response;
    example_interfaces_srv_add_two_ints_response_init(&response);
    response.sum = request.a + request.b;

    NROS_LOG_INFO(g_logger, "Request [%d]: %lld + %lld = %lld",
            g_request_count,
            (long long)request.a,
            (long long)request.b,
            (long long)response.sum);

    int32_t len = example_interfaces_srv_add_two_ints_response_serialize(
        &response, response_data, response_capacity);
    if (len < 0) {
        LOG_ERR("Failed to serialize response");
        return false;
    }

    *response_len = (size_t)len;
    return true;
}

int nros_app_main(int argc, char **argv) {
    (void)argc;
    (void)argv;

    LOG_INF("nros Zephyr Service Server (XRCE)");

    /* Initialize support context (handles network wait + transport setup) */
    if (xrce_zephyr_wait_network(CONFIG_NROS_INIT_DELAY_MS) != 0) {
        return 1;
    }
    nros_support_t support = nros_support_get_zero_initialized();
    NROS_CHECK_RET(nros_support_init_named(
        &support,
        CONFIG_NROS_XRCE_AGENT_ADDR ":" STRINGIFY(CONFIG_NROS_XRCE_AGENT_PORT),
        CONFIG_NROS_DOMAIN_ID,
        "xrce_service_server"), 1);

    nros_node_t node = nros_node_get_zero_initialized();
    NROS_CHECK_RET(nros_node_init(&node, &support, "zephyr_xrce_service_server", "/"), 1);
    g_logger = nros_node_get_logger(&node);

    nros_service_type_t type = {
        .type_name = example_interfaces_srv_add_two_ints_get_type_name(),
        .type_hash = example_interfaces_srv_add_two_ints_get_type_hash(),
    };

    nros_service_t service = nros_service_get_zero_initialized();
    NROS_CHECK_RET(nros_service_init(&service, &node, &type, "/add_two_ints", service_callback, NULL), 1);

    nros_executor_t executor = nros_executor_get_zero_initialized();
    NROS_CHECK_RET(nros_executor_init(&executor, &support, 4), 1);
    NROS_CHECK_RET(nros_executor_register_service(&executor, &service), 1);

    LOG_INF("Waiting for requests...");

    nros_executor_spin_period(&executor, 100000000ULL);

    nros_executor_fini(&executor);
    nros_service_fini(&service);
    nros_node_fini(&node);
    nros_support_fini(&support);

    return 0;
}

NROS_APP_MAIN_REGISTER_ZEPHYR()
```
