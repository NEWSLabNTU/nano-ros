## CMakeLists.txt
```
# SPDX-License-Identifier: Apache-2.0
# nros Zephyr Talker (C) — TYPED component (RFC-0043 / phase-244.C2).
#
# Instead of a hand-written imperative `main.c`, the node is a stateful C
# component (`RCLC_C_COMPONENT(talker_t, talker_configure)`); the Zephyr typed
# carrier (the shared entry pack) generates the entry + composes it
# into `app`. The generated typed C bindings (std_msgs) provide the message
# struct + serializer (phase-277 W4; was hand-rolled CDR).

cmake_minimum_required(VERSION 3.20.0)

find_package(Zephyr REQUIRED HINTS $ENV{ZEPHYR_BASE})
project(nros_zephyr_talker_c)

# package.xml SSoT: generate the typed C bindings for the interface closure
# (std_msgs) into `app` — same call the zephyr C service/action examples use.

# Cyclone DDS topic descriptors for this image's interface packages are generated
# by the shared interface pipeline (`zephyr/cmake/nros_generate_interfaces.cmake`)
# when `find_package(<pkg>)` runs below. A hand-written descriptor block here
# used to generate the same descriptors a second time; with the global
# `--allow-multiple-definition` gone (issue 1636) that was a duplicate-symbol
# link error, so it is gone too (issue 1673).

# The Zephyr typed carrier branch (LANGUAGE C) configure_files
# the shared entry pack (`nros dev codegen entry-node`) + compiles src/Talker.c with
# -DNROS_PKG_NAME=<pkg sym> so its RCLC_C_COMPONENT seam links against the
# generated entry, all into the global `app`. No second executable.
find_package(nano_ros REQUIRED)
find_package(std_msgs REQUIRED)

nano_ros_auto_add_library(talker_lib STATIC src/Talker.c)

nros_components_register_node(talker_lib
    PLUGIN nros_zephyr_talker_c::Talker
    EXECUTABLE talker
    SHAPE configure
    TYPED)
```

## sample.yaml
```
# Phase 180.C — nano-ros C talker as a Zephyr sample (Twister-discoverable).
#
# Discovered via the module mechanism: `samples:` in the repo's
# zephyr/module.yml lists this dir, so `zephyr_module.py` emits a
# `-T <repo>/examples/zephyr/c/talker` arg to Twister automatically.
#
# RMW is selected with the module-contributed snippet (Zephyr 4.x): the
# `nros-zenoh` SNIPPET appends the RMW Kconfig fragment — the 4.x-native
# equivalent of the legacy `-DCONF_FILE="...;prj-zenoh.conf"` overlay.
# native_sim NSOS comes from the auto-applied boards/native_sim_*.conf.
#
# build_only: this is a build-coverage sample. A single talker image has
# no peer to receive from, so we assert the boot banner only (the data
# plane is exercised by the nros-tests Zephyr E2E suite, which pairs
# talker+listener with a zenohd router).
sample:
  name: nano-ros C Talker
  description: nano-ros ROS 2 publisher (C API) on Zephyr, zenoh RMW
common:
  tags:
    - nano-ros
    - nros
  harness: console
  harness_config:
    type: one_line
    regex:
      - "nros Zephyr C Talker"
tests:
  sample.nano-ros.c.talker.zenoh:
    build_only: true
    platform_allow:
      - native_sim/native/64
    integration_platforms:
      - native_sim/native/64
    extra_args:
      - SNIPPET=nros-zenoh
```

## prj.conf
```kconfig
# Base config for Zephyr C talker (Phase 168.4 collapsed shape).
# RMW choice + RMW-specific sizing come from prj-<rmw>.conf overlays.

CONFIG_LOG=y
CONFIG_LOG_DEFAULT_LEVEL=3
CONFIG_PRINTK=y
CONFIG_EARLY_CONSOLE=y
CONFIG_LOG_BACKEND_RTT=n

CONFIG_NETWORKING=y
CONFIG_NET_IPV4=y
CONFIG_NET_UDP=y
CONFIG_NET_SOCKETS=y
CONFIG_NET_L2_ETHERNET=y
CONFIG_NET_MAX_CONTEXTS=16
CONFIG_DNS_RESOLVER=n

CONFIG_SYS_CLOCK_TICKS_PER_SEC=1000

CONFIG_NROS=y
CONFIG_NROS_C_API=y
# Phase 244.C2 — the TYPED Zephyr carrier entry is C++ (drives the C component's
# factory/configure seam via ZephyrBoard::run_components), so the nros-cpp header
# surface must be on the app include path, and the carrier compiles as C++14
# (nros-cpp qos.hpp uses mutating constexpr members).
CONFIG_NROS_CPP_API=y
CONFIG_STD_CPP14=y

CONFIG_NET_LOG=y
CONFIG_NET_STATISTICS=y
```

## prj-cyclonedds.conf
```kconfig
# RMW overlay: Cyclone DDS backend (Phase 117 / 169.5).
#

CONFIG_NROS_RMW_CYCLONEDDS=y
CONFIG_CPP=y

# RTPS uses UDP multicast for SPDP discovery.
CONFIG_NET_IPV4_IGMP=y
CONFIG_POSIX_API=y
CONFIG_MAX_PTHREAD_MUTEX_COUNT=256
CONFIG_MAX_PTHREAD_COND_COUNT=256
CONFIG_POSIX_THREAD_THREADS_MAX=16

# Resource sizing — Cyclone is heavy.
CONFIG_MAIN_STACK_SIZE=524288
CONFIG_HEAP_MEM_POOL_SIZE=4194304
CONFIG_SYSTEM_WORKQUEUE_STACK_SIZE=8192

CONFIG_NET_PKT_RX_COUNT=64
CONFIG_NET_PKT_TX_COUNT=64
CONFIG_NET_BUF_RX_COUNT=128
CONFIG_NET_BUF_TX_COUNT=128

# Phase 11W.12 — runtime parity with the Rust cyclonedds overlay.
# The universal bool configs (THREAD_LOCAL_STORAGE / THREAD_CUSTOM_DATA
# / DYNAMIC_THREAD(+ALLOC) / THREAD_STACK_INFO / THREAD_MONITOR) come
# from CONFIG_NROS_RMW_CYCLONEDDS in zephyr/Kconfig. The int knobs +
# native_sim NSOS offload are example-local:
#   DYNAMIC_THREAD_STACK_SIZE — per-worker-thread stack.
# Issue 1633 -- no COMMON_LIBC_MALLOC_ARENA_SIZE here: ddsrt allocates from the
# nros heap (CONFIG_NROS_ZEPHYR_HEAP_SIZE, 1 MiB with Cyclone) since the Zephyr
# road compiles the platform funnel, and the module's Cyclone default for the
# libc arena (256 KiB) covers what still uses it.
CONFIG_DYNAMIC_THREAD_STACK_SIZE=32768

# NET_TCP — sockwaitset self-pipe (loopback TCP socket pair). Kept
# here because selecting it from NROS_RMW_CYCLONEDDS forms a Kconfig
# dependency loop through NET_SOCKETS.
CONFIG_NET_TCP=y

# Diagnostics — verbose asserts + immediate logging keep Cyclone init
# failures legible (picolibc drops fprintf(stderr)).
CONFIG_ASSERT=y
CONFIG_ASSERT_VERBOSE=y
CONFIG_PICOLIBC_ASSERT_VERBOSE=y
CONFIG_LOG_MODE_IMMEDIATE=y

# Phase 11W.8 — force NSOS (board overlay not auto-applied under
# explicit CONF_FILE). Host BSD sockets instead of zeth/TAP.
# native_sim-only; real hardware uses its actual net stack.
CONFIG_NET_DRIVERS=y
CONFIG_NET_SOCKETS_OFFLOAD=y
CONFIG_NET_NATIVE_OFFLOADED_SOCKETS=y

# Issue 1674 — Cyclone's receive thread select()s over a socket waitset of
# four fds here (self-pipe + three UDP sockets, measured on native_sim), and
# Zephyr's select refuses any set larger than this cap with ENOMEM — the image
# then delivers nothing and floods its console. Zephyr's default is 3. The
# module's Kconfig defaults it to 8 for Cyclone too; it is ALSO stated here
# because a Kconfig default never reaches an existing build dir (Zephyr reloads
# the old .config while the merged fragments are unchanged), and a fragment
# change does.
CONFIG_NET_SOCKETS_POLL_MAX=8
```

## prj-xrce.conf
```kconfig
# Zephyr-native settings the xrce image needs -- named by
# `[image.zephyr_xrce] conf` in system.toml, which the nano-ros module adds
# to the build. The RMW choice and every nano-ros knob are the image's
# (phase-481, RFC-0098 D10/D11): never `CONFIG_NROS_*` here.

CONFIG_NET_TCP=y

# CONFIG_MAIN_STACK_SIZE: the nano-ros module decides it per image (issue 2365)
# phase-391 W3 made the nano-ros allocation funnel rlsf-backed (nros-platform's
# zephyr_heap arena, NROS_ZEPHYR_HEAP_SIZE, default 64 KiB — the size this knob
# used to be), so NOTHING NANO-ROS OWNS allocates from the kernel system heap
# any more.
#
# That is not the same as "nothing in the image does", which is what this file
# briefly claimed (issue 0876). On native_sim, Zephyr's own offloaded-socket
# driver `drivers/net/nsos_sockets.c` calls `k_malloc` once per socket and
# `k_calloc` for sendmsg/recvmsg iovecs and getaddrinfo results, and asserts
# `CONFIG_HEAP_MEM_POOL_SIZE > 0` at compile time. Setting 0 here stopped the
# native_sim image from BUILDING; it went unnoticed for a day only because no
# native_sim build dir had reconfigured since.
#
# There is no board where the 0 was doing anything. mps2_an385 — the coordinate
# W3 measured — appends `packages/boards/nros-board-mps2-an385-zephyr/prj.conf` LAST, and that file sets
# `CONFIG_HEAP_MEM_POOL_SIZE=131072` unconditionally, so the 0 here was already
# being overridden there. Its only live effect in the whole fixture set was to
# break native_sim. If the saving is wanted on mps2, it has to be argued in
# `packages/boards/nros-board-mps2-an385-zephyr/prj.conf` — where it applies to every mps2 leaf, not just
# this one — and re-measured there.
CONFIG_HEAP_MEM_POOL_SIZE=65536
CONFIG_SYSTEM_WORKQUEUE_STACK_SIZE=4096

CONFIG_NET_PKT_RX_COUNT=32
CONFIG_NET_PKT_TX_COUNT=32
CONFIG_NET_BUF_RX_COUNT=64
CONFIG_NET_BUF_TX_COUNT=64
```

## prj-zenoh.conf
```kconfig
# Zephyr-native settings the zenoh image needs -- named by
# `[image.zephyr_zenoh] conf` in system.toml, which the nano-ros module adds
# to the build. The RMW choice and every nano-ros knob are the image's
# (phase-481, RFC-0098 D10/D11): never `CONFIG_NROS_*` here.

CONFIG_NET_TCP=y
CONFIG_POSIX_API=y
# 64, not 32 — the build derives a floor and refuses below it; see
# `_nros_mutex_floor` in `zephyr/cmake/nros_cargo_build.cmake`.
CONFIG_MAX_PTHREAD_MUTEX_COUNT=64
CONFIG_MAX_PTHREAD_COND_COUNT=16
CONFIG_POSIX_THREAD_THREADS_MAX=16

# CONFIG_MAIN_STACK_SIZE: the nano-ros module decides it per image (issue 2365)
# phase-391 W3 made the nano-ros allocation funnel rlsf-backed (nros-platform's
# zephyr_heap arena, NROS_ZEPHYR_HEAP_SIZE, default 64 KiB — the size this knob
# used to be), so NOTHING NANO-ROS OWNS allocates from the kernel system heap
# any more.
#
# That is not the same as "nothing in the image does", which is what this file
# briefly claimed (issue 0876). On native_sim, Zephyr's own offloaded-socket
# driver `drivers/net/nsos_sockets.c` calls `k_malloc` once per socket and
# `k_calloc` for sendmsg/recvmsg iovecs and getaddrinfo results, and asserts
# `CONFIG_HEAP_MEM_POOL_SIZE > 0` at compile time. Setting 0 here stopped the
# native_sim image from BUILDING; it went unnoticed for a day only because no
# native_sim build dir had reconfigured since.
#
# There is no board where the 0 was doing anything. mps2_an385 — the coordinate
# W3 measured — appends `packages/boards/nros-board-mps2-an385-zephyr/prj.conf` LAST, and that file sets
# `CONFIG_HEAP_MEM_POOL_SIZE=131072` unconditionally, so the 0 here was already
# being overridden there. Its only live effect in the whole fixture set was to
# break native_sim. If the saving is wanted on mps2, it has to be argued in
# `packages/boards/nros-board-mps2-an385-zephyr/prj.conf` — where it applies to every mps2 leaf, not just
# this one — and re-measured there.
CONFIG_HEAP_MEM_POOL_SIZE=65536
CONFIG_SYSTEM_WORKQUEUE_STACK_SIZE=4096

CONFIG_NET_PKT_RX_COUNT=32
CONFIG_NET_PKT_TX_COUNT=32
CONFIG_NET_BUF_RX_COUNT=64
CONFIG_NET_BUF_TX_COUNT=64
```

## src/main.c
```c
/**
 * @file main.c
 * @brief Zephyr C talker example (Phase 168.4 collapsed shape).
 *
 * Single source, three RMW backends. RMW choice flows from
 * `prj-<rmw>.conf` overlay → Kconfig `CONFIG_NROS_RMW_<X>` →
 * `#if defined(CONFIG_NROS_RMW_<X>)` blocks below.
 */

#include <zephyr/kernel.h>
#include <zephyr/logging/log.h>
#include <zephyr/autoconf.h>

#include <nros/platform_zephyr.h>

LOG_MODULE_REGISTER(nros_talker, LOG_LEVEL_INF);

#define NROS_CHECK_LOG(file, line, expr, ret)                                                      \
    LOG_ERR("%s:%d %s -> %d", (file), (line), (expr), (int)(ret))

#include <nros/app_main.h>
#include <nros/check.h>
#include <nros/init.h>
#include <nros/log.h>
#include <nros/node.h>
#include <nros/publisher.h>

#include "std_msgs.h"

static nros_logger_t g_logger = NULL;

int nros_app_main(int argc, char** argv) {
    (void)argc;
    (void)argv;

    LOG_INF("nros Zephyr C Talker");

    if (nros_platform_zephyr_wait_network(CONFIG_NROS_INIT_DELAY_MS) != 0) {
        LOG_ERR("Network not ready");
        return 1;
    }

    nros_support_t support = nros_support_get_zero_initialized();
#if defined(CONFIG_NROS_RMW_ZENOH)
    NROS_CHECK_RET(nros_support_init(&support, CONFIG_NROS_ZENOH_LOCATOR, CONFIG_NROS_DOMAIN_ID),
                   1);
#elif defined(CONFIG_NROS_RMW_XRCE)
    NROS_CHECK_RET(nros_support_init_named(&support,
                                           CONFIG_NROS_XRCE_AGENT_ADDR
                                           ":" STRINGIFY(CONFIG_NROS_XRCE_AGENT_PORT),
                                           CONFIG_NROS_DOMAIN_ID, "xrce_talker"),
                   1);
#elif defined(CONFIG_NROS_RMW_CYCLONEDDS)
    NROS_CHECK_RET(nros_support_init(&support, "", CONFIG_NROS_DOMAIN_ID), 1);
#else
#error "Phase 168.4 requires CONFIG_NROS_RMW_{ZENOH,XRCE,CYCLONEDDS}=y via prj-<rmw>.conf overlay"
#endif

    nros_node_t node = nros_node_get_zero_initialized();
    NROS_CHECK_RET(nros_node_init(&node, &support, "zephyr_talker", "/"), 1);
    g_logger = nros_node_get_logger(&node);

    nros_publisher_t pub = nros_publisher_get_zero_initialized();
    NROS_CHECK_RET(
        nros_publisher_init(&pub, &node, std_msgs_msg_int32_get_type_support(), "/chatter"), 1);

    int32_t count = 0;
    std_msgs_msg_int32 msg;
    std_msgs_msg_int32_init(&msg);

    LOG_INF("Publishing messages...");

    while (1) {
        // Post-increment so the first publish is 0, matching ROS demo nodes
        // (rclpy_demos `talker.py`, rclcpp_demos `talker.cpp`). Phase 208.D.9.
        msg.data = count;
        NROS_SOFTCHECK(std_msgs_msg_int32_publish(&pub, &msg));
        NROS_LOG_INFO(g_logger, "Published: %d", count);
        count++;
        k_sleep(K_SECONDS(1));
    }

    nros_publisher_fini(&pub);
    nros_node_fini(&node);
    nros_support_fini(&support);

    return 0;
}

NROS_APP_MAIN_REGISTER_ZEPHYR()
```

## src/Talker.c
```c
/// @file Talker.c
/// @brief Zephyr C talker — typed component (RFC-0043 / phase-244.C2).
///
/// `talker_configure` creates a publisher on `/chatter` + a timer that
/// publishes the official ROS 2 demo payload (`std_msgs/String`,
/// `Hello World: N`) each tick, via the GENERATED typed C bindings
/// (`nros_find_interfaces(LANGUAGE C)` in CMakeLists — phase-277 W4; was
/// hand-rolled CDR). `RCLC_C_COMPONENT` emits the C-ABI factory/configure the
/// Zephyr typed Entry carrier (the shared entry pack) calls.

#include <stddef.h>
#include <stdint.h>
#include <stdio.h>
#include <string.h>

#include <rclc/rclc.h>

#include <std_msgs/msg/string.h>

typedef struct {
    rcl_publisher_t pub;
    rcl_timer_t timer;
    int32_t count;
    /* The message lives in the component (not the tick stack): String is
     * ~256 B and RTOS timer/app stacks are small. */
    std_msgs__msg__String msg;
    /* The bytes behind `msg.data` (phase-492 W7), wired once in configure. */
    std_msgs__msg__String__Storage msg_storage;
} talker_t;

static void on_tick(rcl_timer_t* timer, void* ctx) {
    (void)timer;
    talker_t* self = (talker_t*)ctx;
    /* Pre-increment so the first payload is "Hello World: 1", matching the
     * official ROS 2 demo talker. */
    self->count++;
    snprintf(self->msg.data.data, self->msg.data.capacity, "Hello World: %d", (int)self->count);
    self->msg.data.size = strlen(self->msg.data.data);
    /* `rcl_publish` serializes into a buffer bounded at build time from the
     * type's declared size (phase-492 W8). */
    if (rcl_publish(&self->pub, &self->msg, NULL) == RCL_RET_OK) {
        printf("Publishing: '%s'\n", self->msg.data.data);
    }
}

static rcl_ret_t talker_configure(rcl_node_t* node, rclc_executor_t* executor, talker_t* self) {
    setvbuf(stdout, NULL, _IONBF, 0);
    self->count = 0;
    std_msgs__msg__String__init_in(&self->msg, &self->msg_storage);
    self->pub = rcl_get_zero_initialized_publisher();
    rcl_ret_t rc = rclc_publisher_init_default(
        &self->pub, node, ROSIDL_GET_MSG_TYPE_SUPPORT(std_msgs, msg, String), "/chatter");
    if (rc != RCL_RET_OK) {
        return rc;
    }
    self->timer = rcl_get_zero_initialized_timer();
    rcl_ret_t trc = rclc_timer_init_with_context(&self->timer, 500ULL * 1000000ULL, on_tick, self);
    if (trc != RCL_RET_OK) {
        return trc;
    }
    return rclc_executor_add_timer(executor, &self->timer);
}

RCLC_C_COMPONENT(talker_t, talker_configure)
```
