## CMakeLists.txt
```
# SPDX-License-Identifier: Apache-2.0
# nros Zephyr Service Server Example (C++)

cmake_minimum_required(VERSION 3.20.0)

find_package(Zephyr REQUIRED HINTS $ENV{ZEPHYR_BASE})
project(nros_zephyr_service_server_cpp LANGUAGES CXX)

# nros module (CONFIG_NROS=y, CONFIG_NROS_CPP_API=y) provides zenoh shim,
# platform support, and the nros-cpp library automatically.

nros_generate_interfaces(example_interfaces
    "srv/AddTwoInts.srv"
    LANGUAGE CPP
)

target_sources(app PRIVATE src/main.cpp)
```

## prj.conf
```kconfig
# nros Zephyr Service Server (C++) Configuration
#
# This configuration enables the nros C++ API and networking.

# =============================================================================
# General
# =============================================================================
CONFIG_MAIN_STACK_SIZE=16384
CONFIG_HEAP_MEM_POOL_SIZE=65536
CONFIG_SYSTEM_WORKQUEUE_STACK_SIZE=4096

# =============================================================================
# C++ Support
# =============================================================================
CONFIG_CPP=y
CONFIG_STD_CPP14=y

# =============================================================================
# Logging
# =============================================================================
CONFIG_LOG=y
CONFIG_LOG_DEFAULT_LEVEL=3
CONFIG_PRINTK=y
CONFIG_EARLY_CONSOLE=y

# Use printk backend for logging (not RTT)
CONFIG_LOG_BACKEND_RTT=n

# =============================================================================
# Networking
# =============================================================================
CONFIG_NETWORKING=y
CONFIG_NET_IPV4=y
CONFIG_NET_TCP=y
CONFIG_NET_UDP=y
CONFIG_NET_SOCKETS=y

# Network buffers
CONFIG_NET_PKT_RX_COUNT=32
CONFIG_NET_PKT_TX_COUNT=32
CONFIG_NET_BUF_RX_COUNT=64
CONFIG_NET_BUF_TX_COUNT=64
CONFIG_NET_MAX_CONTEXTS=16

# Network interface
CONFIG_NET_L2_ETHERNET=y

# DNS (optional)
CONFIG_DNS_RESOLVER=n

# =============================================================================
# POSIX API (required by zenoh-pico)
# =============================================================================
CONFIG_POSIX_API=y

# zenoh-pico allocates POSIX mutexes for transport and write filters.
# Zephyr defaults to 5 which is insufficient for zenoh-pico.
CONFIG_MAX_PTHREAD_MUTEX_COUNT=32
CONFIG_MAX_PTHREAD_COND_COUNT=16

# =============================================================================
# nros Module
# =============================================================================
CONFIG_NROS=y
CONFIG_NROS_CPP_API=y
CONFIG_NROS_ZENOH_LOCATOR="tcp/127.0.0.1:7666"
CONFIG_NROS_DOMAIN_ID=0

# =============================================================================
# Timing
# =============================================================================
CONFIG_SYS_CLOCK_TICKS_PER_SEC=1000

# =============================================================================
# Debug
# =============================================================================
CONFIG_DEBUG=y
CONFIG_DEBUG_INFO=y

# Network debug logging
CONFIG_NET_LOG=y
CONFIG_NET_STATISTICS=y
CONFIG_NET_SHELL=y
CONFIG_NET_CONNECTION_MANAGER=y
CONFIG_MAX_PTHREAD_COUNT=16
CONFIG_POSIX_THREAD_THREADS_MAX=16
```

## src/main.cpp
```c
/**
 * @file main.cpp
 * @brief Zephyr C++ service server example using nros-cpp API
 *
 * This example demonstrates handling AddTwoInts service requests on Zephyr RTOS
 * using the nros C++ API (nros::init, nros::Node, nros::Service<S>).
 * Uses manual-poll with spin_once() + try_recv_request().
 * The nros module handles zenoh initialization and platform support.
 */

#include <zephyr/kernel.h>
#include <zephyr/logging/log.h>

LOG_MODULE_REGISTER(nros_cpp_service_server, LOG_LEVEL_INF);

#define NROS_TRY_LOG(file, line, expr, ret) \
    LOG_ERR("%s:%d %s -> %d", (file), (line), (expr), (int)(ret))

extern "C" {
#include <zpico_zephyr.h>
}

#include <nros/app_main.h>
#include <nros/log.hpp>
#include <nros/nros.hpp>

// Generated C++ service bindings
#include "example_interfaces.hpp"

/* ============================================================================
 * Application
 * ============================================================================ */

// Phase 88.16.G — set after `nros::create_node`; used by post-init
// diagnostics. nullptr before init = `NROS_LOG_*` silently drops.
static nros_logger_t g_logger = nullptr;

int nros_app_main(int argc, char **argv) {
    (void)argc;
    (void)argv;

    LOG_INF("nros Zephyr C++ Service Server");
    LOG_INF("================================");

    /* Wait for network interface */
    if (zpico_zephyr_wait_network(CONFIG_NROS_INIT_DELAY_MS) != 0) {
        LOG_ERR("Network not ready");
        return 1;
    }

    NROS_TRY_RET(nros::init(CONFIG_NROS_ZENOH_LOCATOR, CONFIG_NROS_DOMAIN_ID), 1);

    nros::Node node;
    NROS_TRY_RET(nros::create_node(node, "zephyr_cpp_service_server"), 1);
    g_logger = node.get_logger();

    nros::Service<example_interfaces::srv::AddTwoInts> srv;
    NROS_TRY_RET(node.create_service(srv, "/add_two_ints"), 1);
    nros::Result ret;

    /* Spin + poll loop */
    LOG_INF("Waiting for service requests...");

    int request_count = 0;

    while (true) {
        nros::spin_once(100);

        example_interfaces::srv::AddTwoInts::Request req;
        int64_t seq_id = 0;
        while (srv.try_recv_request(req, seq_id)) {
            request_count++;

            example_interfaces::srv::AddTwoInts::Response resp;
            resp.sum = req.a + req.b;

            NROS_LOG_INFO(g_logger, "Request [%d]: %lld + %lld = %lld", request_count,
                    static_cast<long long>(req.a), static_cast<long long>(req.b),
                    static_cast<long long>(resp.sum));

            ret = srv.send_reply(seq_id, resp);
            if (!ret.ok()) {
                LOG_ERR("Failed to send reply: %d", ret.raw());
            }
        }
    }

    /* Cleanup (unreachable in this example) */
    nros::shutdown();

    return 0;
}

NROS_APP_MAIN_REGISTER_ZEPHYR()
```
