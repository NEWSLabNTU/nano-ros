## CMakeLists.txt
```
# SPDX-License-Identifier: Apache-2.0
# nros Zephyr Action Client Example (C++)

cmake_minimum_required(VERSION 3.20.0)

find_package(Zephyr REQUIRED HINTS $ENV{ZEPHYR_BASE})
project(nros_zephyr_action_client_cpp LANGUAGES CXX)

# nros module (CONFIG_NROS=y, CONFIG_NROS_CPP_API=y) provides zenoh shim,
# platform support, and the nros-cpp library automatically.

nros_generate_interfaces(example_interfaces
    "action/Fibonacci.action"
    LANGUAGE CPP
)

target_sources(app PRIVATE src/main.cpp)
```

## prj.conf
```kconfig
# nros Zephyr Action Client (C++) Configuration
#
# This configuration enables the nros C++ API and networking.

# =============================================================================
# General
# =============================================================================
CONFIG_MAIN_STACK_SIZE=16384
CONFIG_HEAP_MEM_POOL_SIZE=65536
CONFIG_SYSTEM_WORKQUEUE_STACK_SIZE=4096

# =============================================================================
# C++ Support
# =============================================================================
CONFIG_CPP=y
CONFIG_STD_CPP14=y

# =============================================================================
# Logging
# =============================================================================
CONFIG_LOG=y
CONFIG_LOG_DEFAULT_LEVEL=3
CONFIG_PRINTK=y
CONFIG_EARLY_CONSOLE=y

# Use printk backend for logging (not RTT)
CONFIG_LOG_BACKEND_RTT=n

# =============================================================================
# Networking
# =============================================================================
CONFIG_NETWORKING=y
CONFIG_NET_IPV4=y
CONFIG_NET_TCP=y
CONFIG_NET_UDP=y
CONFIG_NET_SOCKETS=y

# Network buffers
CONFIG_NET_PKT_RX_COUNT=32
CONFIG_NET_PKT_TX_COUNT=32
CONFIG_NET_BUF_RX_COUNT=64
CONFIG_NET_BUF_TX_COUNT=64
CONFIG_NET_MAX_CONTEXTS=16

# Network interface
CONFIG_NET_L2_ETHERNET=y

# DNS (optional)
CONFIG_DNS_RESOLVER=n

# =============================================================================
# POSIX API (required by zenoh-pico)
# =============================================================================
CONFIG_POSIX_API=y

# zenoh-pico allocates POSIX mutexes for transport and write filters.
# Zephyr defaults to 5 which is insufficient for zenoh-pico.
CONFIG_MAX_PTHREAD_MUTEX_COUNT=32
CONFIG_MAX_PTHREAD_COND_COUNT=16

# Phase 160.C.2 — action client mirrors server: 3 service-client
# queryables + 1 subscriber back-to-back. Same batch-overflow fix
# (vendor default 2048 B).
CONFIG_NROS_BATCH_UNICAST_SIZE=2048
CONFIG_NROS_FRAG_MAX_SIZE=4096

# =============================================================================
# nros Module
# =============================================================================
CONFIG_NROS=y
CONFIG_NROS_CPP_API=y
CONFIG_NROS_ZENOH_LOCATOR="tcp/127.0.0.1:7676"
CONFIG_NROS_DOMAIN_ID=0

# =============================================================================
# Timing
# =============================================================================
CONFIG_SYS_CLOCK_TICKS_PER_SEC=1000

# =============================================================================
# Debug
# =============================================================================
CONFIG_DEBUG=y
CONFIG_DEBUG_INFO=y

# Network debug logging
CONFIG_NET_LOG=y
CONFIG_NET_STATISTICS=y
CONFIG_NET_SHELL=y
CONFIG_NET_CONNECTION_MANAGER=y
CONFIG_MAX_PTHREAD_COUNT=16
CONFIG_POSIX_THREAD_THREADS_MAX=16
```

## src/main.cpp
```c
/**
 * @file main.cpp
 * @brief Zephyr C++ action client example using nros-cpp API
 *
 * Sends a goal asynchronously, polls for feedback, then retrieves
 * the result via Future::wait (executor-driven, no blocking zpico_get).
 */

#include <zephyr/kernel.h>
#include <zephyr/logging/log.h>

LOG_MODULE_REGISTER(nros_cpp_action_client, LOG_LEVEL_INF);

#define NROS_TRY_LOG(file, line, expr, ret) \
    LOG_ERR("%s:%d %s -> %d", (file), (line), (expr), (int)(ret))

extern "C" {
#include <zpico_zephyr.h>
}

#include <nros/app_main.h>
#include <nros/log.hpp>
#include <nros/nros.hpp>

// Generated C++ action bindings
#include "example_interfaces.hpp"

// Phase 88.16.G — set after `nros::create_node`; used by post-init
// diagnostics. nullptr before init = `NROS_LOG_*` silently drops.
static nros_logger_t g_logger = nullptr;

int nros_app_main(int argc, char **argv) {
    (void)argc;
    (void)argv;

    LOG_INF("nros Zephyr C++ Action Client");
    LOG_INF("===============================");

    /* Wait for network interface */
    if (zpico_zephyr_wait_network(CONFIG_NROS_INIT_DELAY_MS) != 0) {
        LOG_ERR("Network not ready");
        return 1;
    }

    NROS_TRY_RET(nros::init(CONFIG_NROS_ZENOH_LOCATOR, CONFIG_NROS_DOMAIN_ID), 1);

    nros::Node node;
    NROS_TRY_RET(nros::create_node(node, "zephyr_cpp_action_client"), 1);
    g_logger = node.get_logger();

    using Fibonacci = example_interfaces::action::Fibonacci;
    nros::ActionClient<Fibonacci> client;
    NROS_TRY_RET(node.create_action_client(client, "/fibonacci"), 1);
    nros::Result ret;

    /* Warm-up spin — allow zenoh discovery to complete */
    for (int i = 0; i < 30; i++) {
        nros::spin_once(100);
    }

    /* Send goal (blocking convenience — spins executor internally) */
    int32_t order = 10;
    LOG_INF("Sending goal: order=%d", order);

    Fibonacci::Goal goal;
    goal.order = order;

    uint8_t goal_id[16];
    ret = client.send_goal(goal, goal_id);
    if (!ret.ok()) {
        LOG_ERR("Failed to send goal: %d", ret.raw());
        nros::shutdown();
        return 1;
    }
    NROS_LOG_INFO(g_logger, "Goal sent: order=%d", order);

    /* Poll for feedback while waiting for server to complete */
    for (int i = 0; i < 30; i++) {
        nros::spin_once(100);

        Fibonacci::Feedback fb;
        while (client.try_recv_feedback(fb)) {
            NROS_LOG_INFO(g_logger, "Feedback: sequence length=%d", fb.sequence.length());
        }
    }

    /* Get result via async Future (executor-driven, no blocking zpico_get) */
    auto result_fut = client.get_result_future(goal_id);
    Fibonacci::Result result;
    ret = result_fut.wait(nros::global_handle(), 10000, result);
    if (ret.ok()) {
        LOG_INF("Result received: sequence length=%d", result.sequence.length());
        LOG_INF("[OK]");
    } else {
        LOG_ERR("Failed to get result: %d", ret.raw());
        LOG_ERR("[FAIL]");
    }

    /* Cleanup */
    nros::shutdown();

    return 0;
}

NROS_APP_MAIN_REGISTER_ZEPHYR()
```
