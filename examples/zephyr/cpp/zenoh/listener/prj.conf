## CMakeLists.txt
```
# SPDX-License-Identifier: Apache-2.0
# nros Zephyr Listener Example (C++)

cmake_minimum_required(VERSION 3.20.0)

find_package(Zephyr REQUIRED HINTS $ENV{ZEPHYR_BASE})
project(nros_zephyr_listener_cpp LANGUAGES CXX)

# nros module (CONFIG_NROS=y, CONFIG_NROS_CPP_API=y) provides zenoh shim,
# platform support, and the nros-cpp-ffi library automatically.

nros_generate_interfaces(std_msgs LANGUAGE CPP)

target_sources(app PRIVATE src/main.cpp)
```

## prj.conf
```kconfig
# nros Zephyr Listener (C++) Configuration
#
# This configuration enables the nros C++ API and networking.

# =============================================================================
# General
# =============================================================================
CONFIG_MAIN_STACK_SIZE=16384
CONFIG_HEAP_MEM_POOL_SIZE=65536
CONFIG_SYSTEM_WORKQUEUE_STACK_SIZE=4096

# =============================================================================
# C++ Support
# =============================================================================
CONFIG_CPP=y
CONFIG_STD_CPP14=y

# =============================================================================
# Logging
# =============================================================================
CONFIG_LOG=y
CONFIG_LOG_DEFAULT_LEVEL=3
CONFIG_PRINTK=y
CONFIG_EARLY_CONSOLE=y

# Use printk backend for logging (not RTT)
CONFIG_LOG_BACKEND_RTT=n

# =============================================================================
# Networking
# =============================================================================
CONFIG_NETWORKING=y
CONFIG_NET_IPV4=y
CONFIG_NET_TCP=y
CONFIG_NET_UDP=y
CONFIG_NET_SOCKETS=y

# Network buffers
CONFIG_NET_PKT_RX_COUNT=32
CONFIG_NET_PKT_TX_COUNT=32
CONFIG_NET_BUF_RX_COUNT=64
CONFIG_NET_BUF_TX_COUNT=64
CONFIG_NET_MAX_CONTEXTS=16

# Network interface
CONFIG_NET_L2_ETHERNET=y

# DNS (optional)
CONFIG_DNS_RESOLVER=n

# =============================================================================
# POSIX API (required by zenoh-pico)
# =============================================================================
CONFIG_POSIX_API=y

# zenoh-pico allocates POSIX mutexes for transport and write filters.
# Zephyr defaults to 5 which is insufficient for zenoh-pico.
CONFIG_MAX_PTHREAD_MUTEX_COUNT=32
CONFIG_MAX_PTHREAD_COND_COUNT=16

# =============================================================================
# nros Module
# =============================================================================
CONFIG_NROS=y
CONFIG_NROS_CPP_API=y
CONFIG_NROS_ZENOH_LOCATOR="tcp/127.0.0.1:7656"
CONFIG_NROS_DOMAIN_ID=0

# =============================================================================
# Timing
# =============================================================================
CONFIG_SYS_CLOCK_TICKS_PER_SEC=1000

# =============================================================================
# Debug
# =============================================================================
CONFIG_DEBUG=y
CONFIG_DEBUG_INFO=y

# Network debug logging
CONFIG_NET_LOG=y
CONFIG_NET_STATISTICS=y
CONFIG_NET_SHELL=y
CONFIG_NET_CONNECTION_MANAGER=y
CONFIG_MAX_PTHREAD_COUNT=16
CONFIG_POSIX_THREAD_THREADS_MAX=16
```

## src/main.cpp
```c
/**
 * @file main.cpp
 * @brief Zephyr C++ listener example using nros-cpp API
 *
 * This example demonstrates subscribing to Int32 messages on Zephyr RTOS
 * using the nros C++ API (nros::init, nros::Node, nros::Subscription<M>).
 * Uses manual-poll with spin_once() + try_recv().
 * The nros module handles zenoh initialization and platform support.
 */

#include <zephyr/kernel.h>
#include <zephyr/logging/log.h>

LOG_MODULE_REGISTER(nros_cpp_listener, LOG_LEVEL_INF);

#define NROS_TRY_LOG(file, line, expr, ret) \
    LOG_ERR("%s:%d %s -> %d", (file), (line), (expr), (int)(ret))

extern "C" {
#include <zpico_zephyr.h>
}

#include <nros/app_main.h>
#include <nros/log.hpp>
#include <nros/nros.hpp>

// Generated C++ message bindings
#include "std_msgs.hpp"

/* ============================================================================
 * Application
 * ============================================================================ */

// Phase 88.16.G — set after `nros::create_node`; used by post-init
// diagnostics. nullptr before init = `NROS_LOG_*` silently drops.
static nros_logger_t g_logger = nullptr;

int nros_app_main(int argc, char **argv) {
    (void)argc;
    (void)argv;

    LOG_INF("nros Zephyr C++ Listener");
    LOG_INF("=========================");

    /* Wait for network interface */
    if (zpico_zephyr_wait_network(CONFIG_NROS_INIT_DELAY_MS) != 0) {
        LOG_ERR("Network not ready");
        return 1;
    }

    NROS_TRY_RET(nros::init(CONFIG_NROS_ZENOH_LOCATOR, CONFIG_NROS_DOMAIN_ID), 1);

    nros::Node node;
    NROS_TRY_RET(nros::create_node(node, "zephyr_cpp_listener"), 1);
    g_logger = node.get_logger();

    nros::Subscription<std_msgs::msg::Int32> sub;
    NROS_TRY_RET(node.create_subscription(sub, "/chatter"), 1);

    /* Alternative: use Stream::wait_next for blocking reception */
    // std_msgs::msg::Int32 msg;
    // sub.stream().wait_next(executor_handle, 1000, msg);

    /* Spin + poll loop */
    LOG_INF("Waiting for messages...");

    int message_count = 0;

    while (true) {
        nros::spin_once(100);

        std_msgs::msg::Int32 msg;
        while (sub.try_recv(msg)) {
            message_count++;
            NROS_LOG_INFO(g_logger, "Received: %d", msg.data);
        }
    }

    /* Cleanup (unreachable in this example) */
    nros::shutdown();

    return 0;
}

NROS_APP_MAIN_REGISTER_ZEPHYR()
```
