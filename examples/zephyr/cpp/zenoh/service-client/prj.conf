## CMakeLists.txt
```
# SPDX-License-Identifier: Apache-2.0
# nros Zephyr Service Client Example (C++)

cmake_minimum_required(VERSION 3.20.0)

find_package(Zephyr REQUIRED HINTS $ENV{ZEPHYR_BASE})
project(nros_zephyr_service_client_cpp LANGUAGES CXX)

# nros module (CONFIG_NROS=y, CONFIG_NROS_CPP_API=y) provides zenoh shim,
# platform support, and the nros-cpp library automatically.

nros_generate_interfaces(example_interfaces
    "srv/AddTwoInts.srv"
    LANGUAGE CPP
)

target_sources(app PRIVATE src/main.cpp)
```

## prj.conf
```kconfig
# nros Zephyr Service Client (C++) Configuration
#
# This configuration enables the nros C++ API and networking.

# =============================================================================
# General
# =============================================================================
CONFIG_MAIN_STACK_SIZE=16384
CONFIG_HEAP_MEM_POOL_SIZE=65536
CONFIG_SYSTEM_WORKQUEUE_STACK_SIZE=4096

# =============================================================================
# C++ Support
# =============================================================================
CONFIG_CPP=y
CONFIG_STD_CPP14=y

# =============================================================================
# Logging
# =============================================================================
CONFIG_LOG=y
CONFIG_LOG_DEFAULT_LEVEL=3
CONFIG_PRINTK=y
CONFIG_EARLY_CONSOLE=y

# Use printk backend for logging (not RTT)
CONFIG_LOG_BACKEND_RTT=n

# =============================================================================
# Networking
# =============================================================================
CONFIG_NETWORKING=y
CONFIG_NET_IPV4=y
CONFIG_NET_TCP=y
CONFIG_NET_UDP=y
CONFIG_NET_SOCKETS=y

# Network buffers
CONFIG_NET_PKT_RX_COUNT=32
CONFIG_NET_PKT_TX_COUNT=32
CONFIG_NET_BUF_RX_COUNT=64
CONFIG_NET_BUF_TX_COUNT=64
CONFIG_NET_MAX_CONTEXTS=16

# Network interface
CONFIG_NET_L2_ETHERNET=y

# DNS (optional)
CONFIG_DNS_RESOLVER=n

# =============================================================================
# POSIX API (required by zenoh-pico)
# =============================================================================
CONFIG_POSIX_API=y

# zenoh-pico allocates POSIX mutexes for transport and write filters.
# Zephyr defaults to 5 which is insufficient for zenoh-pico.
CONFIG_MAX_PTHREAD_MUTEX_COUNT=32
CONFIG_MAX_PTHREAD_COND_COUNT=16

# =============================================================================
# nros Module
# =============================================================================
CONFIG_NROS=y
CONFIG_NROS_CPP_API=y
CONFIG_NROS_ZENOH_LOCATOR="tcp/127.0.0.1:7666"
CONFIG_NROS_DOMAIN_ID=0

# =============================================================================
# Timing
# =============================================================================
CONFIG_SYS_CLOCK_TICKS_PER_SEC=1000

# =============================================================================
# Debug
# =============================================================================
CONFIG_DEBUG=y
CONFIG_DEBUG_INFO=y

# Network debug logging
CONFIG_NET_LOG=y
CONFIG_NET_STATISTICS=y
CONFIG_NET_SHELL=y
CONFIG_NET_CONNECTION_MANAGER=y
CONFIG_MAX_PTHREAD_COUNT=16
CONFIG_POSIX_THREAD_THREADS_MAX=16
```

## src/main.cpp
```c
/**
 * @file main.cpp
 * @brief Zephyr C++ service client example using nros-cpp API
 *
 * This example demonstrates calling an AddTwoInts service on Zephyr RTOS
 * using the nros C++ API (nros::init, nros::Node, nros::Client<S>).
 * Uses async send_request() + Future::wait() with sleep between calls.
 * The nros module handles zenoh initialization and platform support.
 */

#include <zephyr/kernel.h>
#include <zephyr/logging/log.h>

LOG_MODULE_REGISTER(nros_cpp_service_client, LOG_LEVEL_INF);

#define NROS_TRY_LOG(file, line, expr, ret) \
    LOG_ERR("%s:%d %s -> %d", (file), (line), (expr), (int)(ret))

extern "C" {
#include <zpico_zephyr.h>
}

#include <nros/app_main.h>
#include <nros/log.hpp>
#include <nros/nros.hpp>

// Generated C++ service bindings
#include "example_interfaces.hpp"

/* ============================================================================
 * Application
 * ============================================================================ */

// Phase 88.16.G — set after `nros::create_node`; used by post-init
// diagnostics. nullptr before init = `NROS_LOG_*` silently drops.
static nros_logger_t g_logger = nullptr;

int nros_app_main(int argc, char **argv) {
    (void)argc;
    (void)argv;

    LOG_INF("nros Zephyr C++ Service Client");
    LOG_INF("================================");

    /* Wait for network interface */
    if (zpico_zephyr_wait_network(CONFIG_NROS_INIT_DELAY_MS) != 0) {
        LOG_ERR("Network not ready");
        return 1;
    }

    NROS_TRY_RET(nros::init(CONFIG_NROS_ZENOH_LOCATOR, CONFIG_NROS_DOMAIN_ID), 1);

    nros::Node node;
    NROS_TRY_RET(nros::create_node(node, "zephyr_cpp_service_client"), 1);
    g_logger = node.get_logger();

    nros::Client<example_interfaces::srv::AddTwoInts> client;
    NROS_TRY_RET(node.create_client(client, "/add_two_ints"), 1);
    nros::Result ret;

    /* Allow time for connection to stabilize */
    k_sleep(K_SECONDS(2));

    /* Test cases */
    struct TestCase {
        int64_t a;
        int64_t b;
    };

    TestCase test_cases[] = {{5, 3}, {10, 20}, {100, 200}, {-5, 10}};
    int num_cases = static_cast<int>(sizeof(test_cases) / sizeof(test_cases[0]));

    LOG_INF("Calling service %d times...", num_cases);

    int success_count = 0;

    for (int i = 0; i < num_cases; i++) {
        example_interfaces::srv::AddTwoInts::Request req;
        req.a = test_cases[i].a;
        req.b = test_cases[i].b;

        example_interfaces::srv::AddTwoInts::Response resp;
        auto fut = client.send_request(req);
        if (fut.is_consumed()) {
            NROS_LOG_ERROR(g_logger, "Call [%d]: send_request failed", i + 1);
            continue;
        }
        ret = fut.wait(nros::global_handle(), 5000, resp);

        if (ret.ok()) {
            if (resp.sum == req.a + req.b) {
                NROS_LOG_INFO(g_logger, "Call [%d]: %lld + %lld = %lld [OK]", i + 1,
                        static_cast<long long>(req.a), static_cast<long long>(req.b),
                        static_cast<long long>(resp.sum));
                success_count++;
            } else {
                NROS_LOG_ERROR(g_logger, "Call [%d]: mismatch %lld + %lld = %lld (expected %lld)", i + 1,
                        static_cast<long long>(req.a), static_cast<long long>(req.b),
                        static_cast<long long>(resp.sum),
                        static_cast<long long>(req.a + req.b));
            }
        } else {
            NROS_LOG_ERROR(g_logger, "Call [%d]: failed with error %d", i + 1, ret.raw());
        }

        k_sleep(K_SECONDS(1));
    }

    LOG_INF("%d/%d calls succeeded", success_count, num_cases);

    /* Cleanup */
    nros::shutdown();

    return 0;
}

NROS_APP_MAIN_REGISTER_ZEPHYR()
```
