## CMakeLists.txt
```
# SPDX-License-Identifier: Apache-2.0
# Phase 117.14 — nros pub/sub demo on the ARM FVP Base_RevC AEMv8-R
# Cortex-A SMP target under Zephyr. Copy-out template per CLAUDE.md
# examples convention — no walk-up paths, no shared example-only
# helpers. The nros module supplies the C++ API + codegen.

cmake_minimum_required(VERSION 3.20.0)

find_package(Zephyr REQUIRED HINTS $ENV{ZEPHYR_BASE})
project(nros_zephyr_aemv8r_cyclonedds_talker LANGUAGES CXX)

# Generate C++ message bindings for the String type used by the talker.
# `nros_generate_interfaces()` is provided by the nros Zephyr module
# (CONFIG_NROS=y, CONFIG_NROS_CPP_API=y). KEEP this (not the rclcpp-compat
# `find_package` + explicit `NROS_CYCLONE_*` descriptor block the native_sim
# reference uses) — it already emits the Cyclone C descriptor for this FVP build
# path, and `build-fvp-aemv8r-cyclonedds` does not export `NROS_CYCLONE_*`.
nros_generate_interfaces(std_msgs LANGUAGE CPP)

# phase-244.C2.1 — typed carrier. Instead of an imperative `main.cpp`, the node is
# a stateful component (`Talker::configure(node)`); the Zephyr typed carrier
# generates the entry (`nano_ros_add_node(... TYPED ...)` →
# ZephyrBoard::run_components) and target_sources/links it into the global `app`.
find_package(nano_ros REQUIRED)

nano_ros_add_node(talker CLASS nros_zephyr_aemv8r_cyclonedds_talker::Talker
    HEADER Talker.hpp
    TYPED
    SOURCES src/Talker.cpp)
```

## prj.conf
```kconfig
# Phase 117.14 — Zephyr config for the FVP AEMv8-R Cortex-A SMP
# pub/sub demo. nros C++ API + DDS backend.

# =============================================================================
# Kernel + threading
# =============================================================================
CONFIG_MAIN_STACK_SIZE=16384
CONFIG_HEAP_MEM_POOL_SIZE=131072
CONFIG_SYSTEM_WORKQUEUE_STACK_SIZE=4096
CONFIG_SYS_CLOCK_TICKS_PER_SEC=1000

CONFIG_MAX_PTHREAD_COUNT=16
CONFIG_POSIX_THREAD_THREADS_MAX=16
CONFIG_MAX_PTHREAD_MUTEX_COUNT=32
CONFIG_MAX_PTHREAD_COND_COUNT=16

# =============================================================================
# C++ Support
# =============================================================================
CONFIG_CPP=y
CONFIG_STD_CPP14=y

# =============================================================================
# POSIX (DDS pthreads + sockets)
# =============================================================================
CONFIG_POSIX_API=y

# =============================================================================
# Networking — IPv4 + UDP/TCP, ethernet L2.
# =============================================================================
CONFIG_NETWORKING=y
CONFIG_NET_IPV4=y
CONFIG_NET_IPV6=n
CONFIG_NET_TCP=y
CONFIG_NET_UDP=y
CONFIG_NET_SOCKETS=y
CONFIG_NET_L2_ETHERNET=y
CONFIG_NET_PKT_RX_COUNT=32
CONFIG_NET_PKT_TX_COUNT=32
CONFIG_NET_BUF_RX_COUNT=64
CONFIG_NET_BUF_TX_COUNT=64
CONFIG_NET_MAX_CONTEXTS=16

# =============================================================================
# Logging / console
# =============================================================================
CONFIG_LOG=y
CONFIG_LOG_DEFAULT_LEVEL=3
CONFIG_PRINTK=y
CONFIG_EARLY_CONSOLE=y
CONFIG_LOG_BACKEND_RTT=n

# =============================================================================
# nros module — C++ API + Cyclone DDS backend. The Zephyr-Cyclone
# build glue landed in Phase 11W / 171.0 (native_sim); this FVP
# Cortex-A/R target reuses it (build verification tracked as 171.0.c).
# =============================================================================
CONFIG_NROS=y
CONFIG_NROS_CPP_API=y
CONFIG_NROS_RMW_CYCLONEDDS=y
```

## full-libcpp.conf
```kconfig
# Phase 190.D — FVP full-libstdc++ regression profile.
#
# Layered via EXTRA_CONF_FILE on top of prj.conf to mirror the Autoware
# safety-island actuation build's C library / C++ runtime: full newlib +
# the GNU libstdc++ (not Zephyr's minimal libcpp). This is the profile a
# real downstream C++ application uses on fvp_baser_aemv8r, and it is what
# exercises the Phase 190 fixes that the default minimal-libcpp build never
# touches:
#   - 190.A / 190.C — the cxx-compat shims must defer to the real libstdc++
#     (<atomic>/<chrono>/<utility>/<cstdlib>/...) pulled in by nros-cpp +
#     Cyclone TUs; with minimal libcpp the shims are needed and never collide.
#   - 190.B — net.c multicast join (struct ip_mreq vs ip_mreqn) under newlib.
#   - 190.F — zpico-zephyr net_if IPv4 version gate.
#   - 190.G — Cyclone ddsrt POSIX weak stubs (recvmsg / pthread_* / _open).
#
# Build-coverage only: a regression guard so nano-ros CI catches a re-break of
# the consumable-on-FVP-with-full-libstdc++ profile. Runtime exercised by the
# downstream consumer (Autoware safety-island), not here.
CONFIG_NEWLIB_LIBC=y
CONFIG_GLIBCXX_LIBCPP=y
```

## src/main.cpp
```c
/**
 * @file main.cpp
 * @brief Phase 117.14 — Zephyr C++ pub/sub demo on the ARM FVP
 *        Base_RevC AEMv8-R Cortex-A SMP board, exercising `nros-cpp`
 *        + the codegen pipeline end-to-end.
 *
 * Publishes `std_msgs/Int32 { data = count }` on `/chatter` once a
 * second. Pair with a stock ROS 2 `ros2 topic echo /chatter
 * std_msgs/msg/Int32` peer for the runtime interop check, or with
 * the matching `examples/zephyr/cpp/dds/listener` running on
 * native_sim for an in-tree round-trip.
 *
 * Builds against the Zephyr nros module's Cyclone DDS backend
 * (`CONFIG_NROS_RMW_CYCLONEDDS=y`). The Cyclone DDS RMW at
 * `packages/dds/nros-rmw-cyclonedds/` is validated on POSIX (Phase
 * 117.12) and Zephyr native_sim (Phase 11W / 171.0); this FVP
 * Cortex-A/R target reuses that glue (build verification: 171.0.c).
 */

#include <zephyr/kernel.h>
#include <zephyr/logging/log.h>

#include <nros/nros.hpp>

#include "std_msgs.hpp"

LOG_MODULE_REGISTER(nros_aemv8r_cyclonedds_talker, LOG_LEVEL_INF);

int main(void)
{
    LOG_INF("Phase 117.14 — nros C++ talker on FVP AEMv8-R");

    nros::Result ret = nros::init("", CONFIG_NROS_DOMAIN_ID);
    if (!ret.ok()) {
        LOG_ERR("Init failed: %d", ret.raw());
        return 1;
    }

    nros::Node node;
    ret = nros::create_node(node, "aemv8r_cyclonedds_talker");
    if (!ret.ok()) {
        LOG_ERR("Node creation failed: %d", ret.raw());
        nros::shutdown();
        return 1;
    }

    nros::Publisher<std_msgs::msg::Int32> pub;
    ret = node.create_publisher(pub, "/chatter");
    if (!ret.ok()) {
        LOG_ERR("Publisher creation failed: %d", ret.raw());
        nros::shutdown();
        return 1;
    }

    LOG_INF("Publishing /chatter (std_msgs/Int32) at 1 Hz...");

    int32_t count = 0;
    while (true) {
        ++count;
        std_msgs::msg::Int32 msg;
        msg.data = count;

        ret = pub.publish(msg);
        if (ret.ok()) {
            LOG_INF("Published: %d", count);
        } else {
            LOG_ERR("Publish failed: %d", ret.raw());
        }
        k_sleep(K_SECONDS(1));
    }

    nros::shutdown();
    return 0;
}
```

## src/Talker.cpp
```c
/// @file Talker.cpp
/// @brief FVP AEMv8-R Cortex-A/R cyclonedds talker — typed component
///        (RFC-0043 / phase-244.C2.1). Publishes std_msgs/Int32 on /chatter at
///        1 Hz; pair with a stock ROS 2 `ros2 topic echo /chatter` peer.

#include "Talker.hpp"

#include <cstdio>

namespace nros_zephyr_aemv8r_cyclonedds_talker {

void Talker::on_tick() {
    std_msgs::msg::Int32 m;
    m.data = count_++;
    if (pub_.publish(m).ok()) {
        std::printf("Published: %d\n", m.data);
    }
}

::nros::Result Talker::configure(::nros::Node& node) {
    ::nros::Result r = node.create_publisher(pub_, "/chatter");
    if (!r.ok()) return r;
    return ::nros::bind_timer<Talker, &Talker::on_tick>(node, timer_, 1000, this);
}

} // namespace nros_zephyr_aemv8r_cyclonedds_talker
```

## src/Talker.hpp
```c
// FVP AEMv8-R Cortex-A/R cyclonedds talker — typed component (RFC-0043 /
// phase-244.C2.1). A timer member publishes the official ROS 2 demo payload on `/chatter`
// via a typed `Publisher<String>`. The Zephyr typed carrier
// (`zephyr_entry_main_typed.cpp.in`) constructs this object + calls
// `configure(node)` and runs `ZephyrBoard::run_components`. Replaces the legacy
// Phase-117 imperative `main.cpp` (`nros::init`/`create_node`/`while`/`k_sleep`).
#ifndef NROS_ZEPHYR_AEMV8R_CYCLONEDDS_TALKER_HPP
#define NROS_ZEPHYR_AEMV8R_CYCLONEDDS_TALKER_HPP

#include <nros/component.hpp>
#include <nros/nros.hpp>

#include "std_msgs.hpp"

namespace nros_zephyr_aemv8r_cyclonedds_talker {

class Talker {
    ::nros::Publisher<std_msgs::msg::String> pub_;
    ::nros::Timer timer_;
    int count_ = 0;

    void on_tick(); // real body, bound by identity

  public:
    ::nros::Result configure(::nros::Node& node);
};

} // namespace nros_zephyr_aemv8r_cyclonedds_talker

#endif // NROS_ZEPHYR_AEMV8R_CYCLONEDDS_TALKER_HPP
```
