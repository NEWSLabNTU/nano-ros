## CMakeLists.txt
```
# SPDX-License-Identifier: Apache-2.0
# nros Zephyr Talker Example (C++) — TYPED component (RFC-0043 / phase-244.C2).
#
# Instead of a hand-written imperative `main.cpp`, the node is a stateful
# component (`Talker::configure(node)`); the Zephyr typed carrier generates the
# entry (`nano_ros_add_node(... TYPED ...)` → ZephyrBoard::run_components).

cmake_minimum_required(VERSION 3.20.0)

find_package(Zephyr REQUIRED HINTS $ENV{ZEPHYR_BASE})
project(zephyr_cpp_talker LANGUAGES CXX)

# nros zephyr module (CONFIG_NROS=y, CONFIG_NROS_CPP_API=y) auto-loaded
# via `find_package(Zephyr)`; provides zenoh shim, platform support, and
# the nros-cpp library (zephyr_library_named(nros)).
#
# Phase 210.E.3.c — switch from legacy `nros_generate_interfaces(<pkg>)`
# to the canonical `find_package(<pkg>)` shape via nano-ros's find
# modules (`cmake/find/`). `NROS_REPO_DIR` is published as a CACHE var by the
# zephyr module so the include path resolves from the app dir.
find_package(nano_ros REQUIRED)
find_package(std_msgs REQUIRED)

# Cyclone DDS topic descriptors for this image's interface packages are generated
# by the shared interface pipeline (`zephyr/cmake/nros_generate_interfaces.cmake`)
# when `find_package(<pkg>)` runs below. A hand-written descriptor block here
# used to generate the same descriptors a second time; with the global
# `--allow-multiple-definition` gone (issue 1636) that was a duplicate-symbol
# link error, so it is gone too (issue 1673).

# The Zephyr typed carrier branch keys on NROS_PLATFORM=zephyr + DEPLOY
# zephyr + TARGET app + TYPED, and target_sources/target_link_libraries the
# generated entry + component lib into the global `app`. No second executable.

nano_ros_auto_add_library(talker_lib STATIC src/Talker.cpp)

nros_components_register_node(talker_lib
    HEADER Talker.hpp
    PLUGIN zephyr_cpp_talker::Talker
    EXECUTABLE talker
    SHAPE configure
    TYPED
    # phase-412 -- `ENTITIES` is retired. A standalone Zephyr application has
    # no launch file, so it has no contract sidecar to state itself in; what
    # this image creates is stated as the XRCE session caps in system.toml's
    # `[image.zephyr_xrce] env` (phase-481 W3),
    # which is what phase-412's own guidance leaves such an image ("a system
    # with no contract yet keeps its configured" knobs). See issue 1033.
)
```

## sample.yaml
```
# Phase 180.C — nano-ros C++ talker as a Zephyr sample (Twister-discoverable).
# See examples/zephyr/c/talker/sample.yaml for the mechanism.
sample:
  name: nano-ros C++ Talker
  description: nano-ros ROS 2 publisher (C++ API) on Zephyr, zenoh RMW
common:
  tags:
    - nano-ros
    - nros
  harness: console
  harness_config:
    type: one_line
    regex:
      - "nros Zephyr C\\+\\+ Talker"
tests:
  sample.nano-ros.cpp.talker.zenoh:
    build_only: true
    platform_allow:
      - native_sim/native/64
    integration_platforms:
      - native_sim/native/64
    extra_args:
      - SNIPPET=nros-zenoh
```

## prj.conf
```kconfig
# Base config (Phase 168.4 collapsed shape). RMW choice + RMW-specific
# sizing come from prj-<rmw>.conf overlays.

CONFIG_LOG=y
CONFIG_LOG_DEFAULT_LEVEL=3
CONFIG_PRINTK=y
CONFIG_EARLY_CONSOLE=y
CONFIG_LOG_BACKEND_RTT=n

CONFIG_NETWORKING=y
CONFIG_NET_IPV4=y
CONFIG_NET_UDP=y
CONFIG_NET_SOCKETS=y
CONFIG_NET_L2_ETHERNET=y
CONFIG_NET_MAX_CONTEXTS=16
CONFIG_DNS_RESOLVER=n

CONFIG_SYS_CLOCK_TICKS_PER_SEC=1000

CONFIG_NROS=y
CONFIG_STD_CPP17=y

CONFIG_NET_LOG=y
CONFIG_NET_STATISTICS=y
```

## prj-cyclonedds.conf
```kconfig
# Zephyr-native settings the cyclonedds image needs -- named by
# `[image.zephyr_cyclonedds] conf` in system.toml, which the nano-ros module adds
# to the build. The RMW choice and every nano-ros knob are the image's
# (phase-481, RFC-0098 D10/D11): never `CONFIG_NROS_*` here.

# Cyclone DDS is C++-only (depends on NROS_CPP_API). The C side
# can't select it.

# RTPS uses UDP multicast for SPDP discovery.
CONFIG_NET_IPV4_IGMP=y
CONFIG_POSIX_API=y
CONFIG_MAX_PTHREAD_MUTEX_COUNT=256
CONFIG_MAX_PTHREAD_COND_COUNT=256
CONFIG_POSIX_THREAD_THREADS_MAX=16

# Resource sizing — Cyclone is heavy.
CONFIG_MAIN_STACK_SIZE=524288
CONFIG_HEAP_MEM_POOL_SIZE=4194304
CONFIG_SYSTEM_WORKQUEUE_STACK_SIZE=8192

CONFIG_NET_PKT_RX_COUNT=64
CONFIG_NET_PKT_TX_COUNT=64
CONFIG_NET_BUF_RX_COUNT=128
CONFIG_NET_BUF_TX_COUNT=128

# Phase 11W.12 — runtime parity with the Rust cyclonedds overlay.
# The universal bool configs (THREAD_LOCAL_STORAGE / THREAD_CUSTOM_DATA
# / DYNAMIC_THREAD(+ALLOC) / THREAD_STACK_INFO / THREAD_MONITOR) come
# from CONFIG_NROS_RMW_CYCLONEDDS in zephyr/Kconfig. The int knobs +
# native_sim NSOS offload are example-local:
#   DYNAMIC_THREAD_STACK_SIZE — per-worker-thread stack.
# Issue 1633 -- no COMMON_LIBC_MALLOC_ARENA_SIZE here: ddsrt allocates from the
# nros heap (CONFIG_NROS_ZEPHYR_HEAP_SIZE, 1 MiB with Cyclone) since the Zephyr
# road compiles the platform funnel, and the module's Cyclone default for the
# libc arena (256 KiB) covers what still uses it.
CONFIG_DYNAMIC_THREAD_STACK_SIZE=32768

# NET_TCP — sockwaitset self-pipe (loopback TCP socket pair). Kept
# here because selecting it from NROS_RMW_CYCLONEDDS forms a Kconfig
# dependency loop through NET_SOCKETS.
CONFIG_NET_TCP=y

# Diagnostics — verbose asserts + immediate logging keep Cyclone init
# failures legible (picolibc drops fprintf(stderr)).
CONFIG_ASSERT=y
CONFIG_ASSERT_VERBOSE=y
CONFIG_PICOLIBC_ASSERT_VERBOSE=y
CONFIG_LOG_MODE_IMMEDIATE=y

# NSOS (host sockets) is board `zephyr`'s `nros-nsos` snippet (issue 2157).

# Issue 1674 — Cyclone's receive thread select()s over a socket waitset of
# four fds here (self-pipe + three UDP sockets, measured on native_sim), and
# Zephyr's select refuses any set larger than this cap with ENOMEM — the image
# then delivers nothing and floods its console. Zephyr's default is 3. The
# module's Kconfig defaults it to 8 for Cyclone too; it is ALSO stated here
# because a Kconfig default never reaches an existing build dir (Zephyr reloads
# the old .config while the merged fragments are unchanged), and a fragment
# change does.
CONFIG_NET_SOCKETS_POLL_MAX=8
```

## prj-dds.conf
```kconfig
CONFIG_NROS_RMW_DDS=y
CONFIG_NROS_DDS_DOMAIN_ID=0

CONFIG_NET_IPV4_IGMP=y
CONFIG_POSIX_API=y
CONFIG_MAX_PTHREAD_MUTEX_COUNT=32
CONFIG_MAX_PTHREAD_COND_COUNT=16
CONFIG_MAX_PTHREAD_COUNT=16
CONFIG_POSIX_THREAD_THREADS_MAX=16

CONFIG_MAIN_STACK_SIZE=524288
CONFIG_HEAP_MEM_POOL_SIZE=524288
CONFIG_SYSTEM_WORKQUEUE_STACK_SIZE=8192
CONFIG_HW_STACK_PROTECTION=y
CONFIG_STACK_SENTINEL=y

CONFIG_NET_PKT_RX_COUNT=64
CONFIG_NET_PKT_TX_COUNT=64
CONFIG_NET_BUF_RX_COUNT=128
CONFIG_NET_BUF_TX_COUNT=128
```

## prj-xrce.conf
```kconfig
# Zephyr-native settings the xrce image needs -- named by
# `[image.zephyr_xrce] conf` in system.toml, which the nano-ros module adds
# to the build. The RMW choice and every nano-ros knob are the image's
# (phase-481, RFC-0098 D10/D11): never `CONFIG_NROS_*` here.

CONFIG_NET_TCP=y

CONFIG_MAIN_STACK_SIZE=16384
CONFIG_HEAP_MEM_POOL_SIZE=65536
CONFIG_SYSTEM_WORKQUEUE_STACK_SIZE=4096

CONFIG_NET_PKT_RX_COUNT=32
CONFIG_NET_PKT_TX_COUNT=32
CONFIG_NET_BUF_RX_COUNT=64
CONFIG_NET_BUF_TX_COUNT=64
```

## src/main.cpp
```c
/**
 * @file main.cpp
 * @brief Zephyr C++ talker (Phase 168.4 collapsed shape).
 */

#include <zephyr/kernel.h>
#include <zephyr/logging/log.h>
#include <zephyr/autoconf.h>

extern "C" {
#include <nros/platform_zephyr.h>
}

LOG_MODULE_REGISTER(nros_cpp_talker, LOG_LEVEL_INF);

#define NROS_TRY_LOG(file, line, expr, ret)                                                        \
    LOG_ERR("%s:%d %s -> %d", (file), (line), (expr), (int)(ret))

#include <nros/app_main.h>
#include <nros/log.hpp>
#include <nros/nros.hpp>

#include "std_msgs.hpp"

static nros_logger_t g_logger = nullptr;

int nros_app_main(int argc, char** argv) {
    (void)argc;
    (void)argv;
    LOG_INF("nros Zephyr C++ Talker");

    if (nros_platform_zephyr_wait_network(CONFIG_NROS_INIT_DELAY_MS) != 0) {
        LOG_ERR("Network not ready");
        return 1;
    }

#if defined(CONFIG_NROS_RMW_ZENOH)
    NROS_TRY_RET(nros::init(CONFIG_NROS_ZENOH_LOCATOR, CONFIG_NROS_DOMAIN_ID), 1);
#elif defined(CONFIG_NROS_RMW_XRCE)
    /* Distinct XRCE session name (Phase 177.9.F) — the client key is
     * `hash_session_key(session_name)`; the 2-arg `nros::init` defaults it to
     * "nros_cpp", which would collide with the listener's client key on the
     * same Agent. Use this process's node name. */
    NROS_TRY_RET(nros::init(CONFIG_NROS_XRCE_AGENT_ADDR ":" STRINGIFY(CONFIG_NROS_XRCE_AGENT_PORT),
                            CONFIG_NROS_DOMAIN_ID, "zephyr_cpp_talker"),
                 1);
#elif defined(CONFIG_NROS_RMW_CYCLONEDDS)
    NROS_TRY_RET(nros::init("", CONFIG_NROS_DOMAIN_ID), 1);
#else
#error "Phase 168.4 requires CONFIG_NROS_RMW_{ZENOH,XRCE,CYCLONEDDS}=y"
#endif

    nros::Node node;
    NROS_TRY_RET(nros::create_node(node, "zephyr_cpp_talker"), 1);
    g_logger = node.get_logger();

    nros::Publisher<std_msgs::msg::Int32> pub;
    NROS_TRY_RET(node.create_publisher(pub, "/chatter"), 1);

    LOG_INF("Publishing messages...");
    int32_t count = 0;
    while (true) {
        // Post-increment so the first publish is 0, matching ROS demo nodes
        // (rclcpp_demos `talker.cpp`). Phase 208.D.9.
        std_msgs::msg::Int32 msg;
        msg.data = count;
        nros::Result ret = pub.publish(msg);
        if (ret.ok())
            NROS_LOG_INFO(g_logger, "Published: %d", count);
        else
            NROS_LOG_ERROR(g_logger, "Publish failed: %d", ret.raw());
        count++;
        k_sleep(K_SECONDS(1));
    }
    nros::shutdown();
    return 0;
}

NROS_APP_MAIN_REGISTER_ZEPHYR()
```

## src/Talker.cpp
```c
/// @file Talker.cpp
/// @brief Zephyr C++ talker — typed component (RFC-0043 / phase-244.C2).

#include "Talker.hpp"

#include <cstdio>

namespace zephyr_cpp_talker {

void Talker::on_tick() {
    // Pre-increment so the first payload is "Hello World: 1", matching the
    // official ROS 2 demo talker.
    ++count_;
    char payload[64];
    std::snprintf(payload, sizeof(payload), "Hello World: %d", count_);
    std_msgs::msg::String m;
    m.data = payload;
    if (pub_.publish(m).ok()) {
        std::printf("Publishing: '%s'\n", m.data.c_str());
    }
}

::rclcpp::Result Talker::configure(::nros::Node& node) {
    // Unbuffered stdout — a full-buffered console can swallow the final
    // line(s) when the harness kills the QEMU before a flush.
    // `::setvbuf` (global) not `std::setvbuf` — Zephyr's minimal libcpp/picolibc
    // `<cstdio>` declares it in the global namespace only.
    ::setvbuf(stdout, nullptr, _IONBF, 0);
    ::rclcpp::Result r = node.create_publisher(pub_, "/chatter");
    if (!r.ok()) return r;
    return node.create_wall_timer<Talker, &Talker::on_tick>(timer_, 500, this);
}

} // namespace zephyr_cpp_talker
```

## src/Talker.hpp
```c
// Zephyr C++ talker — typed component (RFC-0043 / phase-244.C2). A timer member
// publishes the official ROS 2 demo payload (`std_msgs/String`, `Hello World: N`)
// on `/chatter` via a typed `Publisher<String>`.
// The Zephyr typed carrier (the shared entry pack) constructs this
// object + calls `configure(node)` and runs `ZephyrBoard::run_components`.
#ifndef NROS_ZEPHYR_TALKER_CPP_TALKER_HPP
#define NROS_ZEPHYR_TALKER_CPP_TALKER_HPP

#include <rclcpp/rclcpp.hpp>

#include "std_msgs.hpp"

namespace zephyr_cpp_talker {

class Talker {
    ::rclcpp::Publisher<std_msgs::msg::String> pub_;
    ::rclcpp::Timer timer_;
    int count_ = 0;

    void on_tick(); // real body, bound by identity

  public:
    ::rclcpp::Result configure(::rclcpp::Node& node);
};

} // namespace zephyr_cpp_talker

#endif // NROS_ZEPHYR_TALKER_CPP_TALKER_HPP
```
