## CMakeLists.txt
```
# SPDX-License-Identifier: Apache-2.0
# Phase 117.14 — nros pub/sub demo on the ARM FVP Base_RevC AEMv8-R
# Cortex-A SMP target under Zephyr. Copy-out template per CLAUDE.md
# examples convention — no walk-up paths, no shared example-only
# helpers. The nros module supplies the C++ API + codegen.

cmake_minimum_required(VERSION 3.20.0)

find_package(Zephyr REQUIRED HINTS $ENV{ZEPHYR_BASE})
project(nros_zephyr_aemv8r_cyclonedds_talker LANGUAGES CXX)

# Generate C++ message bindings for the String type used by the talker.
# `nros_generate_interfaces()` is provided by the nros Zephyr module
# (CONFIG_NROS=y, CONFIG_NROS_CPP_API=y). KEEP this (not the rclcpp-compat
# `find_package` + explicit `NROS_CYCLONE_*` descriptor block the native_sim
# reference uses) — it already emits the Cyclone C descriptor for this FVP build
# path, and `build-fvp-aemv8r-cyclonedds` does not export `NROS_CYCLONE_*`.
nros_generate_interfaces(std_msgs LANGUAGE CPP)

# phase-244.C2.1 — typed carrier. Instead of an imperative `main.cpp`, the node is
# a stateful component (`Talker::configure(node)`); the Zephyr typed carrier
# generates the entry (`nano_ros_add_node(... TYPED ...)` →
# ZephyrBoard::run_components) and target_sources/links it into the global `app`.
find_package(nano_ros REQUIRED)

nano_ros_auto_add_library(talker_lib STATIC src/Talker.cpp)

nros_components_register_node(talker_lib
    HEADER Talker.hpp
    PLUGIN nros_zephyr_aemv8r_cyclonedds_talker::Talker
    EXECUTABLE talker
    SHAPE configure
    TYPED)
```

## prj.conf
```kconfig
# Phase 117.14 — Zephyr config for the FVP AEMv8-R Cortex-A SMP
# pub/sub demo. nros C++ API + DDS backend.

# =============================================================================
# Kernel + threading
# =============================================================================
CONFIG_MAIN_STACK_SIZE=16384
CONFIG_HEAP_MEM_POOL_SIZE=131072
CONFIG_SYSTEM_WORKQUEUE_STACK_SIZE=4096
CONFIG_SYS_CLOCK_TICKS_PER_SEC=1000

CONFIG_POSIX_THREAD_THREADS_MAX=16
CONFIG_MAX_PTHREAD_MUTEX_COUNT=32
CONFIG_MAX_PTHREAD_COND_COUNT=16

# =============================================================================
# C++ Support
# =============================================================================
CONFIG_CPP=y
CONFIG_STD_CPP14=y

# =============================================================================
# POSIX (DDS pthreads + sockets)
# =============================================================================
CONFIG_POSIX_API=y

# =============================================================================
# Networking — IPv4 + UDP/TCP, ethernet L2.
# =============================================================================
CONFIG_NETWORKING=y
CONFIG_NET_IPV4=y
CONFIG_NET_IPV6=n
CONFIG_NET_TCP=y
CONFIG_NET_UDP=y
CONFIG_NET_SOCKETS=y
CONFIG_NET_L2_ETHERNET=y
CONFIG_NET_PKT_RX_COUNT=32
CONFIG_NET_PKT_TX_COUNT=32
CONFIG_NET_BUF_RX_COUNT=64
CONFIG_NET_BUF_TX_COUNT=64
CONFIG_NET_MAX_CONTEXTS=16

# =============================================================================
# Logging / console
# =============================================================================
CONFIG_LOG=y
CONFIG_LOG_DEFAULT_LEVEL=3
CONFIG_PRINTK=y
CONFIG_EARLY_CONSOLE=y
CONFIG_LOG_BACKEND_RTT=n

# =============================================================================
# nros module — C++ API + Cyclone DDS backend. The Zephyr-Cyclone
# build glue landed in Phase 11W / 171.0 (native_sim); this FVP
# Cortex-A/R target reuses it (build verification tracked as 171.0.c).
# =============================================================================
CONFIG_NROS=y
CONFIG_NROS_CPP_API=y
CONFIG_NROS_RMW_CYCLONEDDS=y
```

## boards/fvp_baser_aemv8r_fvp_aemv8r_aarch64_smp.conf
```kconfig
# FVP-board override layered on top of `prj.conf`. Mirrors
# `packages/boards/nros-board-fvp-aemv8r-smp/boards/fvp_baser_aemv8r_fvp_aemv8r_aarch64_smp.conf`
# so the example builds standalone (per CLAUDE.md examples
# convention — no walk-up paths).

CONFIG_SMP=y
CONFIG_MP_MAX_NUM_CPUS=4

CONFIG_ETH_DRIVER=y

# Heap budget — leave room for app message buffers atop the DDS
# participant + per-topic descriptors.
CONFIG_HEAP_MEM_POOL_SIZE=196608

# RNG — FVP has no entropy peripheral. Test PRNG is the only
# `sys_rand_get` backend.
CONFIG_TEST_RANDOM_GENERATOR=y
```

## src/Talker.cpp
```c
/// @file Talker.cpp
/// @brief FVP AEMv8-R Cortex-A/R cyclonedds talker — typed component
///        (RFC-0043 / phase-244.C2.1). Publishes the official ROS 2 demo
///        payload (std_msgs/String, "Hello World: N") on /chatter at 1 Hz;
///        pair with a stock ROS 2 `ros2 topic echo /chatter` peer.

#include "Talker.hpp"

#include <cstdio>

namespace nros_zephyr_aemv8r_cyclonedds_talker {

void Talker::on_tick() {
    // Pre-increment so the first payload is "Hello World: 1", matching the
    // official ROS 2 demo talker.
    ++count_;
    char payload[64];
    std::snprintf(payload, sizeof(payload), "Hello World: %d", count_);
    std_msgs::msg::String m;
    m.data = payload;
    if (pub_.publish(m).ok()) {
        std::printf("Publishing: '%s'\n", m.data.c_str());
    }
}

::nros::Result Talker::configure(::nros::Node& node) {
    ::nros::Result r = node.create_publisher(pub_, "/chatter");
    if (!r.ok()) return r;
    return ::nros::bind_timer<Talker, &Talker::on_tick>(node, timer_, 1000, this);
}

} // namespace nros_zephyr_aemv8r_cyclonedds_talker
```
