## CMakeLists.txt
```
# SPDX-License-Identifier: Apache-2.0
# nros Zephyr Talker Example (C++) — TYPED component (RFC-0043 / phase-240.8).
#
# Same Zephyr boilerplate as `examples/zephyr/cpp/talker`, but instead of a
# hand-written imperative `main.cpp`, the node is a stateful **component**
# (`Talker::configure(node)`) and the Zephyr typed carrier generates the entry:
# `nano_ros_node_register(TYPED … DEPLOY zephyr)` `configure_file`s
# `zephyr_entry_main_typed.cpp.in` (plain `int main(void)` →
# `ZephyrBoard::run_components`) and composes it into the Zephyr `app` target.

cmake_minimum_required(VERSION 3.20.0)

find_package(Zephyr REQUIRED HINTS $ENV{ZEPHYR_BASE})
# L.4: the component CLASS must start with `${PROJECT_NAME}::`, so the project
# name IS the pkg name (`nros_zephyr_talker_typed_cpp::Talker`).
project(nros_zephyr_talker_typed_cpp LANGUAGES CXX)

include("${NROS_REPO_DIR}/cmake/compat/NrosRclcppCompat.cmake")
find_package(std_msgs REQUIRED)

# Cyclone DDS C descriptor for std_msgs/Int32 (same as the imperative example).
if(CONFIG_NROS_RMW_CYCLONEDDS)
    list(APPEND CMAKE_MODULE_PATH "${NROS_CYCLONE_CMAKE_DIR}")
    set(IDLC_EXECUTABLE "${NROS_CYCLONE_IDLC}" CACHE FILEPATH "" FORCE)
    set(ENV{NROS_RMW_CYCLONEDDS_SCRIPTS_DIR} "${NROS_CYCLONE_SCRIPTS_DIR}")
    include(NrosRmwCycloneddsTypeSupport)
    nros_rmw_cyclonedds_generate_from_msg(_nros_cyc_types
        PKG_NAME   std_msgs
        PKG_DIR    "$ENV{NROS_STD_MSGS_DIR}"
        INTERFACES msg/String.msg)
    target_sources(app PRIVATE ${_nros_cyc_types})
endif()

# Phase 240.8 — the Zephyr typed carrier branch keys on NANO_ROS_PLATFORM=zephyr
# + DEPLOY zephyr + TARGET app (the `find_package(Zephyr)` app) + TYPED, and
# `target_sources(app …)` + `target_link_libraries(app …)` the generated entry +
# component lib into the global `app`. No second executable.
set(NANO_ROS_PLATFORM zephyr)
include("${NROS_REPO_DIR}/cmake/NanoRosNodeRegister.cmake")

nano_ros_node_register(
    NAME      talker
    CLASS     nros_zephyr_talker_typed_cpp::Talker
    LANGUAGE  CPP
    HEADER    Talker.hpp
    TYPED
    SOURCES   src/Talker.cpp
    DEPLOY    zephyr)
```

## sample.yaml
```
# nano-ros C++ TYPED talker (RFC-0043 / phase-240.8) as a Zephyr sample.
# The node is a stateful component; the Zephyr typed carrier generates the
# entry (ZephyrBoard::run_components). build_only — the typed-carrier component
# path on Zephyr is not yet runtime-validated (no Zephyr SDK in CI for this).
sample:
  name: nano-ros C++ TYPED Talker
  description: nano-ros ROS 2 publisher (typed component, RFC-0043) on Zephyr
common:
  tags:
    - nano-ros
    - nros
  harness: console
  harness_config:
    type: one_line
    regex:
      - "Published:"
tests:
  sample.nano-ros.cpp.talker-typed.zenoh:
    build_only: true
    platform_allow:
      - native_sim/native/64
    integration_platforms:
      - native_sim/native/64
    extra_args:
      - SNIPPET=nros-zenoh
```

## prj.conf
```kconfig
# Base config (Phase 168.4 collapsed shape). RMW choice + RMW-specific
# sizing come from prj-<rmw>.conf overlays.

CONFIG_LOG=y
CONFIG_LOG_DEFAULT_LEVEL=3
CONFIG_PRINTK=y
CONFIG_EARLY_CONSOLE=y
CONFIG_LOG_BACKEND_RTT=n

CONFIG_NETWORKING=y
CONFIG_NET_IPV4=y
CONFIG_NET_UDP=y
CONFIG_NET_SOCKETS=y
CONFIG_NET_L2_ETHERNET=y
CONFIG_NET_MAX_CONTEXTS=16
CONFIG_DNS_RESOLVER=n

CONFIG_SYS_CLOCK_TICKS_PER_SEC=1000

CONFIG_NROS=y
CONFIG_NROS_CPP_API=y
CONFIG_STD_CPP14=y
# Issue #58: nros-cpp parameter.hpp (242.3) includes <initializer_list>; the
# toolchain libstdc++ headers are only on the include path with full libcpp.
CONFIG_REQUIRES_FULL_LIBCPP=y

CONFIG_NET_LOG=y
CONFIG_NET_STATISTICS=y
```

## boards/native_sim_native_64.conf
```kconfig
# Native Sim Offloaded Sockets (NSOS) — uses host kernel BSD sockets
# instead of TAP devices. No bridge/root needed. Multiple instances work.
CONFIG_ETH_NATIVE_POSIX=n
CONFIG_NET_DRIVERS=y
CONFIG_NET_SOCKETS_OFFLOAD=y
CONFIG_NET_NATIVE_OFFLOADED_SOCKETS=y
CONFIG_NATIVE_SIM_SLOWDOWN_TO_REAL_TIME=y
```

## src/Talker.cpp
```c
/// @file Talker.cpp
/// @brief Zephyr C++ talker — typed component (RFC-0043 / phase-240.8).

#include "Talker.hpp"

#include <cstdio>

namespace nros_zephyr_talker_typed_cpp {

void Talker::on_tick() {
    // Pre-increment so the first payload is "Hello World: 1", matching the
    // official ROS 2 demo talker.
    ++count_;
    char payload[64];
    std::snprintf(payload, sizeof(payload), "Hello World: %d", count_);
    std_msgs::msg::String m;
    m.data = payload;
    if (pub_.publish(m).ok()) {
        std::printf("Publishing: '%s'\n", m.data.c_str());
    }
}

::nros::Result Talker::configure(::nros::Node& node) {
    ::nros::Result r = node.create_publisher(pub_, "/chatter");
    if (!r.ok()) return r;
    return ::nros::bind_timer<Talker, &Talker::on_tick>(node, timer_, 500, this);
}

} // namespace nros_zephyr_talker_typed_cpp
```

## src/Talker.hpp
```c
// Zephyr C++ talker — typed component (RFC-0043 / phase-240.8). A timer member
// publishes the official ROS 2 demo payload (`std_msgs/String`, `Hello World: N`)
// on `/chatter` via a typed `Publisher<String>`.
// The Zephyr typed carrier (`zephyr_entry_main_typed.cpp.in`) constructs this
// object + calls `configure(node)` and runs `ZephyrBoard::run_components`.
#ifndef NROS_ZEPHYR_TALKER_TYPED_TALKER_HPP
#define NROS_ZEPHYR_TALKER_TYPED_TALKER_HPP

#include <nros/component.hpp>
#include <nros/nros.hpp>

#include "std_msgs.hpp"

namespace nros_zephyr_talker_typed_cpp {

class Talker {
    ::nros::Publisher<std_msgs::msg::String> pub_;
    ::nros::Timer timer_;
    int count_ = 0;

    void on_tick(); // real body, bound by identity

  public:
    ::nros::Result configure(::nros::Node& node);
};

} // namespace nros_zephyr_talker_typed_cpp

#endif // NROS_ZEPHYR_TALKER_TYPED_TALKER_HPP
```
