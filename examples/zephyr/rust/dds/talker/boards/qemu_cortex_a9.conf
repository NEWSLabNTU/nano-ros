## zephyr/Kconfig
```kconfig
# nros Zephyr Module Configuration
# Copyright (c) 2024 nros contributors
# SPDX-License-Identifier: MIT OR Apache-2.0

menuconfig NROS
    bool "nros ROS 2 client library"
    help
      Enable nros, a lightweight ROS 2 client library for embedded systems.
      This module supports multiple RMW backends (zenoh-pico, XRCE-DDS)
      selectable via Kconfig.

if NROS

# =============================================================================
# API Selection
# =============================================================================

choice NROS_API
    prompt "nros API language"
    default NROS_RUST_API

config NROS_C_API
    bool "C API (nros-c)"
    help
      Build and link the nros C API library (libnros_c.a).
      Uses nros_* functions from nros/init.h, nros/node.h, etc.

config NROS_CPP_API
    bool "C++ API (nros-cpp)"
    select CPP
    help
      Build and link the nros C++ API library (libnros_cpp.a).
      Uses nros::init(), nros::Node, nros::Publisher<M>, etc.
      Requires C++ support (automatically selected).

config NROS_RUST_API
    bool "Rust API (nros crate)"
    depends on RUST
    help
      Use the nros Rust crate via rust_cargo_application().
      Kconfig values are bridged to Cargo env vars automatically.

endchoice

# =============================================================================
# RMW Backend Selection
# =============================================================================

choice NROS_RMW_BACKEND
    prompt "RMW backend"
    default NROS_RMW_ZENOH

config NROS_RMW_ZENOH
    bool "zenoh-pico"
    help
      Use zenoh-pico as the RMW transport backend.
      Connects to a zenoh router for ROS 2 interop via rmw_zenoh.

config NROS_RMW_XRCE
    bool "XRCE-DDS"
    depends on NET_SOCKETS
    help
      Use Micro-XRCE-DDS as the RMW transport backend.
      Connects to a Micro-XRCE-DDS Agent over UDP sockets.

config NROS_RMW_CYCLONEDDS
    bool "Cyclone DDS (nros-rmw-cyclonedds)"
    depends on NET_SOCKETS && POSIX_API && CPP
    # Phase 11W — universal Cyclone-DDS-on-Zephyr runtime requirements
    # (formerly duplicated in every cyclonedds prj-cyclonedds.conf):
    #   THREAD_LOCAL_STORAGE — Cyclone's `ddsrt_thread_local
    #     tsd_thread_state` needs real per-thread `__thread` storage.
    #   THREAD_CUSTOM_DATA — the cyclonedds-zephyr-threads patch uses
    #     k_thread_custom_data in place of pthread TLS for ddsrt cleanup.
    #   DYNAMIC_THREAD(+ALLOC) — Cyclone's worker threads (gc/recv/
    #     lease/tev) are pthread_create'd with no explicit stack attr;
    #     Zephyr needs the dynamic-thread stack pool or pthread_create
    #     returns EINVAL. THREAD_STACK_INFO + THREAD_MONITOR are
    #     DYNAMIC_THREAD's own dependencies.
    # (NET_TCP — the sockwaitset self-pipe needs it, but selecting it
    #  here forms a Kconfig dependency loop through NET_SOCKETS, so it
    #  stays in the example overlay.)
    # Int knobs (pthread pool sizes, malloc arena, stack size), NET_TCP,
    # and the native_sim-only NSOS socket offload stay in the example
    # overlays.
    # `imply` (not `select`): set most of these on by default but
    # respect each symbol's own dependencies (e.g. THREAD_LOCAL_STORAGE
    # needs ARCH_HAS_THREAD_LOCAL_STORAGE) and avoid select dependency
    # loops. THREAD_CUSTOM_DATA has no extra deps and is required at link
    # time by the CycloneDDS Zephyr thread shim, so select it directly.
    imply THREAD_LOCAL_STORAGE
    select THREAD_CUSTOM_DATA
    imply THREAD_STACK_INFO
    imply THREAD_MONITOR
    imply DYNAMIC_THREAD
    imply DYNAMIC_THREAD_ALLOC
    help
      Use Cyclone DDS (pinned to 0.10.5, matches ros-humble-cyclonedds)
      as the RMW transport backend. Wire-compatible with stock
      rmw_cyclonedds_cpp on the ROS 2 Humble peer side.

      Implementation lives at packages/dds/nros-rmw-cyclonedds/ as a
      standalone C++ project; the Zephyr module compiles the pinned
      Cyclone DDS submodule plus the nros-rmw-cyclonedds register
      glue into the app library. The register entry point
      (`nros_rmw_cyclonedds_register`) is declared with C linkage
      in `nros_rmw_cyclonedds.h`, so both the C API
      (CONFIG_NROS_C_API=y) and C++ API (CONFIG_NROS_CPP_API=y) can
      call it via the Phase 160.A strong-stub emission.

      Phase 117 — see docs/roadmap/phase-117-cyclonedds-rmw.md.
      Phase 168.X gap 2.B dropped the NROS_CPP_API requirement so
      C-API examples can also pick this backend through
      `prj-cyclonedds.conf` overlays.

endchoice

# =============================================================================
# Cyclone DDS tuning
# =============================================================================

if NROS_RMW_CYCLONEDDS

config NROS_CYCLONE_DOMAIN_ID
    int "DDS domain ID"
    default 0
    range 0 232
    help
      DDS domain ID passed to dds_create_domain_with_rawconfig at init.
      Must match the ROS 2 peer's ROS_DOMAIN_ID for discovery.

config NROS_CYCLONE_CONFIG_XML
    string "Cyclone raw config XML (empty = default)"
    default ""
    help
      Optional Cyclone DDS configuration XML blob baked at build time
      (Zephyr has no filesystem to read from at runtime). Leave empty
      to use Cyclone's compiled-in defaults; set this to override
      transport / discovery / QoS settings. Mirrors the
      ddsi_config struct produced by Cyclone's XML parser.

endif # NROS_RMW_CYCLONEDDS

# =============================================================================
# Zenoh-pico Feature Configuration
# =============================================================================
# These options control which zenoh-pico features are compiled in.
# They map directly to Z_FEATURE_* compile definitions.
# Defaults are set for typical ROS 2 usage; disable unused features
# to reduce code size on constrained targets.

if NROS_RMW_ZENOH

config NROS_ZENOH_MULTI_THREAD
    bool "Zenoh-pico multithreading"
    default y
    help
      Enable multithreading in zenoh-pico. Uses Zephyr threads for
      background read/lease tasks. Required for non-blocking operation.
      Maps to Z_FEATURE_MULTI_THREAD.

config NROS_ZENOH_SOCKET_TIMEOUT_MS
    int "zenoh-pico socket recv timeout (ms)"
    default 100
    help
      SO_RCVTIMEO for the zenoh-pico session socket (Z_CONFIG_SOCKET_TIMEOUT).
      Zephyr's zsock layer serializes send/recv on a per-fd mutex, so the
      blocking read task holds the socket for a full recv window between
      inbound packets and EVERY tx (declare, keepalive, publish, reply)
      waits for that window — total tx throughput is capped at roughly one
      send per window (issues 0129/0139). The 100 ms default suits ~1-10 Hz
      demo lanes; high-rate publishers (e.g. RT-tier systems at 100 Hz)
      must lower this (5 ms => ~200 tx windows/s) at the cost of more
      read-task wakeups.

config NROS_ZENOH_TX_BATCH
    bool "zenoh-pico tx batching (one send per executor spin)"
    default n
    help
      phase-279 (#145) — opt-in tx batching (ZPICO_TX_BATCH). Publishes queue
      in the transport write buffer and ship as ONE socket send per executor
      spin (zpico_spin_once flush), so total tx throughput scales with
      messages-per-flush instead of being capped at ~1 send per socket recv
      window (the zsock per-fd-mutex ceiling above). Adds up to one spin
      period of publish latency; service/query requests and replies bypass
      the batch (express), as do publishers declared express. Off by default.

config NROS_ZENOH_PUBLICATION
    bool "Publication support"
    default y
    help
      Enable zenoh-pico publication support. Required for publishers.
      Maps to Z_FEATURE_PUBLICATION.

config NROS_ZENOH_SUBSCRIPTION
    bool "Subscription support"
    default y
    help
      Enable zenoh-pico subscription support. Required for subscribers.
      Maps to Z_FEATURE_SUBSCRIPTION.

config NROS_ZENOH_QUERY
    bool "Query support (service client)"
    default y
    help
      Enable zenoh-pico query support. Required for service clients
      and action clients.
      Maps to Z_FEATURE_QUERY.

config NROS_ZENOH_QUERYABLE
    bool "Queryable support (service server)"
    default y
    help
      Enable zenoh-pico queryable support. Required for service servers
      and action servers.
      Maps to Z_FEATURE_QUERYABLE.

config NROS_ZENOH_LINK_TCP
    bool "TCP link"
    default y
    help
      Enable TCP transport link. This is the primary transport for
      connecting to a zenoh router.
      Maps to Z_FEATURE_LINK_TCP.

config NROS_ZENOH_LINK_UDP_UNICAST
    bool "UDP unicast link"
    default n
    help
      Enable UDP unicast transport link.
      Maps to Z_FEATURE_LINK_UDP_UNICAST.

config NROS_ZENOH_LINK_UDP_MULTICAST
    bool "UDP multicast link"
    default n
    help
      Enable UDP multicast transport link.
      Maps to Z_FEATURE_LINK_UDP_MULTICAST.

config NROS_ZENOH_SCOUTING
    bool "Scouting (UDP discovery)"
    default n
    help
      Enable scouting for automatic router discovery via UDP.
      Maps to Z_FEATURE_SCOUTING.

config NROS_ZENOH_LINK_SERIAL
    bool "Serial/UART link"
    default n
    help
      Enable serial/UART transport link.
      Maps to Z_FEATURE_LINK_SERIAL.

config NROS_ZENOH_LINK_WS
    bool "WebSocket link"
    default n
    help
      Enable WebSocket transport link.
      Maps to Z_FEATURE_LINK_WS.

config NROS_ZENOH_RAWETH_TRANSPORT
    bool "Raw Ethernet transport"
    default n
    help
      Enable raw Ethernet transport (bypasses IP stack).
      Maps to Z_FEATURE_RAWETH_TRANSPORT.

# =============================================================================
# Zenoh Transport Tuning (zpico-sys)
# =============================================================================

config NROS_MAX_PUBLISHERS
    int "Maximum concurrent publishers"
    default 8
    help
      Maximum number of concurrent zenoh publishers in the shim layer.
      Maps to ZPICO_MAX_PUBLISHERS.

config NROS_MAX_SUBSCRIBERS
    int "Maximum concurrent subscribers"
    default 8
    help
      Maximum number of concurrent zenoh subscribers in the shim layer.
      Maps to ZPICO_MAX_SUBSCRIBERS.

config NROS_MAX_QUERYABLES
    int "Maximum concurrent queryables"
    default 8
    help
      Maximum number of concurrent zenoh queryables (service servers) in the shim.
      Maps to ZPICO_MAX_QUERYABLES.

config NROS_MAX_LIVELINESS
    int "Maximum concurrent liveliness tokens"
    default 16
    help
      Maximum number of concurrent liveliness tokens in the shim layer.
      Maps to ZPICO_MAX_LIVELINESS.

config NROS_MAX_PENDING_GETS
    int "Maximum concurrent pending get operations"
    default 4
    help
      Maximum number of concurrent pending get (service call) operations.
      Maps to ZPICO_MAX_PENDING_GETS.

config NROS_GET_REPLY_BUF_SIZE
    int "Get reply buffer size"
    default 4096
    help
      Size of the buffer for get (service call) reply payloads (bytes).
      Maps to ZPICO_GET_REPLY_BUF_SIZE.

config NROS_GET_POLL_INTERVAL_MS
    int "Get poll interval (ms)"
    default 10
    help
      Polling interval for pending get operations (milliseconds).
      Maps to ZPICO_GET_POLL_INTERVAL_MS.

config NROS_FRAG_MAX_SIZE
    int "Maximum reassembled message size"
    default 2048
    help
      Maximum reassembled message size after defragmentation (bytes).
      Maps to ZPICO_FRAG_MAX_SIZE.

config NROS_BATCH_UNICAST_SIZE
    int "Maximum unicast batch size"
    default 1024
    help
      Maximum unicast batch size before fragmentation (bytes).
      Maps to ZPICO_BATCH_UNICAST_SIZE.

config NROS_SUBSCRIBER_BUFFER_SIZE
    int "Per-subscriber static buffer size"
    default 1024
    help
      Size of the static buffer for each subscriber slot (bytes).
      Maps to ZPICO_SUBSCRIBER_BUFFER_SIZE.

config NROS_SERVICE_BUFFER_SIZE
    int "Per-service static buffer size"
    default 1024
    help
      Size of the static buffer for each service server slot (bytes).
      Maps to ZPICO_SERVICE_BUFFER_SIZE.

# =============================================================================
# Zenoh Platform Configuration
# =============================================================================

config NROS_ZENOH_LOCATOR
    string "Zenoh router locator"
    default "tcp/127.0.0.1:7456"
    help
      Zenoh router address. Supported formats:
        TCP:    "tcp/IP:PORT"       (e.g. "tcp/127.0.0.1:7456")
        Serial: "serial/DEVICE#baudrate=RATE"

config NROS_TRANSPORT_SERIAL
    bool "Enable serial/UART transport"
    select NROS_ZENOH_LINK_SERIAL
    help
      Enable serial/UART transport for zenoh-pico.

endif # NROS_RMW_ZENOH

# =============================================================================
# XRCE-DDS Transport Tuning
# =============================================================================

if NROS_RMW_XRCE

config NROS_XRCE_TRANSPORT_MTU
    int "XRCE transport MTU"
    default 512
    help
      Custom transport MTU for XRCE-DDS. Also sizes stream buffers
      (4x MTU) and UDP staging. Maps to XRCE_TRANSPORT_MTU.

config NROS_XRCE_MAX_SUBSCRIBERS
    int "Maximum concurrent subscribers"
    default 8
    help
      Maximum number of concurrent XRCE subscribers.
      Maps to XRCE_MAX_SUBSCRIBERS.

config NROS_XRCE_MAX_SERVICE_SERVERS
    int "Maximum concurrent service servers"
    default 4
    help
      Maximum number of concurrent XRCE service servers.
      Maps to XRCE_MAX_SERVICE_SERVERS.

config NROS_XRCE_MAX_SERVICE_CLIENTS
    int "Maximum concurrent service clients"
    default 4
    help
      Maximum number of concurrent XRCE service clients.
      Maps to XRCE_MAX_SERVICE_CLIENTS.

config NROS_XRCE_BUFFER_SIZE
    int "Per-slot static buffer size"
    default 1024
    help
      Size of the static buffer for each subscriber/service slot (bytes).
      Maps to XRCE_BUFFER_SIZE.

config NROS_XRCE_STREAM_HISTORY
    int "Reliable stream history depth"
    default 4
    range 2 16
    help
      Reliable stream history depth for XRCE-DDS. Must be >= 2.
      Maps to XRCE_STREAM_HISTORY.

config NROS_XRCE_AGENT_ADDR
    string "XRCE-DDS Agent address"
    default "127.0.0.1"
    help
      IP address of the Micro-XRCE-DDS Agent.

config NROS_XRCE_AGENT_PORT
    int "XRCE-DDS Agent port"
    default 2018
    help
      UDP port of the Micro-XRCE-DDS Agent.

endif # NROS_RMW_XRCE

# C API executor limits are derived from the Rust executor limits below.
# NROS_EXECUTOR_MAX_CBS controls the total handle count for both APIs.

# =============================================================================
# Executor Limits
# =============================================================================

config NROS_EXECUTOR_MAX_CBS
    int "Maximum executor callback slots"
    default 16
    help
      Maximum number of callback slots in the executor
      (subscriptions + timers + services). Controls both Rust and C APIs.
      Arena size is derived automatically from this value and the
      subscription buffer size.

# =============================================================================
# Common Platform Configuration
# =============================================================================

config NROS_DOMAIN_ID
    int "ROS 2 Domain ID"
    default 0
    help
      ROS 2 domain ID for topic isolation.

config NROS_INIT_DELAY_MS
    int "Network initialization delay (ms)"
    default 2000
    help
      Maximum time to wait for the network interface to come up
      before initializing the RMW transport.

# =============================================================================
# Host-side codegen tool (cross-compile fix-up)
# =============================================================================

config NROS_CODEGEN_TOOL
    string "Path to host-built nros-codegen binary"
    default ""
    help
      Phase 140 — Zephyr builds cross-compile for the target, but
      nros-codegen runs on the build host. Build it once via a
      parallel POSIX configure:

        cmake -S <nano-ros> -B build-host -DNANO_ROS_PLATFORM=posix
        cmake --build build-host --target nros-codegen

      and point this Kconfig at the resulting binary
      (e.g. /home/user/nano-ros/build-host/<...>/nros-codegen).

      The Zephyr module's nros_generate_interfaces() picks it up
      automatically when set. Without this (and without the binary
      on PATH), configure errors out with a Hint.

endif # NROS
```
