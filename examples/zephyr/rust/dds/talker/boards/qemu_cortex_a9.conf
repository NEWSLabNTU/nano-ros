## examples/zephyr/rust/dds/talker/boards/qemu_cortex_a9.conf
```kconfig
# Phase 92 — qemu_cortex_a9 networking overlay (talker)
#
# Boots Zephyr on a QEMU Zynq-7000 (Cortex-A9 + Xilinx GEM ethernet)
# with full IPv4 + IGMP. Two QEMU instances are stitched together via
# `-netdev socket,mcast=…` (added at runtime by the test harness),
# giving them a virtual L2 broadcast domain. SPDP discovery
# (RTPS multicast `239.255.0.1:7400`) flows over that segment via
# Zephyr's native IP stack — same code path as real Zephyr hardware.
#
# Listener-side overlay differs only in the static IPv4.

# ── Ethernet driver ─────────────────────────────────────────────────
CONFIG_NET_QEMU_ETHERNET=y
CONFIG_ETH_XLNX_GEM=y

# ── IPv4 + IGMP ─────────────────────────────────────────────────────
CONFIG_NET_CONFIG_SETTINGS=y
CONFIG_NET_CONFIG_NEED_IPV4=y
CONFIG_NET_CONFIG_MY_IPV4_ADDR="192.0.2.1"
CONFIG_NET_CONFIG_MY_IPV4_NETMASK="255.255.255.0"
CONFIG_NET_IPV4_IGMP=y
CONFIG_NET_IF_MCAST_IPV4_ADDR_COUNT=4

# ── Heap sizing for dust-dds ────────────────────────────────────────
# Zynq has 512 MB SRAM, plenty of room. The talker's mailbox queues
# and RTPS state easily fit inside 8 MB of heap.
CONFIG_HEAP_MEM_POOL_SIZE=524288

# ── ARMv7-A exception stacks ────────────────────────────────────────
# qemu_cortex_a9_defconfig sets these to 8 KiB. main() runs on the
# SVC stack on AArch32; Rust formatting + dust-dds setup blow that
# easily. Bumping them across the board (FIQ/SVC/SYS) gives the
# Rust runtime enough headroom to actually print the boot banner.
CONFIG_ARMV7_EXCEPTION_STACK_SIZE=32768
CONFIG_ARMV7_FIQ_STACK_SIZE=32768
CONFIG_ARMV7_SVC_STACK_SIZE=32768
CONFIG_ARMV7_SYS_STACK_SIZE=32768
CONFIG_ISR_STACK_SIZE=32768
```

## examples/zephyr/rust/listener/sample.yaml
```yaml
# Phase 180.C — nano-ros Rust listener as a Zephyr sample (Twister-discoverable).
# See examples/zephyr/c/talker/sample.yaml for the mechanism.
sample:
  name: nano-ros Rust Listener
  description: nano-ros ROS 2 subscriber (Rust API) on Zephyr, zenoh RMW
common:
  tags:
    - nano-ros
    - nros
  harness: console
  harness_config:
    type: one_line
    regex:
      - "nros Zephyr Listener"
tests:
  sample.nano-ros.rust.listener.zenoh:
    build_only: true
    platform_allow:
      - native_sim/native/64
    integration_platforms:
      - native_sim/native/64
    extra_args:
      - SNIPPET=nros-zenoh
```

## examples/zephyr/rust/talker/sample.yaml
```yaml
# Phase 180.C — nano-ros Rust talker as a Zephyr sample (Twister-discoverable).
# See examples/zephyr/c/talker/sample.yaml for the mechanism.
sample:
  name: nano-ros Rust Talker
  description: nano-ros ROS 2 publisher (Rust API) on Zephyr, zenoh RMW
common:
  tags:
    - nano-ros
    - nros
  harness: console
  harness_config:
    type: one_line
    regex:
      - "nros Zephyr Talker"
tests:
  sample.nano-ros.rust.talker.zenoh:
    build_only: true
    platform_allow:
      - native_sim/native/64
    integration_platforms:
      - native_sim/native/64
    extra_args:
      - SNIPPET=nros-zenoh
```

## examples/zephyr/rust/xrce/listener/boards/native_sim_native_64.conf
```kconfig
# Native Sim Offloaded Sockets (NSOS) — uses host kernel BSD sockets
# instead of TAP devices. No bridge/root needed. Multiple instances work.
CONFIG_ETH_NATIVE_POSIX=n
CONFIG_NET_DRIVERS=y
CONFIG_NET_SOCKETS_OFFLOAD=y
CONFIG_NET_NATIVE_OFFLOADED_SOCKETS=y
CONFIG_NATIVE_SIM_SLOWDOWN_TO_REAL_TIME=y
# No static IP config needed (NSOS uses host networking)
CONFIG_NET_CONFIG_SETTINGS=n
# Override agent address to host loopback (NSOS bypasses TAP bridge)
CONFIG_NROS_XRCE_AGENT_ADDR="127.0.0.1"
```

## examples/zephyr/rust/zenoh/action-server/boards/native_sim_native_64.conf
```kconfig
# Board-specific configuration for native_sim/native/64
# Server role uses zeth0

CONFIG_ETH_NATIVE_POSIX_DRV_NAME="zeth0"
```

## examples/zephyr/rust/zenoh/service-client/boards/native_sim_native_64.conf
```kconfig
# Board-specific config for native_sim/native/64
# Client role uses zeth1 (server uses zeth0)

CONFIG_ETH_NATIVE_POSIX_DRV_NAME="zeth1"

# Slow down simulated time to match real wall-clock time.
# Without this, zenoh-pico query timeouts (z_get) expire at CPU speed
# while network I/O through TAP takes real wall-clock time, causing
# service calls to time out before replies arrive.
CONFIG_NATIVE_SIM_SLOWDOWN_TO_REAL_TIME=y
```

## examples/zephyr/rust/zenoh/talker/boards/native_sim_native_64.conf
```kconfig
# Board-specific config for native_sim/native/64
# Sets the TAP interface name to zeth0 for the talker

CONFIG_ETH_NATIVE_POSIX_DRV_NAME="zeth0"
CONFIG_NATIVE_SIM_SLOWDOWN_TO_REAL_TIME=y
```

## integrations/nuttx/Kconfig
```kconfig
# Phase 139.4 / 152.7 / 157.B — Kconfig surfaced under
# `Application Configuration → External Modules → nano-ros`.
#
# 152.7 — promoted free-form `string` knobs to `choice` so
# `make menuconfig` drives Cargo `--features` cleanly via the
# matching `CONFIG_NROS_RMW_*` / `CONFIG_NROS_ROS_*` symbols read
# by the sibling `Makefile`.
#
# 157.B — this file is the integration shell's own Kconfig,
# discovered by NuttX once symlinked to `apps/external/nano-ros/`
# AND the Phase 157.C staging script has copied
# `external-Kconfig.in` to `apps/external/Kconfig` (which
# osource-globs every `apps/external/*/Kconfig`). Example apps
# (apps/external/nano-ros-talker-c/Kconfig etc.) are discovered
# as separate apps/external/ siblings via that same glob. Example
# Kconfigs depend on NROS_C_API / NROS_CPP_API (declared below)
# so menuconfig only shows examples whose host API is enabled.

config NROS
    bool "nano-ros ROS 2 client"
    default n
    help
      Enables the nano-ros Cargo-built static library in the NuttX
      build. Cargo runs in NuttX's `context::` phase via the
      upstream `apps/tools/Rust.mk` macros; the resulting
      `libnros_c.a` (and optionally `libnros_cpp.a`) is appended to
      `EXTRA_LIBS` for the monolithic link.

if NROS

choice
    prompt "RMW backend"
    default NROS_RMW_ZENOH
    help
      Selects the ROS 2 middleware nano-ros uses. The choice flips
      the matching `--features rmw-<name>` Cargo flag in the
      sibling Makefile.

config NROS_RMW_ZENOH
    bool "Zenoh (zenoh-pico)"
    help
      Embedded zenoh client; full ROS 2 graph support, low
      footprint. Recommended default for most NuttX boards.

config NROS_RMW_XRCE
    bool "XRCE-DDS (micro-XRCE-DDS-Client)"
    help
      Lightweight XRCE-DDS client; needs a Micro-XRCE-DDS Agent
      bridge on the host side.

config NROS_RMW_CYCLONEDDS
    bool "Cyclone DDS"
    help
      Eclipse Cyclone DDS via the rmw_cyclonedds_cpp bridge.
      Largest footprint; pick only if Cyclone-specific QoS knobs
      matter to you.

endchoice

choice
    prompt "ROS 2 edition"
    default NROS_ROS_HUMBLE

config NROS_ROS_HUMBLE
    bool "Humble"

config NROS_ROS_IRON
    bool "Iron"

endchoice

# Phase 157 — language API selectors. The C surface always builds
# (cargo features `rmw-cffi` already pulls nros-c), but the C++
# surface is opt-in because it doubles the Cargo build time +
# adds ~80 KB to the link. External-app examples key their
# Kconfig depends on these two so the menu only shows examples
# whose host API is actually enabled.

config NROS_C_API
    bool "C API surface (nros-c)"
    default y
    help
      Enables the nros-c C API. Required by every C-language
      external-app example (`apps/external/nano-ros-*-c/`).
      Disable to skip the nros-c staticlib build for C++-only
      deployments.

config NROS_CPP_API
    bool "C++ API surface (nros-cpp)"
    default n
    help
      Enables the nros-cpp C++ API. Required by every
      C++-language external-app example
      (`apps/external/nano-ros-*-cpp/`). Adds ~80 KB to the
      link + an extra Cargo build cycle.

endif # NROS
```

## integrations/nuttx/apps-external-template/Kconfig
```kconfig
# Phase 212.H.2 — NuttX apps/external/<bringup>/Kconfig template.
#
# Surfaced under `Application Configuration → External Modules →
# nano-ros bringup` once symlinked into apps/external/<bringup>/. The
# sibling Make.defs gates `CONFIGURED_APPS` registration on this knob.
#
# The knob NAME is intentionally fixed (`NROS_BRINGUP_DEMO`) because
# NuttX's `apps/external/Kconfig` aggregator can't pass per-dir
# variables. A second bringup template gets staged at a sibling
# directory with its own (sed-rewritten) Kconfig copy.

config NROS_BRINGUP_DEMO
    bool "nano-ros multi-component bringup (demo)"
    default n
    depends on NROS
    help
      Enables a nano-ros multi-component bringup package staged at
      apps/external/<bringup>/. The Makefile's `context::` rule runs
      `nros codegen-system` to bake system.toml + launch/*.xml into
      compile-time C config, then cross-builds the bringup Rust
      workspace for the configured NuttX target triple.

      See docs/design/multi-node-workspace-layout.md for the
      `<bringup>` package shape (system.toml, launch/system.launch.xml,
      sibling component crates, optional nuttx_app_glue/).
```

## integrations/px4/module-template/component-skeleton/Kconfig
```kconfig
# Phase 212.H.7 — per-component PX4 Kconfig skeleton.
#
# Rendered once per `[[component]]` by `nros codegen-system
# --ahead-of-vendor --target px4`. The codegen replaces @COMPONENT_NAME@
# with the component's lowercase name; PX4's Kconfig walker discovers it
# under `src/modules/nros_<name>/Kconfig`.
menuconfig USER_NROS_@COMPONENT_NAME_UPPER@
	bool "nano-ros component: @COMPONENT_NAME@"
	default y
	help
	  nano-ros component '@COMPONENT_NAME@' emitted by
	  `nros codegen-system --ahead-of-vendor --target px4` from the
	  bringup pkg's system.toml. The body is a uORB-backed publisher /
	  subscriber generated against the component's nros metadata.
```

## integrations/zephyr/Kconfig
```kconfig
# Phase 139.1 — Kconfig knobs surfaced by the nano-ros Zephyr shell.
#
# Maps user `prj.conf` settings to CMake cache vars consumed by the
# Phase 137 root CMakeLists.txt. Keep the surface MINIMAL — RMW-specific
# tuning lives in the long-standing `zephyr/Kconfig` at the repo root
# (which the legacy module honours). This shell only owns the
# add-subdirectory dispatch knobs.

menuconfig NROS
    bool "nano-ros ROS 2 client (Phase 139 integration shell)"
    help
      Enables the nano-ros Zephyr integration shell. The shell pulls
      the unified Phase 137 / 138 root CMake into the Zephyr build and
      links NanoRos::NanoRos into the application.

      For richer transport / executor tuning, also enable the legacy
      `zephyr/` module knobs (kept until Phase 140).

if NROS

config NROS_RMW
    string "RMW backend (zenoh | dds | xrce | cyclonedds)"
    default "zenoh"
    help
      Maps to the NANO_ROS_RMW CMake cache variable.

config NROS_ROS_EDITION
    string "ROS 2 edition (humble | iron)"
    default "humble"
    help
      Maps to the NANO_ROS_ROS_EDITION CMake cache variable.

endif # NROS
```

## packages/boards/nros-board-fvp-aemv8r-smp/boards/fvp_baser_aemv8r_fvp_aemv8r_aarch64_smp.conf
```kconfig
# Board overlay for fvp_baser_aemv8r/fvp_aemv8r_aarch64/smp
#
# Layered on top of the in-tree `prj.conf` for runs targeting the
# 64-bit Cortex-A SMP variant of the FVP. Picks up the Arm GICv3
# arch timer, enables 4-CPU SMP scheduling (matching the FVP's
# default cpu count), and wires the FVP's emulated ethernet to
# Zephyr's net stack.

CONFIG_SMP=y
CONFIG_MP_MAX_NUM_CPUS=4

# Zephyr's stock `fvp_baser_aemv8r_aarch64_smp_defconfig` already
# turns on `CONFIG_ARM_ARCH_TIMER`, `CONFIG_CACHE_MANAGEMENT`,
# `CONFIG_PM_CPU_OPS`, `CONFIG_ARM64_SET_VMPIDR_EL2`, and the
# UART/console plumbing — not repeated here.

# FVP's emulated ethernet — reachable via the `--network` CLI option
# on the FVP runner, which bridges to a tap device on the host.
CONFIG_ETH_DRIVER=y
# The SMSC 91C111 model + its MDIO bus. Without ETH_SMSC91X the DTS eth node
# has no driver; without MDIO (+ a late ETH_INIT_PRIORITY so the bus is ready
# first) the smsc driver's mdio path dereferences a null register base and
# faults at init. Matches the ASI reference image. phase-292 W2 / issue 0232.
CONFIG_ETH_SMSC91X=y
CONFIG_MDIO=y
# The SMSC 91C111 bank-switches ONE MMIO window between its ethernet and MDIO
# register banks, so the MDIO + PHY drivers must init AFTER the eth driver has
# set up that base — otherwise the mdio driver's smsc_select_bank writes to a
# null base and faults (Data Abort in smsc_select_bank at init). Order:
# eth(80) < mdio(81) < phy(82), matching the ASI reference image. Defaults
# (mdio=60, phy=70) put them BEFORE eth → crash.
CONFIG_ETH_INIT_PRIORITY=80
CONFIG_MDIO_INIT_PRIORITY=81
CONFIG_PHY_INIT_PRIORITY=82

# Heap budget — Cyclone DDS allocates ~64 KiB of static state per
# domain participant + per-topic descriptors. 192 KiB leaves room
# for app-side message buffers without OOM.
CONFIG_HEAP_MEM_POOL_SIZE=196608

# RNG — the FVP has no entropy peripheral, so Zephyr's test PRNG
# (xoroshiro128 seeded from k_uptime + boot-time markers) is the
# only sys_rand_get backend available. Phase-117 cyclonedds-on-FVP
# only uses RNG for participant-id generation; production hardware
# (S32Z R52 in 117.11) replaces with a real entropy driver.
CONFIG_TEST_RANDOM_GENERATOR=y

# The SMSC eth<->mdio<->phy ordering above (eth first, so it sets up the
# shared MMIO base before mdio/phy touch it) is runtime-correct but trips
# Zephyr's build-time init-priority checker (eth declares a phy-handle
# dependency, so the checker wants phy FIRST). Disable it for this board —
# the hardware constraint wins. Matches the ASI reference image.
CONFIG_CHECK_INIT_PRIORITIES=n
```

## packages/boards/nros-board-s32z270dc2-r52/boards/s32z2xxdc2_s32z270_rtu0_D.conf
```kconfig
# Board overlay for s32z2xxdc2/s32z270/rtu0/D
#
# S32Z270-DC RTU0 D-rev silicon. Layered on top of the in-tree
# `prj.conf` for runs targeting the eval board.

# Cyclone DDS participant + endpoint metadata. 64 KiB is the floor
# for one participant + ~4 endpoints; the eval board has only 1 MiB
# SRAM (post-XIP=n) so growing past 64 KiB squeezes the kernel +
# net stack out of RAM. Production deployments with more topics
# either trim the kernel/net buffers below or move SRAM to LPDDR.
CONFIG_HEAP_MEM_POOL_SIZE=65536

# Net stack — shrink default RX/TX queues so the heap budget fits.
# Phase 117.13 build smoke needs the link step to succeed; runtime
# tuning lands when the eval board is plugged in.
CONFIG_NET_PKT_RX_COUNT=8
CONFIG_NET_PKT_TX_COUNT=8
CONFIG_NET_BUF_RX_COUNT=16
CONFIG_NET_BUF_TX_COUNT=16
CONFIG_NET_MAX_CONTEXTS=8

# Tighter pthread / mutex pool — Cyclone DDS needs ~3 worker threads
# + per-endpoint mutexes; 12 / 24 covers a basic talker/listener
# workload without consuming all of SRAM.
CONFIG_MAX_PTHREAD_COUNT=12
CONFIG_POSIX_THREAD_THREADS_MAX=12
CONFIG_MAX_PTHREAD_MUTEX_COUNT=24
CONFIG_MAX_PTHREAD_COND_COUNT=12

# Disable IPv6 (Phase-117 wire is IPv4 only) — saves ~16 KiB net.
CONFIG_NET_IPV6=n

# Cap the system + main stack so the kernel image leaves room for
# heap + net buffers in the 1 MiB SRAM.
CONFIG_MAIN_STACK_SIZE=8192
CONFIG_SYSTEM_WORKQUEUE_STACK_SIZE=2048
CONFIG_ISR_STACK_SIZE=2048

# RNG — S32Z lacks an entropy peripheral with a Zephyr driver; fall
# back to the test PRNG. Production deployments should replace with
# the SoC's TRNG once a Zephyr driver lands.
CONFIG_TEST_RANDOM_GENERATOR=y

# ENETC mailbox driver and clock. The eval board's J22 RJ45 hangs
# off PSI0; the stock board defconfig already wires it.
CONFIG_NET_DRIVERS=y
```
