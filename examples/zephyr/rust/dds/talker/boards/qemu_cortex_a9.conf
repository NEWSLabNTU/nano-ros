## packages/boards/nros-board-zephyr/boards/fvp-aemv8r-smp/zephyr-rust-support/Kconfig
```kconfig
# Phase 215.J.4 — board Kconfig overlay: enable RUST_SUPPORTED for the FVP
# Base_RevC AEMv8-R board WITHOUT mutating the consumer's zephyr-lang-rust tree.
#
# `zephyr-lang-rust` declares `config RUST_SUPPORTED` as a typeless-prompt bool
# whose only `default y if (...)` covers Cortex-M / RISC-V / 64-bit ARCH_POSIX
# — none of which match this board's AArch64 AEMv8-R (Cortex-R) core, so
# `RUST_SUPPORTED` defaults n and `CONFIG_RUST=y` is silently dropped.
#
# Kconfig allows a symbol's properties to be defined across multiple files; the
# first `default` whose condition is satisfied (in parse order) wins. Since the
# upstream condition is false on this board, the board-keyed default below is
# the one that fires — a non-destructive cross-file extension. Restating `bool`
# keeps the symbol well-typed regardless of which module Kconfig parses first.
#
# This handles only the RUST_SUPPORTED symbol; the lang-rust CMake
# `_rust_map_target` → `aarch64-unknown-none` mapping is supplied separately by
# scripts/zephyr/aarch64-rust-patch.sh (Phase 215.J.2 step (b)).

config RUST_SUPPORTED
	bool
	default y if BOARD_FVP_BASER_AEMV8R
```

## packages/boards/nros-nuttx-qemu-arm/nuttx-config/defconfig
```kconfig
#
# NuttX defconfig for QEMU ARM virt (Cortex-A7) with networking
#
# Base: boards/arm/qemu/qemu-armv7a/configs/nsh/defconfig
# Additions: networking (TCP/UDP/BSD sockets), virtio-net, POSIX threading,
#            /dev/urandom, larger stacks for zenoh-pico.
#
# Usage:
#   cp defconfig $NUTTX_DIR/.config
#   cd $NUTTX_DIR && make olddefconfig
#   make
#

# --- Architecture ---
CONFIG_ARCH="arm"
CONFIG_ARCH_BOARD="qemu-armv7a"
CONFIG_ARCH_BOARD_QEMU_ARMV7A=y
CONFIG_ARCH_CHIP="qemu"
CONFIG_ARCH_CHIP_QEMU_ARM=y
CONFIG_ARCH_CHIP_QEMU_CORTEXA7=y
CONFIG_ARCH_INTERRUPTSTACK=2048
CONFIG_ARCH_LOWVECTORS=y

# --- Memory layout (QEMU virt) ---
CONFIG_RAM_SIZE=132120576
CONFIG_RAM_START=0x40200000
CONFIG_RAM_VSTART=0x40200000
CONFIG_FLASH_SIZE=127926272
CONFIG_FLASH_START=0x00600000
CONFIG_FLASH_VSTART=0x00600000

# --- UART (PL011 serial console) ---
CONFIG_UART_PL011=y
CONFIG_UART1_PL011=y
CONFIG_UART1_BASE=0x9000000
CONFIG_UART1_IRQ=33
CONFIG_UART1_SERIAL_CONSOLE=y

# --- Toolchain ---
CONFIG_ARM_TOOLCHAIN_GNU_EABI=y

# --- Apps directory (relative to NUTTX_DIR, matches just setup-nuttx layout) ---
CONFIG_APPS_DIR="../nuttx-apps"

# --- Build options ---
CONFIG_DEBUG_FULLOPT=y
CONFIG_DEBUG_SYMBOLS=y
CONFIG_SIG_DEFAULT=y
CONFIG_RAW_BINARY=y
CONFIG_INTELHEX_BINARY=y
CONFIG_EXPERIMENTAL=y

# --- Scheduling ---
CONFIG_RR_INTERVAL=200
CONFIG_DEFAULT_TASK_STACKSIZE=8192
CONFIG_IDLETHREAD_STACKSIZE=4096
CONFIG_SCHED_HPWORK=y
CONFIG_SCHED_HPWORKPRIORITY=192
CONFIG_SCHED_LPWORK=y
CONFIG_SCHED_LPNTHREADS=2
CONFIG_SCHED_WAITPID=y
CONFIG_USEC_PER_TICK=1000

# --- Timers ---
CONFIG_ALARM_ARCH=y
CONFIG_ONESHOT=y

# --- 64-bit time_t (required: Rust libc crate assumes time_t = i64) ---
CONFIG_SYSTEM_TIME64=y
CONFIG_PREALLOC_TIMERS=4

# --- I/O buffers (required by virtio-net for packet buffers) ---
CONFIG_IOB_ALIGNMENT=16
CONFIG_IOB_BUFSIZE=1534
CONFIG_IOB_NBUFFERS=64
CONFIG_IOB_THROTTLE=8

# --- Networking (BSD sockets, TCP/UDP) ---
CONFIG_NET=y
CONFIG_NET_TCP=y
CONFIG_NET_TCP_NODELAY=y
CONFIG_NET_TCPBACKLOG=y
CONFIG_NET_UDP=y
CONFIG_NET_BROADCAST=y
CONFIG_NET_ICMP_SOCKET=y
CONFIG_NET_SOCKOPTS=y
CONFIG_NET_ETH_PKTSIZE=1514
CONFIG_NET_LL_GUARDSIZE=32
CONFIG_NET_RECV_BUFSIZE=32768
CONFIG_NET_MAX_LISTENPORTS=8
CONFIG_NET_STATISTICS=y
CONFIG_NET_ROUTE=y
CONFIG_NETDEV_WORK_THREAD=y
CONFIG_NETDEV_WORK_THREAD_POLLING_PERIOD=10000
CONFIG_NETDEV_IFINDEX=y

# --- Network initialization (QEMU slirp subnet: 10.0.2.0/24) ---
CONFIG_NETUTILS_NETINIT=y
CONFIG_NSH_NETINIT=y
CONFIG_NETINIT_IPADDR=0x0a00021e
CONFIG_NETINIT_DRIPADDR=0x0a000202
CONFIG_NETINIT_NETMASK=0xffffff00
CONFIG_NETINIT_NOMAC=y

# --- Virtio drivers (virtio-net for QEMU networking) ---
CONFIG_DRIVERS_VIRTIO=y
CONFIG_DRIVERS_VIRTIO_MMIO=y
CONFIG_DRIVERS_VIRTIO_NET=y
CONFIG_DEV_SIMPLE_ADDRENV=y
CONFIG_NET_LL_GUARDSIZE=28

# --- Device tree (virtio device discovery) ---
CONFIG_DEVICE_TREE=y

# --- POSIX threading (required by zenoh-pico + Rust std TLS) ---
CONFIG_PTHREAD_MUTEX_TYPES=y
CONFIG_PTHREAD_MUTEX_BOTH=y
CONFIG_PTHREAD_STACK_DEFAULT=65536
CONFIG_TLS_NELEM=64

# --- Random device (required by zenoh-pico RNG) ---
CONFIG_DEV_URANDOM=y
CONFIG_CRYPTO=y
CONFIG_CRYPTO_RANDOM_POOL=y

# --- Filesystem ---
CONFIG_DEV_ZERO=y
CONFIG_FS_PROCFS=y
CONFIG_FS_ROMFS=y
CONFIG_PIPES=y

# --- DNS / network database (for getaddrinfo) ---
CONFIG_LIBC_NETDB=y

# --- C++ support (for NuttX apps framework) ---
CONFIG_HAVE_CXX=y
CONFIG_HAVE_CXXINITIALIZE=y

# --- NSH shell (interactive debugging) ---
CONFIG_BUILTIN=y
CONFIG_INIT_ENTRYPOINT="nsh_main"
CONFIG_INIT_STACKSIZE=524288
CONFIG_NSH_ARCHINIT=y
CONFIG_NSH_BUILTIN_APPS=y
CONFIG_NSH_FILEIOSIZE=512
CONFIG_NSH_READLINE=y
CONFIG_READLINE_CMD_HISTORY=y
CONFIG_SYSTEM_NSH=y
CONFIG_SYSTEM_PING=y
CONFIG_NETUTILS_NETCAT=y
CONFIG_NETUTILS_WEBCLIENT=y

# --- Misc ---
CONFIG_LIBC_EXECFUNCS=y
CONFIG_RAMLOG=y
CONFIG_STACK_COLORATION=y
CONFIG_SYMTAB_ORDEREDBYNAME=y

CONFIG_STACK_USAGE_WARNING=0
```

## packages/bsp/nano-ros-bsp-zephyr/Kconfig
```kconfig
# nros BSP for Zephyr
# Copyright (c) 2024 nros contributors
# SPDX-License-Identifier: MIT OR Apache-2.0

menuconfig NANO_ROS_BSP
    bool "nros Board Support Package"
    depends on ZENOH_PICO
    help
      Enable nros BSP for simplified ROS 2 node development.
      This provides a high-level API that hides zenoh-pico details.

if NANO_ROS_BSP

config NANO_ROS_DOMAIN_ID
    int "ROS 2 Domain ID"
    default 0
    help
      ROS 2 domain ID for topic isolation.

config NANO_ROS_ZENOH_LOCATOR
    string "Zenoh router locator"
    default "tcp/192.0.2.2:7447"
    help
      Zenoh router address. Supported formats:
        TCP:    "tcp/IP:PORT"       (e.g. "tcp/192.0.2.2:7447")
        Serial: "serial/DEVICE#baudrate=RATE" (e.g. "serial/uart1#baudrate=115200")

config NANO_ROS_NODE_NAME
    string "Default node name"
    default "nros_node"
    help
      Default name for the ROS 2 node.

config NANO_ROS_MAX_PUBLISHERS
    int "Maximum number of publishers"
    default 4
    help
      Maximum number of publishers per node.

config NANO_ROS_MAX_SUBSCRIBERS
    int "Maximum number of subscribers"
    default 4
    help
      Maximum number of subscribers per node.

config NANO_ROS_MAX_SERVICES
    int "Maximum number of services per node"
    default 4
    help
      Maximum number of service servers per node.

config NANO_ROS_MAX_TIMERS
    int "Maximum number of timers per node"
    default 8
    help
      Maximum number of timers per node.

config NANO_ROS_MAX_NODES
    int "Maximum number of nodes per executor"
    default 4
    help
      Maximum number of nodes managed by one executor.

config NANO_ROS_INIT_DELAY_MS
    int "Initialization delay (ms)"
    default 2000
    help
      Delay before initializing zenoh to allow network to settle.

config NANO_ROS_TRANSPORT_SERIAL
    bool "Enable serial/UART transport"
    select ZENOH_PICO_LINK_SERIAL
    help
      Enable serial/UART transport for zenoh-pico.
      Use with a serial locator, e.g.:
        CONFIG_NANO_ROS_ZENOH_LOCATOR="serial/uart1#baudrate=115200"

config NANO_ROS_AUTO_INIT
    bool "Automatic initialization"
    default n
    help
      Automatically initialize nros BSP at boot.
      If disabled, call nano_ros_bsp_init() manually.

endif # NANO_ROS_BSP
```

## packages/cli/testing_workspaces/orchestration_e2e/deploy/zephyr-mod/west.yml
```yaml
# West manifest for the `zephyr-mod` vendor-module deploy (Phase 172 W.4).
#
# Pulls in the nano-ros Zephyr module so `west build {entry_src}` discovers
# `NanoRos::NanoRos` (the module wires the root CMake under west — see
# integrations/zephyr/{module.yml,west.yml}). Downstream/out-of-tree workspaces
# import this; an in-tree build already has nano-ros present.
manifest:
  remotes:
    - name: nano-ros
      url-base: https://github.com/NEWSLabNTU
  projects:
    - name: nano-ros
      remote: nano-ros
      path: modules/nano-ros
      import:
        file: integrations/zephyr/west.yml
```

## packages/testing/nros-tests/fixtures/multi_pkg_workspace_esp_idf/esp_idf_app/sdkconfig.defaults
```kconfig
# Phase 212.H.5 fixture — sdkconfig defaults wiring the Kconfig.projbuild
# knobs introduced by integrations/nano-ros/.
CONFIG_NROS_BRINGUP_NAME="demo_bringup"
CONFIG_NROS_DOMAIN_ID=0
CONFIG_NROS_RMW_XRCE=y
CONFIG_NROS_ROS_EDITION="humble"
```

## scripts/arduino/idf-builder/sdkconfig.defaults
```kconfig
# Phase 23.2 — IDF defaults for the Arduino library builder. Tune for
# library output size, not full app runtime. The Arduino sketch's own
# sdkconfig (delivered by arduino-esp32) overrides these at link time.

# Smallest viable C library implementation (smaller .a output).
CONFIG_NEWLIB_NANO_FORMAT=y

# Disable the IDF console + boot logger — keeps the static archives
# free of host-only printf weight that would otherwise inflate
# libnanoros.a.
CONFIG_BOOTLOADER_LOG_LEVEL_NONE=y
CONFIG_LOG_DEFAULT_LEVEL_NONE=y

# nros's own RMW pulls TCP / UDP / multicast off ESP-IDF lwIP. Keep
# lwIP defaults for the library — Arduino sketches that want to trim
# them can override.
```

## tests/esp-idf-smoke/sdkconfig.defaults
```kconfig
# Minimal config for the nros esp-idf-c smoke test.
CONFIG_FREERTOS_HZ=1000
CONFIG_ESP_TIMER_TASK_STACK_SIZE=4096
CONFIG_LWIP_DNS_SUPPORT_MDNS_QUERIES=n
```
