## CMakeLists.txt
```
# SPDX-License-Identifier: Apache-2.0
# nros Zephyr Talker Example (C) using BSP
#
# A ROS 2 compatible publisher running on Zephyr RTOS using nros BSP.
#
# Build:
#   source ~/nano-ros-workspace/env.sh
#   west build -b native_sim/native/64 nros/examples/zephyr-c-talker
#
# Run:
#   ./build/zephyr/zephyr.exe

cmake_minimum_required(VERSION 3.20.0)

find_package(Zephyr REQUIRED HINTS $ENV{ZEPHYR_BASE})
project(nano_ros_talker_c)

# =============================================================================
# Application Source
# =============================================================================
target_sources(app PRIVATE src/main.c)

# =============================================================================
# nros BSP
# =============================================================================
set(BSP_DIR ${CMAKE_CURRENT_SOURCE_DIR}/../../packages/zpico/zpico-zephyr)
target_sources(app PRIVATE ${BSP_DIR}/src/bsp_zephyr.c)
target_include_directories(app PRIVATE ${BSP_DIR}/include)

# =============================================================================
# zpico-sys (provides transport layer)
# =============================================================================
set(SHIM_DIR ${CMAKE_CURRENT_SOURCE_DIR}/../../packages/zpico/zpico-sys/c)
target_sources(app PRIVATE ${SHIM_DIR}/shim/zenoh_shim.c)
target_include_directories(app PRIVATE ${SHIM_DIR}/include)

# Disable Z_FEATURE_INTEREST to avoid write filter issues with multiple clients
zephyr_compile_definitions(Z_FEATURE_INTEREST=0 Z_FEATURE_MATCHING=0)
```

## prj.conf
```kconfig
# nros Zephyr Talker (C) Configuration
#
# This configuration enables nros BSP and networking.

# =============================================================================
# General
# =============================================================================
CONFIG_MAIN_STACK_SIZE=16384
CONFIG_HEAP_MEM_POOL_SIZE=65536
CONFIG_SYSTEM_WORKQUEUE_STACK_SIZE=4096

# =============================================================================
# Logging
# =============================================================================
CONFIG_LOG=y
CONFIG_LOG_DEFAULT_LEVEL=3
CONFIG_PRINTK=y
CONFIG_EARLY_CONSOLE=y

# Use printk backend for logging (not RTT)
CONFIG_LOG_BACKEND_RTT=n

# =============================================================================
# Networking
# =============================================================================
CONFIG_NETWORKING=y
CONFIG_NET_IPV4=y
CONFIG_NET_TCP=y
CONFIG_NET_UDP=y
CONFIG_NET_SOCKETS=y

# Network buffers
CONFIG_NET_PKT_RX_COUNT=32
CONFIG_NET_PKT_TX_COUNT=32
CONFIG_NET_BUF_RX_COUNT=64
CONFIG_NET_BUF_TX_COUNT=64
CONFIG_NET_MAX_CONTEXTS=16

# Network interface
CONFIG_NET_L2_ETHERNET=y
CONFIG_ETH_NATIVE_POSIX_DRV_NAME="zeth0"

# Static IP configuration
CONFIG_NET_CONFIG_SETTINGS=y
CONFIG_NET_CONFIG_NEED_IPV4=y
CONFIG_NET_CONFIG_MY_IPV4_ADDR="192.0.2.1"
CONFIG_NET_CONFIG_MY_IPV4_GW="192.0.2.2"
CONFIG_NET_CONFIG_MY_IPV4_NETMASK="255.255.255.0"

# DNS (optional)
CONFIG_DNS_RESOLVER=n

# =============================================================================
# POSIX API (required by zenoh-pico)
# =============================================================================
CONFIG_POSIX_API=y

# zenoh-pico allocates POSIX mutexes for transport and write filters.
# Zephyr defaults to 5 which is insufficient for zenoh-pico.
CONFIG_MAX_PTHREAD_MUTEX_COUNT=32
CONFIG_MAX_PTHREAD_COND_COUNT=16

# =============================================================================
# zenoh-pico
# =============================================================================
CONFIG_ZENOH_PICO=y
CONFIG_ZENOH_PICO_PUBLICATION=y
CONFIG_ZENOH_PICO_SUBSCRIPTION=y
CONFIG_ZENOH_PICO_LINK_TCP=y
CONFIG_ZENOH_PICO_MULTI_THREAD=y

# =============================================================================
# nros BSP Configuration
# =============================================================================
# Note: CONFIG_NANO_ROS_BSP would be enabled via module integration
# For now, these are documented for future Kconfig integration:
#
# CONFIG_NANO_ROS_ZENOH_LOCATOR="tcp/192.0.2.2:7447"
# CONFIG_NANO_ROS_DOMAIN_ID=0
# CONFIG_NANO_ROS_INIT_DELAY_MS=2000

# =============================================================================
# Timing
# =============================================================================
CONFIG_SYS_CLOCK_TICKS_PER_SEC=1000

# =============================================================================
# Debug
# =============================================================================
CONFIG_DEBUG=y
CONFIG_DEBUG_INFO=y

# Network debug logging
CONFIG_NET_LOG=y
CONFIG_NET_STATISTICS=y
CONFIG_NET_SHELL=y
```

## src/main.c
```c
/**
 * @file main.c
 * @brief Zephyr C talker example using nano-ros BSP
 *
 * This example demonstrates using nano-ros BSP on Zephyr RTOS.
 * The BSP handles zenoh initialization and ROS 2 keyexpr formatting.
 */

#include <zephyr/kernel.h>
#include <zephyr/logging/log.h>

#include "nano_ros_bsp_zephyr.h"

LOG_MODULE_REGISTER(nano_ros_talker, LOG_LEVEL_INF);

/* ============================================================================
 * std_msgs/Int32 message support
 * ============================================================================ */

typedef struct std_msgs_Int32 {
    int32_t data;
} std_msgs_Int32;

/**
 * Serialize to CDR format
 * CDR format for Int32: 4-byte header + 4-byte int32
 */
static int32_t std_msgs_Int32_serialize(const std_msgs_Int32 *msg, uint8_t *buffer, size_t buffer_size)
{
    if (buffer_size < 8) {
        return -1;
    }
    /* CDR header (little-endian) */
    buffer[0] = 0x00;
    buffer[1] = 0x01;
    buffer[2] = 0x00;
    buffer[3] = 0x00;
    /* Little-endian int32 */
    buffer[4] = (uint8_t)(msg->data & 0xFF);
    buffer[5] = (uint8_t)((msg->data >> 8) & 0xFF);
    buffer[6] = (uint8_t)((msg->data >> 16) & 0xFF);
    buffer[7] = (uint8_t)((msg->data >> 24) & 0xFF);
    return 8;
}

/* ============================================================================
 * Application
 * ============================================================================ */

int main(void)
{
    LOG_INF("nano-ros Zephyr C Talker (BSP)");
    LOG_INF("==============================");

    /* Initialize BSP (uses Kconfig for zenoh locator) */
    nano_ros_bsp_context_t ctx;
    int32_t ret = nano_ros_bsp_init(&ctx);
    if (ret != NANO_ROS_BSP_OK) {
        LOG_ERR("BSP init failed: %d", ret);
        return 1;
    }

    /* Create node */
    nano_ros_node_t node;
    ret = nano_ros_bsp_create_node(&ctx, &node, "zephyr_talker");
    if (ret != NANO_ROS_BSP_OK) {
        LOG_ERR("Node creation failed: %d", ret);
        return 1;
    }

    /* Create publisher */
    nano_ros_publisher_t pub;
    ret = nano_ros_bsp_create_publisher(&node, &pub, "/chatter", "std_msgs::msg::dds_::Int32_");
    if (ret != NANO_ROS_BSP_OK) {
        LOG_ERR("Publisher creation failed: %d", ret);
        return 1;
    }

    /* Publish messages */
    std_msgs_Int32 msg = { .data = 0 };
    uint8_t buffer[64];

    LOG_INF("Publishing messages...");

    while (1) {
        msg.data++;

        int32_t len = std_msgs_Int32_serialize(&msg, buffer, sizeof(buffer));
        if (len > 0) {
            ret = nano_ros_bsp_publish(&pub, buffer, (size_t)len);
            if (ret == NANO_ROS_BSP_OK) {
                LOG_INF("Published: %d", msg.data);
            } else {
                LOG_ERR("Publish failed: %d", ret);
            }
        }

        nano_ros_bsp_spin_once(&ctx, K_SECONDS(1));
    }

    /* Cleanup (unreachable in this example) */
    nano_ros_bsp_destroy_publisher(&pub);
    nano_ros_bsp_shutdown(&ctx);

    return 0;
}
```
