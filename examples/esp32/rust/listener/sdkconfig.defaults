## examples/esp32/rust/listener/sdkconfig.defaults
```kconfig
# Phase 212.M.7 — ESP-IDF listener sdkconfig defaults.
#
# Mirrors the H.5 fixture's nano-ros Kconfig wiring. Adjust
# CONFIG_NROS_DOMAIN_ID + CONFIG_NROS_RMW per deployment.
CONFIG_NROS_BRINGUP_NAME="esp32_bsp_listener"
CONFIG_NROS_DOMAIN_ID=0
CONFIG_NROS_RMW_XRCE=y
CONFIG_NROS_ROS_EDITION="humble"
```

## examples/qemu-arm-nuttx/c/action-server/Kconfig
```kconfig
# Phase 157 — NuttX external-app Kconfig for the C action-server example.
# Sourced from `integrations/nuttx/Kconfig` via osource glob.

config NROS_EXAMPLE_ACTION_SERVER_C
    tristate "nano-ros: C action-server (zenoh)"
    default n
    depends on NROS && NROS_C_API
    ---help---
        Hosts an example_interfaces/action/Fibonacci action on /fibonacci.
        Built-in command name: `nuttx_c_action_server`.
```

## examples/qemu-arm-nuttx/c/listener/Kconfig
```kconfig
# Phase 157 — NuttX external-app Kconfig for the C listener example.
# Sourced from `integrations/nuttx/Kconfig` via osource glob.

config NROS_EXAMPLE_LISTENER_C
    tristate "nano-ros: C listener (zenoh)"
    default n
    depends on NROS && NROS_C_API
    ---help---
        Subscribes to std_msgs/msg/Int32 on /chatter and prints each message.
        Built-in command name: `nuttx_c_listener`.
```

## examples/qemu-arm-nuttx/c/service-server/Kconfig
```kconfig
# Phase 157 — NuttX external-app Kconfig for the C service-server example.
# Sourced from `integrations/nuttx/Kconfig` via osource glob.

config NROS_EXAMPLE_SERVICE_SERVER_C
    tristate "nano-ros: C service-server (zenoh)"
    default n
    depends on NROS && NROS_C_API
    ---help---
        Hosts an example_interfaces/srv/AddTwoInts service on /add_two_ints.
        Built-in command name: `nuttx_c_service_server`.
```

## examples/qemu-arm-nuttx/c/zenoh/action-client/Kconfig
```kconfig
# Phase 157 — NuttX external-app Kconfig for the C action-client example.
# Sourced from `integrations/nuttx/Kconfig` via osource glob.

config NROS_EXAMPLE_ACTION_CLIENT_C
    tristate "nano-ros: C action-client (zenoh)"
    default n
    depends on NROS && NROS_C_API
    ---help---
        Sends an example_interfaces/action/Fibonacci goal on /fibonacci and streams feedback.
        Built-in command name: `nuttx_c_action_client`.
```

## examples/qemu-arm-nuttx/c/zenoh/service-client/Kconfig
```kconfig
# Phase 157 — NuttX external-app Kconfig for the C service-client example.
# Sourced from `integrations/nuttx/Kconfig` via osource glob.

config NROS_EXAMPLE_SERVICE_CLIENT_C
    tristate "nano-ros: C service-client (zenoh)"
    default n
    depends on NROS && NROS_C_API
    ---help---
        Calls example_interfaces/srv/AddTwoInts on /add_two_ints and prints the result.
        Built-in command name: `nuttx_c_service_client`.
```

## examples/qemu-arm-nuttx/c/zenoh/talker/Kconfig
```kconfig
# Phase 157 — NuttX external-app Kconfig for the C talker example.
# Sourced from `integrations/nuttx/Kconfig` via osource glob.

config NROS_EXAMPLE_TALKER_C
    tristate "nano-ros: C talker (zenoh)"
    default n
    depends on NROS && NROS_C_API
    ---help---
        Publishes std_msgs/msg/Int32 on /chatter via zenoh-pico.
        Built-in command name: `nuttx_c_talker`.
```

## examples/qemu-arm-nuttx/cpp/action-server/Kconfig
```kconfig
# Phase 157 — NuttX external-app Kconfig for the CPP action-server example.
# Sourced from `integrations/nuttx/Kconfig` via osource glob.

config NROS_EXAMPLE_ACTION_SERVER_CPP
    tristate "nano-ros: CPP action-server (zenoh)"
    default n
    depends on NROS && NROS_CPP_API
    ---help---
        Hosts an example_interfaces/action/Fibonacci action on /fibonacci.
        Built-in command name: `nuttx_cpp_action_server`.
```

## examples/qemu-arm-nuttx/cpp/zenoh/action-client/Kconfig
```kconfig
# Phase 157 — NuttX external-app Kconfig for the CPP action-client example.
# Sourced from `integrations/nuttx/Kconfig` via osource glob.

config NROS_EXAMPLE_ACTION_CLIENT_CPP
    tristate "nano-ros: CPP action-client (zenoh)"
    default n
    depends on NROS && NROS_CPP_API
    ---help---
        Sends an example_interfaces/action/Fibonacci goal on /fibonacci and streams feedback.
        Built-in command name: `nuttx_cpp_action_client`.
```

## examples/qemu-arm-nuttx/cpp/zenoh/listener/Kconfig
```kconfig
# Phase 157 — NuttX external-app Kconfig for the CPP listener example.
# Sourced from `integrations/nuttx/Kconfig` via osource glob.

config NROS_EXAMPLE_LISTENER_CPP
    tristate "nano-ros: CPP listener (zenoh)"
    default n
    depends on NROS && NROS_CPP_API
    ---help---
        Subscribes to std_msgs/msg/Int32 on /chatter and prints each message.
        Built-in command name: `nuttx_cpp_listener`.
```

## examples/qemu-arm-nuttx/cpp/zenoh/service-client/Kconfig
```kconfig
# Phase 157 — NuttX external-app Kconfig for the CPP service-client example.
# Sourced from `integrations/nuttx/Kconfig` via osource glob.

config NROS_EXAMPLE_SERVICE_CLIENT_CPP
    tristate "nano-ros: CPP service-client (zenoh)"
    default n
    depends on NROS && NROS_CPP_API
    ---help---
        Calls example_interfaces/srv/AddTwoInts on /add_two_ints and prints the result.
        Built-in command name: `nuttx_cpp_service_client`.
```

## examples/qemu-arm-nuttx/cpp/zenoh/service-server/Kconfig
```kconfig
# Phase 157 — NuttX external-app Kconfig for the CPP service-server example.
# Sourced from `integrations/nuttx/Kconfig` via osource glob.

config NROS_EXAMPLE_SERVICE_SERVER_CPP
    tristate "nano-ros: CPP service-server (zenoh)"
    default n
    depends on NROS && NROS_CPP_API
    ---help---
        Hosts an example_interfaces/srv/AddTwoInts service on /add_two_ints.
        Built-in command name: `nuttx_cpp_service_server`.
```

## examples/qemu-arm-nuttx/cpp/zenoh/talker/Kconfig
```kconfig
# Phase 157 — NuttX external-app Kconfig for the CPP talker example.
# Sourced from `integrations/nuttx/Kconfig` via osource glob.

config NROS_EXAMPLE_TALKER_CPP
    tristate "nano-ros: CPP talker (zenoh)"
    default n
    depends on NROS && NROS_CPP_API
    ---help---
        Publishes std_msgs/msg/Int32 on /chatter via zenoh-pico.
        Built-in command name: `nuttx_cpp_talker`.
```

## examples/templates/zephyr-byo/west.yml
```yaml
# nano-ros Zephyr starter — west manifest (Phase 205.A).
#
# This is a *manifest + app* starter, NOT a vendored/pre-patched Zephyr. It pins
# a nano-ros-tested Zephyr line and imports nano-ros as a west module, so
# `west init -m <this-repo>` + `west update` yields a known-good
# (Zephyr × nano-ros) pair. Patches are applied to YOUR workspace by
# `nros setup zephyr` / `west patch` (see README) — never shipped pre-applied.
#
# 4.4 line: switch `zephyr` revision to `v4.4.0` (needs Python ≥ 3.12; select the
# RMW with `-S nros-zenoh` instead of the prj-zenoh.conf overlay).
manifest:
  version: "1.0"

  remotes:
    - name: zephyrproject-rtos
      url-base: https://github.com/zephyrproject-rtos
    - name: NEWSLabNTU
      url-base: https://github.com/NEWSLabNTU

  projects:
    - name: zephyr
      remote: zephyrproject-rtos
      revision: v3.7.0          # nano-ros-tested LTS pin
      import:
        # Minimal module set for native_sim; add HALs for your real board.
        name-allowlist:
          - cmsis
          - picolibc
          - net-tools
    - name: nano-ros
      remote: NEWSLabNTU
      revision: main
      path: modules/nano-ros
      import:
        file: integrations/zephyr/west.yml

  self:
    path: nano-ros-app
```

## examples/workspaces/realtime-cpp/src/zephyr_entry/sample.yaml
```yaml
# phase-281 W3b — nano-ros RT-tiers C++ workspace Entry as a Zephyr sample
# (Twister-discoverable). Boots the ctrl (10 ms, high tier) + telem (100 ms, low
# tier) pair via ZephyrBoard::run_tiers (the W3a run_tiers seam's first full link).
sample:
  name: nano-ros C++ RT-Tiers Workspace Entry
  description: nano-ros RT-tiers (run_tiers) C++ workspace Entry on Zephyr, zenoh RMW
common:
  tags:
    - nano-ros
    - nros
  harness: console
tests:
  sample.nano-ros.cpp.ws-realtime-entry.zenoh:
    build_only: true
    platform_allow:
      - native_sim/native/64
    integration_platforms:
      - native_sim/native/64
```

## examples/workspaces/realtime-rust/src/zephyr_entry/sample.yaml
```yaml
# phase-276 W2 / issue #128 half 2 — nano-ros RT-tiers Rust workspace Entry
# as a Zephyr sample (Twister-discoverable). Boots the ctrl (10 ms, high
# tier) + telem (100 ms, low tier) pair via ZephyrBoard::run_tiers.
sample:
  name: nano-ros Rust RT-Tiers Workspace Entry
  description: nano-ros RT-tiers (run_tiers) workspace Entry on Zephyr, zenoh RMW
common:
  tags:
    - nano-ros
    - nros
  harness: console
  harness_config:
    type: one_line
    regex:
      - "nros: zephyr workspace entry up"
tests:
  sample.nano-ros.rust.ws-params-entry.zenoh:
    build_only: true
    platform_allow:
      - native_sim/native/64
    integration_platforms:
      - native_sim/native/64
    extra_args:
      - SNIPPET=nros-zenoh
```

## examples/workspaces/rust/src/zephyr_entry/sample.yaml
```yaml
# Phase 225.P — nano-ros Rust workspace Entry as a Zephyr sample
# (Twister-discoverable). Boots the two-node demo_bringup topology
# (talker + listener) from a single launch file.
sample:
  name: nano-ros Rust Workspace Entry
  description: nano-ros two-node (talker + listener) workspace Entry on Zephyr, zenoh RMW
common:
  tags:
    - nano-ros
    - nros
  harness: console
  harness_config:
    type: one_line
    regex:
      - "nros: zephyr workspace entry up"
tests:
  sample.nano-ros.rust.workspace-entry.zenoh:
    build_only: true
    platform_allow:
      - native_sim/native/64
    integration_platforms:
      - native_sim/native/64
    extra_args:
      - SNIPPET=nros-zenoh
```

## examples/workspaces/ws-lifecycle-rust/src/zephyr_entry/sample.yaml
```yaml
# phase-276 W3 (#128) — nano-ros managed (lifecycle) Rust workspace Entry as a
# Zephyr sample (Twister-discoverable). Boots the talker node with the five
# REP-2002 lifecycle services + boot autostart from a single launch file +
# system.toml.
sample:
  name: nano-ros Rust Lifecycle Workspace Entry
  description: nano-ros managed (lifecycle autostart) workspace Entry on Zephyr, zenoh RMW
common:
  tags:
    - nano-ros
    - nros
  harness: console
  harness_config:
    type: one_line
    regex:
      - "nros: zephyr workspace entry up"
tests:
  sample.nano-ros.rust.ws-lifecycle-entry.zenoh:
    build_only: true
    platform_allow:
      - native_sim/native/64
    integration_platforms:
      - native_sim/native/64
    extra_args:
      - SNIPPET=nros-zenoh
```

## examples/workspaces/ws-qos-rust/src/zephyr_entry/sample.yaml
```yaml
# phase-276 W1 (#128) — nano-ros QoS-override Rust workspace Entry as a
# Zephyr sample (Twister-discoverable). Boots the param_talker node with
# the six ROS 2 parameter services from a single launch file + system.toml.
sample:
  name: nano-ros Rust Params Workspace Entry
  description: nano-ros QoS-override (param services) workspace Entry on Zephyr, zenoh RMW
common:
  tags:
    - nano-ros
    - nros
  harness: console
  harness_config:
    type: one_line
    regex:
      - "nros: zephyr workspace entry up"
tests:
  sample.nano-ros.rust.ws-params-entry.zenoh:
    build_only: true
    platform_allow:
      - native_sim/native/64
    integration_platforms:
      - native_sim/native/64
    extra_args:
      - SNIPPET=nros-zenoh
```

## examples/workspaces/ws-safety-rust/src/zephyr_entry/sample.yaml
```yaml
# phase-276 W4 — nano-ros E2E-safety (CRC) Rust workspace Entry as a Zephyr
# sample (Twister-discoverable). Boots the talker + safe_listener pair with
# the zenoh backend's CRC attach/validate from a single launch + system.toml.
sample:
  name: nano-ros Rust Safety Workspace Entry
  description: nano-ros E2E-safety (CRC) workspace Entry on Zephyr, zenoh RMW
common:
  tags:
    - nano-ros
    - nros
  harness: console
  harness_config:
    type: one_line
    regex:
      - "nros: zephyr workspace entry up"
tests:
  sample.nano-ros.rust.ws-params-entry.zenoh:
    build_only: true
    platform_allow:
      - native_sim/native/64
    integration_platforms:
      - native_sim/native/64
    extra_args:
      - SNIPPET=nros-zenoh
```

## examples/zephyr/cpp/listener/sample.yaml
```yaml
# Phase 180.C — nano-ros C++ listener as a Zephyr sample (Twister-discoverable).
# See examples/zephyr/c/talker/sample.yaml for the mechanism.
sample:
  name: nano-ros C++ Listener
  description: nano-ros ROS 2 subscriber (C++ API) on Zephyr, zenoh RMW
common:
  tags:
    - nano-ros
    - nros
  harness: console
  harness_config:
    type: one_line
    regex:
      - "nros Zephyr C\\+\\+ Listener"
tests:
  sample.nano-ros.cpp.listener.zenoh:
    build_only: true
    platform_allow:
      - native_sim/native/64
    integration_platforms:
      - native_sim/native/64
    extra_args:
      - SNIPPET=nros-zenoh
```

## examples/zephyr/rust/cyclonedds/talker-aemv8r/sample.yaml
```yaml
# Phase 217.D.1 — Twister-discoverable sample for the FVP AEMv8-R
# Rust talker. The runtime gate (FVP license) keeps this build-only.
sample:
  name: nano-ros Rust Talker (FVP AEMv8-R, Cyclone DDS)
  description: nano-ros ROS 2 publisher (Rust API) on ARM FVP Base_RevC AEMv8-R Cortex-A SMP, Cyclone DDS RMW
common:
  tags:
    - nano-ros
    - nros
    - fvp
  harness: console
  harness_config:
    type: one_line
    regex:
      - "Phase 217.D"
tests:
  sample.nano-ros.rust.talker-aemv8r.cyclonedds:
    build_only: true
    platform_allow:
      - fvp_baser_aemv8r/fvp_aemv8r_aarch64/smp
    integration_platforms:
      - fvp_baser_aemv8r/fvp_aemv8r_aarch64/smp
```

## examples/zephyr/rust/dds/async-service-client/boards/native_sim_native_64.conf
```kconfig
# Native Sim Offloaded Sockets (NSOS) — uses host kernel BSD sockets
# instead of TAP devices. No bridge/root needed. Multiple instances work.
CONFIG_ETH_NATIVE_POSIX=n
CONFIG_NET_DRIVERS=y
CONFIG_NET_SOCKETS_OFFLOAD=y
CONFIG_NET_NATIVE_OFFLOADED_SOCKETS=y
CONFIG_NATIVE_SIM_SLOWDOWN_TO_REAL_TIME=y

# Zephyr's malloc on native_sim is backed by picolibc's COMMON_LIBC_MALLOC
# arena. dust-dds + heapless message queues hit ~256 KB easily; size up.
CONFIG_COMMON_LIBC_MALLOC_ARENA_SIZE=4194304
```

## examples/zephyr/rust/dds/listener/boards/qemu_cortex_a9.conf
```kconfig
# Phase 92 — qemu_cortex_a9 networking overlay (listener)
# Mirror of the talker overlay; differs only in static IPv4 so the two
# guests aren't on the same address.

CONFIG_NET_QEMU_ETHERNET=y
CONFIG_ETH_XLNX_GEM=y

CONFIG_NET_CONFIG_SETTINGS=y
CONFIG_NET_CONFIG_NEED_IPV4=y
CONFIG_NET_CONFIG_MY_IPV4_ADDR="192.0.2.2"
CONFIG_NET_CONFIG_MY_IPV4_NETMASK="255.255.255.0"
CONFIG_NET_IPV4_IGMP=y
CONFIG_NET_IF_MCAST_IPV4_ADDR_COUNT=4

CONFIG_HEAP_MEM_POOL_SIZE=8388608
```
