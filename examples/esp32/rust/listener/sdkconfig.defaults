## examples/zephyr/rust/dds/service-client-async/boards/qemu_cortex_a9.conf
```kconfig
# Phase 95.B — qemu_cortex_a9 networking overlay (DDS async service client)
#
# Boots Zephyr on a QEMU Zynq-7000 (Cortex-A9 + Xilinx GEM ethernet)
# with full IPv4 + IGMP. Two QEMU instances are stitched together via
# `-netdev socket,mcast=…` (added at runtime by the test harness),
# giving them a virtual L2 broadcast domain. SPDP discovery
# (RTPS multicast `239.255.0.1:7400`) flows over that segment via
# Zephyr's native IP stack — same code path as real Zephyr hardware.
#
# Listener-side overlay differs only in the static IPv4.

# ── Ethernet driver ─────────────────────────────────────────────────
CONFIG_NET_QEMU_ETHERNET=y
CONFIG_ETH_XLNX_GEM=y

# ── IPv4 + IGMP ─────────────────────────────────────────────────────
CONFIG_NET_CONFIG_SETTINGS=y
CONFIG_NET_CONFIG_NEED_IPV4=y
CONFIG_NET_CONFIG_MY_IPV4_ADDR="192.0.2.31"
CONFIG_NET_CONFIG_MY_IPV4_NETMASK="255.255.255.0"
CONFIG_NET_IPV4_IGMP=y
CONFIG_NET_IF_MCAST_IPV4_ADDR_COUNT=4

# ── Heap sizing for dust-dds ────────────────────────────────────────
# Zynq has 512 MB SRAM, plenty of room. The talker's mailbox queues
# and RTPS state easily fit inside 8 MB of heap.
# dust-dds + heapless mailboxes need a real heap. zephyr-lang-rust's
# global allocator calls picolibc `malloc()`, which is backed by the
# COMMON_LIBC_MALLOC arena (16 KiB by default — way too small for
# DDS). Zynq has 512 MB SRAM in the DTS so this is well within budget.
CONFIG_COMMON_LIBC_MALLOC_ARENA_SIZE=4194304
CONFIG_HEAP_MEM_POOL_SIZE=524288

# Verbose exception info — saves r4-r11 + user-mode SP into the
# exception stack frame so post-mortem debug can walk the user
# thread's stack chain. Phase 92.4 needs this to find what's
# calling memcpy with a NULL destination.
CONFIG_EXTRA_EXCEPTION_INFO=y
CONFIG_FAULT_DUMP=2

# Enable ARP debug + RX path debug to see why ARP replies aren't sent

# ── ARMv7-A exception stacks ────────────────────────────────────────
# qemu_cortex_a9_defconfig sets these to 8 KiB. main() runs on the
# SVC stack on AArch32; Rust formatting + dust-dds setup blow that
# easily. Bumping them across the board (FIQ/SVC/SYS) gives the
# Rust runtime enough headroom to actually print the boot banner.
CONFIG_ARMV7_EXCEPTION_STACK_SIZE=32768
CONFIG_ARMV7_FIQ_STACK_SIZE=32768
CONFIG_ARMV7_SVC_STACK_SIZE=32768
CONFIG_ARMV7_SYS_STACK_SIZE=32768
CONFIG_ISR_STACK_SIZE=32768

# ── Phase 71.29 — net_pkt / net_buf pools ───────────────────────────
# See service-server conf for rationale. Defensive bumps so the
# Embassy spin_task can't fall briefly behind on draining without
# tipping the GEM driver into "RX packet buffer alloc failed".
CONFIG_NET_PKT_RX_COUNT=256
CONFIG_NET_PKT_TX_COUNT=128
CONFIG_NET_BUF_RX_COUNT=512
CONFIG_NET_BUF_TX_COUNT=256
CONFIG_NET_BUF_DATA_SIZE=512
```
