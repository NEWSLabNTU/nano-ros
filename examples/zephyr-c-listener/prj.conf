## CMakeLists.txt
```
# SPDX-License-Identifier: Apache-2.0
# nano-ros Zephyr Listener Example (C)
#
# A ROS 2 compatible subscriber running on Zephyr RTOS using nano-ros C API.
#
# Build:
#   source ~/nano-ros-workspace/env.sh
#   west build -b native_sim/native/64 nano-ros/examples/zephyr-c-listener
#
# Run:
#   ./build/zephyr/zephyr.exe

cmake_minimum_required(VERSION 3.20.0)

find_package(Zephyr REQUIRED HINTS $ENV{ZEPHYR_BASE})
project(nano_ros_listener_c)

# =============================================================================
# Application Source
# =============================================================================
target_sources(app PRIVATE src/main.c)

# =============================================================================
# nano-ros-c headers
# =============================================================================
set(NANO_ROS_C_DIR ${CMAKE_CURRENT_SOURCE_DIR}/../../crates/nano-ros-c)
target_include_directories(app PRIVATE ${NANO_ROS_C_DIR}/include)

# =============================================================================
# zenoh-pico shim (provides transport layer)
# =============================================================================
# Use shared C shim from zenoh-pico-shim-sys
# This provides the zenoh_shim_* API used by nano-ros-c
set(SHIM_DIR ${CMAKE_CURRENT_SOURCE_DIR}/../../crates/zenoh-pico-shim-sys/c)
target_sources(app PRIVATE ${SHIM_DIR}/shim/zenoh_shim.c)
target_include_directories(app PRIVATE ${SHIM_DIR}/include)

# Disable Z_FEATURE_INTEREST to avoid write filter issues with multiple clients
# The interest feature causes _z_send_n_msg() to fail when multiple zenoh clients
# connect to the same router simultaneously. Disabling it makes pub/sub work.
# Z_FEATURE_MATCHING depends on Z_FEATURE_INTEREST, so disable both.
# Use zephyr_compile_definitions to affect all Zephyr targets including zenoh-pico
zephyr_compile_definitions(Z_FEATURE_INTEREST=0 Z_FEATURE_MATCHING=0)

# =============================================================================
# nano-ros-c library
# =============================================================================
# Note: For full integration, we need to either:
# 1. Cross-compile nano-ros-c as a static library for the target
# 2. Or use Zephyr's Rust support to build nano-ros-c as part of the build
#
# For now, this example demonstrates the API structure. Full integration
# requires implementing no_std transport support in nano-ros-c.
#
# To enable Rust library integration, uncomment:
# rust_cargo_library(nano-ros-c)
```

## prj.conf
```kconfig
# nano-ros Zephyr Listener (C) Configuration
#
# This configuration enables zenoh-pico and networking for the C API.

# =============================================================================
# General
# =============================================================================
CONFIG_MAIN_STACK_SIZE=16384
CONFIG_HEAP_MEM_POOL_SIZE=65536
CONFIG_SYSTEM_WORKQUEUE_STACK_SIZE=4096

# =============================================================================
# Logging
# =============================================================================
CONFIG_LOG=y
CONFIG_LOG_DEFAULT_LEVEL=3
CONFIG_PRINTK=y
CONFIG_EARLY_CONSOLE=y

# Use printk backend for logging (not RTT)
CONFIG_LOG_BACKEND_RTT=n

# =============================================================================
# Networking
# =============================================================================
CONFIG_NETWORKING=y
CONFIG_NET_IPV4=y
CONFIG_NET_TCP=y
CONFIG_NET_UDP=y
CONFIG_NET_SOCKETS=y

# Network buffers
CONFIG_NET_PKT_RX_COUNT=32
CONFIG_NET_PKT_TX_COUNT=32
CONFIG_NET_BUF_RX_COUNT=64
CONFIG_NET_BUF_TX_COUNT=64
CONFIG_NET_MAX_CONTEXTS=16

# Network interface
CONFIG_NET_L2_ETHERNET=y
CONFIG_ETH_NATIVE_POSIX_DRV_NAME="zeth0"

# Static IP configuration
CONFIG_NET_CONFIG_SETTINGS=y
CONFIG_NET_CONFIG_NEED_IPV4=y
CONFIG_NET_CONFIG_MY_IPV4_ADDR="192.0.2.1"
CONFIG_NET_CONFIG_MY_IPV4_GW="192.0.2.2"
CONFIG_NET_CONFIG_MY_IPV4_NETMASK="255.255.255.0"

# DNS (optional)
CONFIG_DNS_RESOLVER=n

# =============================================================================
# POSIX API (required by zenoh-pico)
# =============================================================================
CONFIG_POSIX_API=y

# =============================================================================
# zenoh-pico
# =============================================================================
CONFIG_ZENOH_PICO=y
CONFIG_ZENOH_PICO_PUBLICATION=y
CONFIG_ZENOH_PICO_SUBSCRIPTION=y
CONFIG_ZENOH_PICO_LINK_TCP=y
CONFIG_ZENOH_PICO_MULTI_THREAD=y

# =============================================================================
# Timing
# =============================================================================
CONFIG_SYS_CLOCK_TICKS_PER_SEC=1000

# =============================================================================
# Debug
# =============================================================================
CONFIG_DEBUG=y
CONFIG_DEBUG_INFO=y

# Network debug logging
CONFIG_NET_LOG=y
CONFIG_NET_STATISTICS=y
CONFIG_NET_SHELL=y
```

## src/main.c
```c
/**
 * @file main.c
 * @brief Zephyr C listener example - subscribes to std_msgs/Int32 messages
 *
 * This example demonstrates using nano-ros C API on Zephyr RTOS.
 * It uses the zenoh shim singleton API for pub/sub communication.
 */

#include <zephyr/kernel.h>
#include <zephyr/logging/log.h>

#include "zenoh_shim.h"

LOG_MODULE_REGISTER(nano_ros_listener, LOG_LEVEL_INF);

// ----------------------------------------------------------------------------
// std_msgs/Int32 message support
// ----------------------------------------------------------------------------

typedef struct std_msgs_Int32 {
    int32_t data;
} std_msgs_Int32;

// Deserialize from CDR format
// CDR format for Int32: 4-byte header + 4-byte int32
static int32_t std_msgs_Int32_deserialize(std_msgs_Int32* msg, const uint8_t* buffer, size_t buffer_size) {
    if (buffer_size < 8) {
        return -1;
    }
    // Skip CDR header (4 bytes), read little-endian int32
    msg->data = (int32_t)(
        buffer[4] |
        ((uint32_t)buffer[5] << 8) |
        ((uint32_t)buffer[6] << 16) |
        ((uint32_t)buffer[7] << 24)
    );
    return 0;
}

// ----------------------------------------------------------------------------
// ROS 2 Topic Configuration
// ----------------------------------------------------------------------------

#define DOMAIN_ID 0
#define TOPIC_NAME "/chatter"
#define TYPE_NAME "std_msgs::msg::dds_::Int32_"

// ROS 2 keyexpr format with wildcard for type hash
static char topic_keyexpr[256];

// Zenoh locator (router address)
#define ZENOH_LOCATOR "tcp/192.0.2.2:7447"

// ----------------------------------------------------------------------------
// Subscription Callback
// ----------------------------------------------------------------------------

static int message_count = 0;

// Callback signature: (const uint8_t *data, uintptr_t len, void *ctx)
static void subscription_callback(const uint8_t* data, uintptr_t len, void* context)
{
    (void)context;

    std_msgs_Int32 msg;
    if (std_msgs_Int32_deserialize(&msg, data, (size_t)len) == 0) {
        message_count++;
        LOG_INF("Received [%d]: %d", message_count, msg.data);
    } else {
        LOG_ERR("Failed to deserialize message (len=%zu)", (size_t)len);
    }
}

// ----------------------------------------------------------------------------
// Application
// ----------------------------------------------------------------------------

static int32_t sub_handle = -1;

int main(void)
{
    LOG_INF("nano-ros Zephyr C Listener");
    LOG_INF("==========================");

    // Give network time to initialize
    k_sleep(K_SECONDS(2));

    // Build ROS 2 compatible keyexpr with wildcard for type hash
    // This allows receiving from publishers with any type hash
    snprintf(topic_keyexpr, sizeof(topic_keyexpr),
             "%d%s/%s/*",
             DOMAIN_ID, TOPIC_NAME, TYPE_NAME);

    LOG_INF("Locator: %s", ZENOH_LOCATOR);
    LOG_INF("Topic keyexpr: %s", topic_keyexpr);

    // Initialize zenoh shim
    int32_t ret = zenoh_shim_init(ZENOH_LOCATOR);
    if (ret != ZENOH_SHIM_OK) {
        LOG_ERR("Failed to initialize zenoh: %d", ret);
        return 1;
    }
    LOG_INF("Zenoh initialized");

    // Open zenoh session
    ret = zenoh_shim_open();
    if (ret != ZENOH_SHIM_OK) {
        LOG_ERR("Failed to open zenoh session: %d", ret);
        return 1;
    }
    LOG_INF("Zenoh session opened");

    // Declare subscriber (returns handle)
    sub_handle = zenoh_shim_declare_subscriber(topic_keyexpr, subscription_callback, NULL);
    if (sub_handle < 0) {
        LOG_ERR("Failed to declare subscriber: %d", sub_handle);
        zenoh_shim_close();
        return 1;
    }
    LOG_INF("Subscriber declared (handle=%d) for: %s", sub_handle, topic_keyexpr);

    LOG_INF("Waiting for messages...");

    // Main loop - zenoh tasks handle message delivery
    while (1) {
        // Messages are delivered via callback from zenoh tasks
        k_sleep(K_MSEC(100));
    }

    // Cleanup (unreachable in this example)
    zenoh_shim_undeclare_subscriber(sub_handle);
    zenoh_shim_close();

    return 0;
}
```
