/****************************************************************************
 * nano-ros uORB → RMW bridge (phase-325 W3, issue 0362)
 *
 * WHAT THIS IS, AND WHY IT IS NOT THE W2 DEMO
 *
 *   examples/px4/cpp/firmware (W2) proves the ZERO-COPY property: nano-ros
 *   publishes a PX4 struct into uORB with no serialization, and a stock PX4
 *   `listener` reads it. Nothing is encoded because nothing needs to be.
 *
 *   This module proves REACH: the same in-firmware process reads uORB and
 *   re-publishes on a networked backend, so a real ROS 2 subscriber sees the
 *   data. The serialization uORB avoids comes back HERE, at the RMW boundary —
 *   necessarily, and that is the honest framing (phase-325 W4.3). Zero-copy is
 *   NOT claimed for this path.
 *
 * TWO SESSIONS — AND THIS FILE USES THE WRONG API FOR THAT (issue 0436)
 *
 *   `nros::init()` opens ONE session and `NodeBuilder::rmw(name)` binds a node to
 *   a session that ALREADY EXISTS. That is the single-session shape (what the
 *   phase-325 W3 note suggested), so the outward node below has no zenoh session
 *   to bind to and its bind fails.
 *
 *   The supported multi-RMW shape is `nros::MultiExecutor` + `SessionSpec`
 *   (`nros/bridge.hpp`, phase-128 F.5), which opens BOTH sessions up front from a
 *   spec list. Porting this module to it is blocked only on linking
 *   `libnros_bridge.a`, which `nros_px4_add_module` cannot do yet — see issue
 *   0436. The inward (uORB) half below is correct and verified working.
 *
 * WHY THE TRANSLATION IS FIELD-BY-FIELD AND NOT A memcpy
 *
 *   Both structs are generated from the same `.msg`, so the field NAMES match —
 *   but the layouts do not. PX4 reorders for packing and appends explicit
 *   padding:
 *
 *     PX4  debug_key_value_s        { uint64 timestamp; float value; char key[10]; uint8 _padding0[2]; }
 *     ROS  px4_msgs::msg::DebugKeyValue { uint64 timestamp; char key[10]; float value; }
 *
 *   A memcpy would silently transpose `key` and `value`. The map below is
 *   therefore written out, and `char[N]` is copied with its NUL terminator
 *   intact because the CDR side reads it as a string (see `fixed_str` in the
 *   bridge's FFI crate).
 *
 * WHY THE TYPE HASH MATTERS HERE AND NOT IN W2
 *
 *   On uORB, topic identity is the `orb_metadata` pointer and the ROS type name
 *   is ignored. On the wire, `rmw_zenoh` keys discovery on the RIHS01 type hash:
 *   a guessed hash is either invisible to ROS 2 or — worse — matches the wrong
 *   type. So the outward type comes from `nros generate-px4-msgs --lang cpp`,
 *   which computes the same hash the Rust `px4_msgs` crate carries (issue 0362).
 ****************************************************************************/

#include <nros/nros.hpp>

#include <px4_platform_common/defines.h>
#include <px4_platform_common/log.h>
#include <px4_platform_common/module.h>
#include <px4_platform_common/posix.h>
#include <px4_platform_common/px4_work_queue/ScheduledWorkItem.hpp>

#include <uORB/topics/debug_key_value.h>

#include "nros_rmw_uorb.h"
#include "nros_rmw_uorb_registry.h"

// Generated by `nros generate-px4-msgs --lang cpp --topics debug_key_value`.
// Carries the struct, TYPE_NAME (`px4_msgs::msg::dds_::DebugKeyValue_` — what a
// ROS 2 subscriber of PX4's own XRCE client already matches) and the real RIHS01.
#include <px4_msgs/msg/debug_key_value.hpp>

#include <cstring>


using namespace time_literals;

namespace
{

// The uORB side: a ROS-style name mapped to `ORB_ID(debug_key_value)` below.
constexpr const char *kInTopic = "/fmu/out/debug_key_value";
// The wire side: the topic a ROS 2 node subscribes.
constexpr const char *kOutTopic = "/fmu/out/debug_key_value";

// The outward backend, chosen when libnros_cpp.a was built
// (`--features rmw-<name>-cffi`) and named here so session selection does not
// depend on registration order.
#ifndef NROS_BRIDGE_RMW
#define NROS_BRIDGE_RMW "zenoh"
#endif

/// The whole point of the module: PX4 struct → ROS/CDR struct.
///
/// Field-by-field because the layouts differ (see the header comment). Kept as a
/// free function so it is trivially unit-testable and so a second topic is a
/// second function rather than more branches in `Run()`.
void translate(const debug_key_value_s &in, px4_msgs::msg::DebugKeyValue &out)
{
	out.timestamp = in.timestamp;
	out.value = in.value;
	// `char[10]`, NUL-terminated. Copy at most capacity-1 and terminate, so the
	// CDR side's `fixed_str` (which stops at the first NUL) never reads past the
	// data — the bytes after a terminator are uninitialized.
	static_assert(sizeof(out.key) >= sizeof(in.key), "ROS key buffer smaller than PX4's");
	std::memset(out.key, 0, sizeof(out.key));
	std::memcpy(out.key, in.key, sizeof(in.key));
	out.key[sizeof(out.key) - 1] = '\0';
}

} // namespace

class NrosUorbBridge : public ModuleBase<NrosUorbBridge>, public px4::ScheduledWorkItem
{
public:
	NrosUorbBridge();
	~NrosUorbBridge() override = default;

	static int task_spawn(int argc, char *argv[]);
	static int custom_command(int argc, char *argv[]);
	static int print_usage(const char *reason = nullptr);

	int print_status() override;
	bool init();

private:
	void Run() override;

	// TWO nodes on ONE executor: inward uORB, outward networked.
	nros::Node _in_node{};
	nros::Node _out_node{};
	nros::Subscription<px4_msgs::msg::DebugKeyValue> _in_sub{};
	nros::Publisher<px4_msgs::msg::DebugKeyValue> _out_pub{};

	uint32_t _forwarded{0};
	uint32_t _drops{0};
};

NrosUorbBridge::NrosUorbBridge()
	: ScheduledWorkItem(MODULE_NAME, px4::wq_configurations::lp_default)
{
}

bool NrosUorbBridge::init()
{
	// uORB has no name-keyed metadata lookup, so teach the backend which
	// orb_metadata the inward ROS-style name means. The type NAME is ignored on
	// uORB (identity is the metadata pointer) but is load-bearing outward.
	if (nros_rmw_uorb_register_topic(kInTopic, px4_msgs::msg::DebugKeyValue::TYPE_NAME,
					 ORB_ID(debug_key_value)) != NROS_RMW_RET_OK) {
		PX4_ERR("register_topic(%s) failed", kInTopic);
		return false;
	}

	{
		auto r = nros::init();
		if (!r.ok()) {
			PX4_ERR("nros::init() failed: code=%d", static_cast<int>(r.code()));
			return false;
		}
	}

	// Inward session — explicitly "uorb".
	if (!nros::create_node(_in_node, "px4_bridge_in").ok()) {
		PX4_ERR("create_node(in) failed");
		return false;
	}

	void *exec = _in_node.executor_handle();

	if (!nros::NodeBuilder(exec, "px4_bridge_in").rmw("uorb").build(_in_node).ok()) {
		PX4_ERR("bind inward node to uorb failed");
		return false;
	}

#ifndef NROS_BRIDGE_INWARD_ONLY
	// Outward session — explicitly the networked backend.
	if (!nros::NodeBuilder(exec, "px4_bridge_out").rmw(NROS_BRIDGE_RMW).build(_out_node).ok()) {
		PX4_ERR("bind outward node to %s failed", NROS_BRIDGE_RMW);
		return false;
	}
#endif

	if (!_in_node.create_subscription(_in_sub, kInTopic).ok()) {
		PX4_ERR("create_subscription(%s) failed", kInTopic);
		return false;
	}

#ifndef NROS_BRIDGE_INWARD_ONLY
	if (!_out_node.create_publisher(_out_pub, kOutTopic).ok()) {
		PX4_ERR("create_publisher(%s) on %s failed", kOutTopic, NROS_BRIDGE_RMW);
		return false;
	}
#endif

	PX4_INFO("bridging %s (uorb) -> %s (%s)", kInTopic, kOutTopic, NROS_BRIDGE_RMW);
	ScheduleOnInterval(200_ms);
	return true;
}

void NrosUorbBridge::Run()
{
	if (should_exit()) {
		ScheduleClear();
		exit_and_cleanup();
		return;
	}

	// Inward: raw PX4 bytes, no decode (this half is still zero-copy).
	uint8_t buf[sizeof(debug_key_value_s)];
	size_t len = 0;

	if (!_in_sub.try_recv_raw(buf, sizeof(buf), len).ok() || len < sizeof(debug_key_value_s)) {
		return;
	}

	const auto *in = reinterpret_cast<const debug_key_value_s *>(buf);

	// Translate, then publish TYPED — the typed path is what CDR-encodes with the
	// generated type's hash, which is what makes a ROS 2 peer able to see it.
	px4_msgs::msg::DebugKeyValue out{};
	translate(*in, out);

#ifdef NROS_BRIDGE_INWARD_ONLY
	(void)out;
	_forwarded++;
	if (false) {
#else
	if (_out_pub.publish(out).ok()) {
#endif
		_forwarded++;

		if (_forwarded == 1 || (_forwarded % 25) == 0) {
			PX4_INFO("forwarded %u samples (key=%s value=%.1f)",
				 static_cast<unsigned>(_forwarded), out.key,
				 static_cast<double>(out.value));
		}

	} else {
		_drops++;
	}
}

int NrosUorbBridge::print_status()
{
	PX4_INFO("forwarded: %u  drops: %u", static_cast<unsigned>(_forwarded),
		 static_cast<unsigned>(_drops));
	return 0;
}

int NrosUorbBridge::task_spawn(int argc, char *argv[])
{
	NrosUorbBridge *instance = new NrosUorbBridge();

	if (!instance) {
		PX4_ERR("alloc failed");
		return PX4_ERROR;
	}

	_object.store(instance);
	_task_id = task_id_is_work_queue;

	if (!instance->init()) {
		delete instance;
		_object.store(nullptr);
		_task_id = -1;
		return PX4_ERROR;
	}

	return PX4_OK;
}

int NrosUorbBridge::custom_command(int argc, char *argv[])
{
	return print_usage("unknown command");
}

int NrosUorbBridge::print_usage(const char *reason)
{
	if (reason) {
		PX4_WARN("%s", reason);
	}

	PRINT_MODULE_DESCRIPTION(
		R"DESCR_STR(
### Description
Bridges a uORB topic onto a networked RMW so a ROS 2 subscriber sees it.

Reads `/fmu/out/debug_key_value` through the uORB backend (raw PX4 struct, no
decode), translates it field-by-field into the generated CDR `px4_msgs` type, and
publishes it on the networked backend the archive was built with.

Zero-copy is NOT claimed for the outward half: the serialization uORB avoids
returns at the RMW boundary.
)DESCR_STR");

	PRINT_MODULE_USAGE_NAME("nros_uorb_bridge", "examples");
	PRINT_MODULE_USAGE_COMMAND("start");
	PRINT_MODULE_USAGE_DEFAULT_COMMANDS();
	return 0;
}

extern "C" __EXPORT int nros_uorb_bridge_main(int argc, char *argv[])
{
	return NrosUorbBridge::main(argc, argv);
}
