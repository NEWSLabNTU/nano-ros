## examples/px4/cpp/bridge/src/modules/nros_uorb_bridge/Kconfig
```kconfig
menuconfig MODULES_NROS_UORB_BRIDGE
	bool "nros_uorb_bridge"
	default n
	---help---
		nano-ros uORB -> RMW bridge: reads a uORB topic in-firmware (raw PX4
		struct, no decode) and re-publishes it as CDR px4_msgs on a networked
		backend, so a ROS 2 subscriber sees it. Zero-copy is not claimed for
		the outward half.
```

## examples/px4/cpp/firmware/src/modules/nros_uorb_demo/Kconfig
```kconfig
menuconfig MODULES_NROS_UORB_DEMO
	bool "nros_uorb_demo"
	default n
	---help---
		nano-ros uORB interop demo: publishes debug_key_value and subscribes
		vehicle_status through nano-ros, with no serialization on either side.
```

## integrations/px4/module-template/src/modules/nano_ros_app/Kconfig
```kconfig
menuconfig MODULES_NANO_ROS_APP
	bool "nano_ros_app"
	default n
	---help---
		Enable the nano-ros PX4 module template.
```

## packages/testing/nros-px4-register-check/src/modules/nros_register_check/Kconfig
```kconfig
menuconfig MODULES_NROS_REGISTER_CHECK
	bool "nros_register_check"
	default n
	---help---
		Enable the nano-ros uORB RMW register-check module. Links the
		nros-rmw-uorb backend into the SITL build and calls
		nros_rmw_uorb_register(); the build itself is the validation.
```
