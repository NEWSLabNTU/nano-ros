## CMakeLists.txt
```
# SPDX-License-Identifier: Apache-2.0
#
# Phase 121.6.zephyr-c smoke test.
#
# Standalone Zephyr application that pulls
# packages/platform/nros-platform-zephyr/src/{platform,timer}.c into
# the build via `zephyr_library_sources()` and exercises every
# capability category from the C ABI. net.c is omitted (no
# NETWORKING enabled in this profile — would require lwip/ipv4
# config + a network device).
#
# Build:  west build -b native_sim -- this directory
# Run:    ./build/zephyr/zephyr.exe
# Driver: just zephyr build-c-port / test-c-port

cmake_minimum_required(VERSION 3.20.0)

find_package(Zephyr REQUIRED HINTS $ENV{ZEPHYR_BASE})
project(nros_zephyr_c_smoke)

set(NROS_PLATFORM_C_SRC
    "${CMAKE_CURRENT_LIST_DIR}/../../packages/platform/nros-platform-zephyr/src")
set(NROS_PLATFORM_CFFI_INCLUDE
    "${CMAKE_CURRENT_LIST_DIR}/../../packages/platform/nros-platform-api/include")

target_sources(app PRIVATE
    src/main.c
    # issue 1720 -- the Rust heap half this C-only build does not link.
    src/heap_stand_in.c
    "${NROS_PLATFORM_C_SRC}/platform.c"
    "${NROS_PLATFORM_C_SRC}/timer.c")
target_include_directories(app PRIVATE "${NROS_PLATFORM_CFFI_INCLUDE}")
```

## prj.conf
```kconfig
# Phase 121.6.zephyr-c smoke — minimal config.

# Required for nros-platform-zephyr-c/src/timer.c (k_timer_*).
CONFIG_TIMESLICING=y

# k_condvar_* (used by platform.c condvar paths) needs POSIX-ish APIs.
# These are part of the kernel base config; no extra flag needed.

# Heap for k_malloc / k_free.
CONFIG_HEAP_MEM_POOL_SIZE=65536

# Stack a bit larger than default for the smoke thread's printk usage.
CONFIG_MAIN_STACK_SIZE=8192

# Console (printk via UART or POSIX stdout on native_sim).
CONFIG_PRINTK=y

# Random source. native_sim provides a host-backed entropy driver
# (CONFIG_FAKE_ENTROPY_NATIVE_POSIX); sys_rand_get pulls from it.
CONFIG_ENTROPY_GENERATOR=y
CONFIG_TEST_RANDOM_GENERATOR=y

# native_sim exits via the standard return-from-main path; allow it.
CONFIG_REBOOT=n
```

## src/main.c
```c
/*
 * Phase 121.6.zephyr-c smoke test main.
 *
 * Runs on native_sim (host x86_64 binary). Exercises one symbol
 * per capability of <nros/platform.h> + <nros/platform_timer.h>
 * through the canonical extern declarations.
 *
 * Exits the process with status 0 on PASS, 1 on first FAIL.
 * Networking paths are out of scope here (no IP stack in this
 * profile).
 */

#include <nros/platform.h>
#include <nros/platform_timer.h>

#include <zephyr/kernel.h>

#include "../../c-port-smoke-common/realloc_probe.h"

#include <inttypes.h>
#include <stdio.h>
#include <stdlib.h>
#include <string.h>

static volatile int s_timer_fires = 0;
static void on_timer(void *user_data) {
    (void) user_data;
    s_timer_fires++;
}

#define CHECK(cond, msg) do {                                                  \
    if (!(cond)) {                                                             \
        printk("FAIL: %s (%s:%d)\n", msg, __FILE__, __LINE__);                 \
        exit(1);                                                               \
    }                                                                          \
} while (0)

int main(void) {
    printk("nros-platform-zephyr-c smoke begin\n");

    /* Clock */
    uint64_t t0 = (nros_platform_clock_ns() / 1000000ULL);
    nros_platform_sleep_ms(50);
    uint64_t t1 = (nros_platform_clock_ns() / 1000000ULL);
    printk("  clock_ms: %" PRIu64 " -> %" PRIu64 "\n", t0, t1);
    CHECK(t1 >= t0 + 30, "clock_ms did not advance");

    /* Alloc */
    void *p = nros_platform_alloc(64);
    CHECK(p != NULL, "alloc");
    memset(p, 0xCC, 64);
    nros_platform_dealloc(p);

    /* Issue 1719 -- a growing realloc copies the OLD block, not the new size. */
    {
        const char *why = nros_smoke_realloc_probe();
        CHECK(why == NULL, why);
    }

    /* Yield */
    nros_platform_yield_now();

    /* Random */
    uint32_t r = nros_platform_random_u32();
    printk("  random_u32: 0x%08" PRIx32 "\n", r);

    /* Mutex round-trip on a Zephyr k_mutex (heap-allocated). */
    void *mtx = k_malloc(sizeof(struct k_mutex));
    CHECK(mtx != NULL, "mutex k_malloc");
    memset(mtx, 0, sizeof(struct k_mutex));
    CHECK(nros_platform_mutex_init(mtx) == 0, "mutex_init");
    CHECK(nros_platform_mutex_lock(mtx) == 0, "mutex_lock");
    CHECK(nros_platform_mutex_unlock(mtx) == 0, "mutex_unlock");
    CHECK(nros_platform_mutex_drop(mtx) == 0, "mutex_drop");
    k_free(mtx);
    printk("  mutex round-trip ok\n");

    /* Periodic timer fires every 20 ms; wait 200 ms then destroy. */
    void *th = nros_platform_timer_create_periodic(20 * 1000, on_timer, NULL);
    CHECK(th != NULL, "timer create_periodic");
    nros_platform_sleep_ms(200);
    nros_platform_timer_destroy(th);
    printk("  timer fires over 200ms: %d\n", s_timer_fires);
    CHECK(s_timer_fires >= 4, "periodic timer fired too few times");

    printk("nros-platform-zephyr-c smoke PASS\n");
    /* native_sim runs in its own process; exit() returns the
     * status to the host shell. */
    exit(0);
}
```

## src/heap_stand_in.c
```c
/*
 * Issue 1720 -- the Rust heap half this C-only smoke does not link.
 *
 * phase-391 W3 moved `nros_platform_alloc`'s backing out of `k_malloc` and into
 * the rlsf arena in `nros-platform/src/zephyr_heap.rs`, which every real image
 * links through its Rust staticlib. This smoke builds `platform.c` with NO Rust
 * half, so from that wave on it stopped LINKING (`undefined reference to
 * nros_zephyr_heap_alloc`) -- and nothing noticed, because no lane ran it.
 *
 * These stand-ins supply the same `nros_zephyr_heap_*` symbols over a Zephyr
 * `k_heap`, so the smoke exercises what it exists for: the PORT's `platform.c`
 * funnel (size checks, exhaustion report, dealloc) over the real kernel. The
 * rlsf arena itself is tested on the Rust side (`zpico-alloc`), not here.
 */

#include <zephyr/kernel.h>

#include <stddef.h>

#define NROS_SMOKE_HEAP_BYTES 65536

K_HEAP_DEFINE(nros_smoke_heap, NROS_SMOKE_HEAP_BYTES);

void *nros_zephyr_heap_alloc(size_t size) {
    return k_heap_alloc(&nros_smoke_heap, size, K_NO_WAIT);
}

void *nros_zephyr_heap_realloc(void *ptr, size_t size) {
    return k_heap_realloc(&nros_smoke_heap, ptr, size, K_NO_WAIT);
}

void nros_zephyr_heap_free(void *ptr) {
    k_heap_free(&nros_smoke_heap, ptr);
}

size_t nros_zephyr_heap_capacity(void) {
    return NROS_SMOKE_HEAP_BYTES;
}

/* Not tracked by the stand-in; 0 is the platform ABI's "unknown". */
size_t nros_zephyr_heap_used(void) {
    return 0;
}

size_t nros_zephyr_heap_peak(void) {
    return 0;
}

/* No shape to report: 0 = "not known to be fragmentation". */
int nros_zephyr_heap_free_shape(size_t size, size_t *largest, size_t *total) {
    (void) size;
    if (largest != NULL) {
        *largest = 0;
    }
    if (total != NULL) {
        *total = 0;
    }
    return 0;
}
```
